## CMakeLists.txt
```
cmake_minimum_required(VERSION 3.20.0)

find_package(Zephyr REQUIRED HINTS $ENV{ZEPHYR_BASE})
project(test)

# CTR_CLOUD depends on the CHESTER LTE shield, so its Kconfig symbols are not
# visible here and the sources under test are compiled by hand with these values.
add_compile_definitions(CONFIG_CTR_CLOUD_LOG_LEVEL=3)

# The real ctr_cloud_transfer.c over a scripted ctr_lte_v2_send_recv()
set(CLOUD_DIR ${CMAKE_CURRENT_SOURCE_DIR}/../../../subsys/ctr_cloud)

include_directories(${CLOUD_DIR})
target_sources(app PRIVATE ${CLOUD_DIR}/ctr_cloud_packet.c)
target_sources(app PRIVATE ${CLOUD_DIR}/ctr_cloud_transfer.c)

target_sources(app PRIVATE src/mock_ctr_lte_v2.c)
target_sources(app PRIVATE src/test_transfer.c)
```

## prj.conf
```kconfig
CONFIG_LOG=y

CONFIG_CTR_BUF=y
CONFIG_BASE64=y

CONFIG_ZCBOR=y

CONFIG_ZTEST=y
CONFIG_ZTEST_STACK_SIZE=4096

# PSA crypto API (backend selection is per-board; see boards/*.conf)
CONFIG_PSA_WANT_ALG_SHA_256=y
```

## boards/native_sim.conf
```kconfig
# native_sim has a CSPRNG-capable entropy driver, so the Mbed TLS PSA
# provider works without the external-RNG fallback. On this non-Nordic target
# PSA_CRYPTO selects the Mbed TLS provider (CONFIG_PSA_CRYPTO_PROVIDER_MBEDTLS).
CONFIG_PSA_CRYPTO=y
CONFIG_ENTROPY_GENERATOR=y
```

## src/mock.h
```c
/*
 * Copyright (c) 2026 HARDWARIO a.s.
 *
 * SPDX-License-Identifier: LicenseRef-HARDWARIO-5-Clause
 */

#ifndef TESTS_SUBSYS_CTR_CLOUD_TRANSFER_SRC_MOCK_H_
#define TESTS_SUBSYS_CTR_CLOUD_TRANSFER_SRC_MOCK_H_

/* Standard includes */
#include <limits.h>
#include <stdbool.h>
#include <stddef.h>
#include <stdint.h>

/* The call lasts its whole timeout */
#define MOCK_LTE_UNTIL_TIMEOUT INT_MAX

/* The timeout of a call was K_FOREVER */
#define MOCK_LTE_FOREVER (-1)

/* One ctr_lte_v2_send_recv() call: the packet the transfer is expected to send, how long the call
 * takes and what it returns */
struct mock_lte_exchange {
	uint16_t sequence;
	uint8_t flags;
	/* Sent without a response expected (the final ACK) */
	bool no_recv;
	int duration_ms;
	int ret;
	/* The response packet, if the call succeeds and expects one */
	uint16_t resp_sequence;
	uint8_t resp_flags;
	const char *resp_data;
};

/* When a call started and the timeout it got (ms, or MOCK_LTE_FOREVER) */
struct mock_lte_call {
	int64_t start;
	int64_t timeout_ms;
};

/* Load a script of exchanges; a call past its end, or one that sends another packet, fails the
 * test */
void mock_lte_start(uint32_t serial_number, const uint8_t token[16],
		    const struct mock_lte_exchange *exchanges, size_t count);

/* The call (one of those made so far) */
const struct mock_lte_call *mock_lte_call(size_t index);

/* Assert that the script ran to its end */
void mock_lte_assert_done(void);

#endif
```

## src/mock_ctr_lte_v2.c
```c
/*
 * Copyright (c) 2026 HARDWARIO a.s.
 *
 * SPDX-License-Identifier: LicenseRef-HARDWARIO-5-Clause
 */

#include "mock.h"

#include "ctr_cloud_packet.h"

/* CHESTER includes */
#include <chester/ctr_buf.h>
#include <chester/ctr_lte_v2.h>

/* Zephyr includes */
#include <zephyr/kernel.h>
#include <zephyr/sys/base64.h>
#include <zephyr/ztest.h>

/* Standard includes */
#include <errno.h>
#include <stdbool.h>
#include <stddef.h>
#include <stdint.h>
#include <string.h>

#define CALLS_MAX 16

CTR_BUF_DEFINE_STATIC(m_pck_buf, CTR_CLOUD_PACKET_MAX_SIZE);

static uint32_t m_serial_number;
static uint8_t m_token[16];
static const struct mock_lte_exchange *m_exchanges;
static size_t m_count;
static size_t m_index;
static struct mock_lte_call m_calls[CALLS_MAX];

void mock_lte_start(uint32_t serial_number, const uint8_t token[16],
		    const struct mock_lte_exchange *exchanges, size_t count)
{
	zassert_true(count <= CALLS_MAX, "script of %zu exchanges, at most %d", count, CALLS_MAX);

	m_serial_number = serial_number;
	memcpy(m_token, token, sizeof(m_token));
	m_exchanges = exchanges;
	m_count = count;
	m_index = 0;
	memset(m_calls, 0, sizeof(m_calls));
}

const struct mock_lte_call *mock_lte_call(size_t index)
{
	zassert_true(index < m_index, "call %zu not made, %zu calls", index, m_index);

	return &m_calls[index];
}

void mock_lte_assert_done(void)
{
	zassert_equal(m_index, m_count, "script stopped at exchange %zu of %zu", m_index, m_count);
}

int ctr_lte_v2_enable(void)
{
	return 0;
}

int ctr_lte_v2_wait_for_connected(k_timeout_t timeout)
{
	return 0;
}

static int64_t timeout_ms(k_timeout_t timeout)
{
	if (K_TIMEOUT_EQ(timeout, K_FOREVER)) {
		return MOCK_LTE_FOREVER;
	}

	return k_ticks_to_ms_floor64(timeout.ticks);
}

int ctr_lte_v2_send_recv(const struct ctr_lte_v2_send_recv_param *param)
{
	size_t i = m_index;

	zassert_true(i < m_count, "send_recv %zu past the end of the script", i);

	const struct mock_lte_exchange *ex = &m_exchanges[i];
	struct mock_lte_call *call = &m_calls[i];

	m_index++;

	call->start = k_uptime_get();
	call->timeout_ms = timeout_ms(param->timeout);

	/* The packet sent */
	size_t len;
	ctr_buf_reset(&m_pck_buf);
	zassert_ok(base64_decode(ctr_buf_get_mem(&m_pck_buf), ctr_buf_get_free(&m_pck_buf), &len,
				 param->send_buf, param->send_len));
	ctr_buf_seek(&m_pck_buf, len);

	struct ctr_cloud_packet pck;
	zassert_ok(ctr_cloud_packet_unpack(&pck, m_token, &m_pck_buf));
	zassert_equal(pck.sequence, ex->sequence, "exchange %zu: sequence %u, expected %u", i,
		      pck.sequence, ex->sequence);
	zassert_equal(pck.flags, ex->flags, "exchange %zu: flags 0x%x, expected 0x%x", i, pck.flags,
		      ex->flags);
	zassert_equal(param->recv_buf == NULL, ex->no_recv, "exchange %zu: recv_buf %p", i,
		      param->recv_buf);

	/* The call takes its time, but not more than its timeout */
	k_timepoint_t end = sys_timepoint_calc(param->timeout);
	k_timepoint_t done = end;

	if (ex->duration_ms != MOCK_LTE_UNTIL_TIMEOUT) {
		done = sys_timepoint_calc(K_MSEC(ex->duration_ms));
		if (sys_timepoint_cmp(done, end) > 0) {
			done = end;
		}
	} else {
		zassert_false(K_TIMEOUT_EQ(param->timeout, K_FOREVER),
			      "exchange %zu: until K_FOREVER", i);
	}

	k_sleep(sys_timepoint_timeout(done));

	if (ex->ret) {
		return ex->ret;
	}

	*param->recv_len = 0;

	if (param->recv_buf) {
		struct ctr_cloud_packet resp = {
			.serial_number = m_serial_number,
			.sequence = ex->resp_sequence,
			.flags = ex->resp_flags,
			.data = (uint8_t *)ex->resp_data,
			.data_len = ex->resp_data ? strlen(ex->resp_data) : 0,
		};

		zassert_ok(ctr_cloud_packet_pack(&resp, m_token, &m_pck_buf));
		zassert_ok(base64_encode(param->recv_buf, param->recv_size, &len,
					 ctr_buf_get_mem(&m_pck_buf),
					 ctr_buf_get_used(&m_pck_buf)));
		*param->recv_len = len;
	}

	return 0;
}
```

## src/test_transfer.c
```c
/*
 * Copyright (c) 2026 HARDWARIO a.s.
 *
 * SPDX-License-Identifier: LicenseRef-HARDWARIO-5-Clause
 */

/*
 * Retries of ctr_cloud_transfer_uplink() and ctr_cloud_transfer_downlink() when an exchange fails
 * or gets a stale response, over a scripted ctr_lte_v2_send_recv()
 */

#include "ctr_cloud_packet.h"
#include "ctr_cloud_transfer.h"
#include "mock.h"

/* CHESTER includes */
#include <chester/ctr_buf.h>

/* Zephyr includes */
#include <zephyr/kernel.h>
#include <zephyr/ztest.h>

/* Standard includes */
#include <errno.h>
#include <stdint.h>
#include <string.h>

#define SERIAL_NUMBER 2159018247

#define UPLINK (CTR_CLOUD_PACKET_FLAG_FIRST | CTR_CLOUD_PACKET_FLAG_LAST)
#define POLL   CTR_CLOUD_PACKET_FLAG_POLL
#define ACK    CTR_CLOUD_PACKET_FLAG_ACK
#define LAST   CTR_CLOUD_PACKET_FLAG_LAST
#define DATA   (CTR_CLOUD_PACKET_FLAG_FIRST | CTR_CLOUD_PACKET_FLAG_LAST)

/* clang-format off */
/* The exchange of the packet fails after ms */
#define FAIL(seq, fl, err, ms) \
	{.sequence = (seq), .flags = (fl), .ret = (err), .duration_ms = (ms)}
/* The packet gets the response at once */
#define REPLY(seq, fl, rseq, rfl, data) \
	{.sequence = (seq), .flags = (fl), .resp_sequence = (rseq), .resp_flags = (rfl), \
	 .resp_data = (data)}
/* The packet gets the response after ms */
#define REPLY_AFTER(seq, fl, rseq, rfl, ms) \
	{.sequence = (seq), .flags = (fl), .resp_sequence = (rseq), .resp_flags = (rfl), \
	 .duration_ms = (ms)}
/* The final ACK of a downlink, which expects no response, fails after ms */
#define ACK_FAIL(seq, err, ms) \
	{.sequence = (seq), .flags = ACK, .no_recv = true, .ret = (err), .duration_ms = (ms)}
#define ACK_OK(seq) \
	{.sequence = (seq), .flags = ACK, .no_recv = true}
/* clang-format on */

static uint8_t m_token[16] = {0x01, 0x23, 0x45, 0x67, 0x89, 0xab, 0xcd, 0xef,
			      0xfe, 0xdc, 0xba, 0x98, 0x76, 0x54, 0x32, 0x10};

CTR_BUF_DEFINE_STATIC(m_buf, 64);
/* Two fragments: 360 and 40 bytes */
CTR_BUF_DEFINE_STATIC(m_big_buf, 400);

static int uplink(k_timeout_t timeout, int64_t *elapsed)
{
	ctr_buf_reset(&m_buf);
	zassert_ok(ctr_buf_append_mem(&m_buf, "Hello", 5));

	int64_t start = k_uptime_get();
	int ret = ctr_cloud_transfer_uplink(&m_buf, NULL, timeout);
	*elapsed = k_uptime_get() - start;

	return ret;
}

static int downlink(k_timeout_t timeout, int64_t *elapsed)
{
	ctr_buf_reset(&m_buf);

	int64_t start = k_uptime_get();
	int ret = ctr_cloud_transfer_downlink(&m_buf, NULL, timeout);
	*elapsed = k_uptime_get() - start;

	return ret;
}

/* Assert that the call started at_ms after the first one, with the timeout; each sleep before it
 * may end a tick or so late */
static void assert_call(size_t index, int64_t at_ms, int64_t timeout_ms)
{
	const struct mock_lte_call *call = mock_lte_call(index);
	int64_t at = call->start - mock_lte_call(0)->start;
	int64_t delta = 20 * (index + 1);

	zassert_within(at, at_ms, delta, "call %zu at %lld ms, expected %lld ms", index, at, at_ms);

	if (timeout_ms == MOCK_LTE_FOREVER) {
		zassert_equal(call->timeout_ms, MOCK_LTE_FOREVER,
			      "call %zu with timeout %lld ms, expected K_FOREVER", index,
			      call->timeout_ms);
	} else {
		zassert_within(call->timeout_ms, timeout_ms, delta,
			       "call %zu with timeout %lld ms, expected %lld ms", index,
			       call->timeout_ms, timeout_ms);
	}
}

/* A lost response: the same packet again 1 s later, with the time left */
ZTEST(transfer, test_lost_reply)
{
	static const struct mock_lte_exchange script[] = {
		FAIL(0, UPLINK, -ETIMEDOUT, 5000),
		REPLY(0, UPLINK, 1, 0, NULL),
	};

	mock_lte_start(SERIAL_NUMBER, m_token, script, ARRAY_SIZE(script));

	int64_t elapsed;
	int ret = uplink(K_SECONDS(60), &elapsed);
	zassert_ok(ret, "uplink failed: %d", ret);

	assert_call(0, 0, 60000);
	assert_call(1, 6000, 54000);
	mock_lte_assert_done();
}

/* No connection granted: the same packet again 30 s later */
ZTEST(transfer, test_no_conn)
{
	static const struct mock_lte_exchange script[] = {
		FAIL(0, UPLINK, -ENOTCONN, 3000),
		REPLY(0, UPLINK, 1, 0, NULL),
	};

	mock_lte_start(SERIAL_NUMBER, m_token, script, ARRAY_SIZE(script));

	int64_t elapsed;
	int ret = uplink(K_SECONDS(120), &elapsed);
	zassert_ok(ret, "uplink failed: %d", ret);

	assert_call(1, 33000, 87000);
	mock_lte_assert_done();
}

/* Each attempt gets the time left, and the backoff ends at the deadline */
ZTEST(transfer, test_deadline)
{
	static const struct mock_lte_exchange script[] = {
		FAIL(0, UPLINK, -ETIMEDOUT, 5000),
		/* The backoff of 30 s is cut to the 29 s left */
		FAIL(0, UPLINK, -ENOTCONN, 10000),
	};

	mock_lte_start(SERIAL_NUMBER, m_token, script, ARRAY_SIZE(script));

	int64_t elapsed;
	int ret = uplink(K_SECONDS(45), &elapsed);
	zassert_equal(ret, -ENOTCONN, "expected -ENOTCONN but got: %d", ret);
	zassert_within(elapsed, 45000, 20, "returned %lld ms after the call", elapsed);

	assert_call(1, 6000, 39000);
	mock_lte_assert_done();
}

/* The final ACK of a downlink, which gets no response, is sent again after no connection */
ZTEST(transfer, test_ack_no_conn)
{
	static const struct mock_lte_exchange script[] = {
		REPLY(0, POLL, 1, DATA, "abc"),
		ACK_FAIL(2, -ENOTCONN, 2000),
		ACK_OK(2),
	};

	mock_lte_start(SERIAL_NUMBER, m_token, script, ARRAY_SIZE(script));

	int64_t elapsed;
	int ret = downlink(K_SECONDS(60), &elapsed);
	zassert_ok(ret, "downlink failed: %d", ret);
	zassert_equal(ctr_buf_get_used(&m_buf), 3, "downlink of %zu bytes",
		      ctr_buf_get_used(&m_buf));
	zassert_mem_equal(ctr_buf_get_mem(&m_buf), "abc", 3);

	assert_call(2, 32000, 28000);
	mock_lte_assert_done();
}

/* ... but not after a lost response, as it expects none */
ZTEST(transfer, test_ack_lost_reply)
{
	static const struct mock_lte_exchange script[] = {
		REPLY(0, POLL, 1, DATA, "abc"),
		ACK_FAIL(2, -ETIMEDOUT, 2000),
	};

	mock_lte_start(SERIAL_NUMBER, m_token, script, ARRAY_SIZE(script));

	int64_t elapsed;
	int ret = downlink(K_SECONDS(60), &elapsed);
	zassert_equal(ret, -ETIMEDOUT, "expected -ETIMEDOUT but got: %d", ret);

	mock_lte_assert_done();
}

/* A fragment that would start past the deadline is not sent at all */
ZTEST(transfer, test_fragment_past_deadline)
{
	static const struct mock_lte_exchange script[] = {
		/* The response to the first fragment comes at the deadline */
		REPLY_AFTER(0, CTR_CLOUD_PACKET_FLAG_FIRST, 1, 0, 2000),
	};

	mock_lte_start(SERIAL_NUMBER, m_token, script, ARRAY_SIZE(script));

	ctr_buf_reset(&m_big_buf);
	memset(ctr_buf_get_mem(&m_big_buf), 0x55, ctr_buf_get_free(&m_big_buf));
	zassert_ok(ctr_buf_seek(&m_big_buf, 400));

	int64_t start = k_uptime_get();
	int ret = ctr_cloud_transfer_uplink(&m_big_buf, NULL, K_MSEC(2000));
	int64_t elapsed = k_uptime_get() - start;

	zassert_equal(ret, -ETIMEDOUT, "expected -ETIMEDOUT but got: %d", ret);
	zassert_within(elapsed, 2000, 20, "returned %lld ms after the call", elapsed);

	mock_lte_assert_done();
}

/* A stale response to an uplink: the same packet with the same sequence, at most 3 times, then a
 * restart 1 s later */
ZTEST(transfer, test_stale_uplink)
{
	static const struct mock_lte_exchange script[] = {
		REPLY(0, UPLINK, 1, 0, NULL),
		/* The response to the previous packet, 4 times */
		REPLY(2, UPLINK, 1, 0, NULL),
		REPLY(2, UPLINK, 1, 0, NULL),
		REPLY(2, UPLINK, 1, 0, NULL),
		REPLY(2, UPLINK, 1, 0, NULL),
		/* Restarted */
		REPLY(0, UPLINK, 1, 0, NULL),
	};

	mock_lte_start(SERIAL_NUMBER, m_token, script, ARRAY_SIZE(script));

	int64_t elapsed;
	int ret = uplink(K_SECONDS(60), &elapsed);
	zassert_ok(ret, "uplink failed: %d", ret);

	ret = uplink(K_SECONDS(60), &elapsed);
	zassert_ok(ret, "uplink failed: %d", ret);

	assert_call(4, 0, 60000);
	assert_call(5, 1000, 59000);
	mock_lte_assert_done();
}

/* The same for a downlink */
ZTEST(transfer, test_stale_downlink)
{
	static const struct mock_lte_exchange script[] = {
		REPLY(0, POLL, 1, LAST, NULL),
		/* The response to the previous packet, 4 times */
		REPLY(2, POLL, 1, LAST, NULL),
		REPLY(2, POLL, 1, LAST, NULL),
		REPLY(2, POLL, 1, LAST, NULL),
		REPLY(2, POLL, 1, LAST, NULL),
		/* Restarted */
		REPLY(0, POLL, 1, LAST, NULL),
	};

	mock_lte_start(SERIAL_NUMBER, m_token, script, ARRAY_SIZE(script));

	int64_t elapsed;
	int ret = downlink(K_SECONDS(60), &elapsed);
	zassert_ok(ret, "downlink failed: %d", ret);

	ret = downlink(K_SECONDS(60), &elapsed);
	zassert_ok(ret, "downlink failed: %d", ret);

	assert_call(4, 0, 60000);
	assert_call(5, 1000, 59000);
	mock_lte_assert_done();
}

/* A restart waits 1 s, and not past the deadline */
ZTEST(transfer, test_restart_deadline)
{
	static const struct mock_lte_exchange script[] = {
		/* An unexpected sequence each time */
		REPLY(0, UPLINK, 77, 0, NULL),
		REPLY(0, UPLINK, 77, 0, NULL),
		REPLY(0, UPLINK, 77, 0, NULL),
	};

	mock_lte_start(SERIAL_NUMBER, m_token, script, ARRAY_SIZE(script));

	int64_t elapsed;
	int ret = uplink(K_MSEC(2500), &elapsed);
	zassert_equal(ret, -ETIMEDOUT, "expected -ETIMEDOUT but got: %d", ret);
	zassert_within(elapsed, 2500, 20, "returned %lld ms after the call", elapsed);

	assert_call(1, 1000, 1500);
	assert_call(2, 2000, 500);
	mock_lte_assert_done();
}

/* The same for a downlink */
ZTEST(transfer, test_restart_deadline_downlink)
{
	static const struct mock_lte_exchange script[] = {
		REPLY(0, POLL, 77, LAST, NULL),
		REPLY(0, POLL, 77, LAST, NULL),
		REPLY(0, POLL, 77, LAST, NULL),
	};

	mock_lte_start(SERIAL_NUMBER, m_token, script, ARRAY_SIZE(script));

	int64_t elapsed;
	int ret = downlink(K_MSEC(2500), &elapsed);
	zassert_equal(ret, -ETIMEDOUT, "expected -ETIMEDOUT but got: %d", ret);
	zassert_within(elapsed, 2500, 20, "returned %lld ms after the call", elapsed);

	assert_call(1, 1000, 1500);
	assert_call(2, 2000, 500);
	mock_lte_assert_done();
}

/* K_FOREVER retries on */
ZTEST(transfer, test_forever)
{
	/* clang-format off */
	static const struct mock_lte_exchange script[] = {
		FAIL(0, UPLINK, -ENOTCONN, 1000),
		FAIL(0, UPLINK, -ENOTCONN, 1000),
		FAIL(0, UPLINK, -ENOTCONN, 1000),
		FAIL(0, UPLINK, -ETIMEDOUT, 5000),
		FAIL(0, UPLINK, -ETIMEDOUT, 5000),
		REPLY(0, UPLINK, 1, 0, NULL),
	};
	/* clang-format on */

	mock_lte_start(SERIAL_NUMBER, m_token, script, ARRAY_SIZE(script));

	int64_t elapsed;
	int ret = uplink(K_FOREVER, &elapsed);
	zassert_ok(ret, "uplink failed: %d", ret);

	assert_call(0, 0, MOCK_LTE_FOREVER);
	assert_call(1, 31000, MOCK_LTE_FOREVER);
	assert_call(2, 62000, MOCK_LTE_FOREVER);
	assert_call(3, 93000, MOCK_LTE_FOREVER);
	assert_call(4, 99000, MOCK_LTE_FOREVER);
	assert_call(5, 105000, MOCK_LTE_FOREVER);
	mock_lte_assert_done();
}

static void before(void *fixture)
{
	/* From sequence 0 */
	zassert_ok(ctr_cloud_transfer_init(SERIAL_NUMBER, m_token, NULL));
}

ZTEST_SUITE(transfer, NULL, NULL, before, NULL, NULL);
```
