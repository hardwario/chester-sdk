## CMakeLists.txt
```
cmake_minimum_required(VERSION 3.20.0)

find_package(Zephyr REQUIRED HINTS $ENV{ZEPHYR_BASE})
project(test)

# The subsystem source is compiled directly into each suite via #include
# "ctr_trace.c" (white-box access to its now-static helpers), NOT linked through
# CONFIG_CTR_TRACE (kept off in prj.conf). This include path resolves both that
# include and its nested #include "ctr_trace_priv.h".
include_directories(${CMAKE_CURRENT_SOURCE_DIR}/../../../subsys/ctr_trace)

# Kconfig knobs the subsystem source needs when compiled directly: with
# CONFIG_CTR_TRACE=n the `if CTR_TRACE` block (log level, reason count, init
# priority, shell) is absent from autoconf, so supply them here. Keep in sync
# with subsys/ctr_trace/Kconfig defaults.
zephyr_compile_definitions(
  CONFIG_CTR_TRACE_LOG_LEVEL=4          # LOG_LEVEL_DBG
  CONFIG_CTR_TRACE_RESET_REASON_COUNT=8 # Kconfig default
  CONFIG_CTR_TRACE_INIT_PRIORITY=90     # = CONFIG_APPLICATION_INIT_PRIORITY default
  CONFIG_CTR_TRACE_SHELL=1              # registers the `trace` shell command set
)

# Mock retained_mem device (chosen device for the subsystem + scratch device
# for the unit tests).
target_sources(app PRIVATE src/mock_retmem.c)

# Test suites; one CONFIG_TEST_FEATURE_* flag each.
target_sources_ifdef(CONFIG_TEST_FEATURE_LAYOUT app PRIVATE src/test_layout.c)
target_sources_ifdef(CONFIG_TEST_FEATURE_RING   app PRIVATE src/test_ring.c)
target_sources_ifdef(CONFIG_TEST_FEATURE_REASON app PRIVATE src/test_reason.c)
target_sources_ifdef(CONFIG_TEST_FEATURE_SHELL  app PRIVATE src/test_shell.c)
```

## Kconfig
```
#
# Copyright (c) 2026 HARDWARIO a.s.
#
# SPDX-License-Identifier: LicenseRef-HARDWARIO-5-Clause
#

menu "Test Features"

config TEST_FEATURE_LAYOUT
	bool "Test retained-region layout math and fault decision"
	default n

config TEST_FEATURE_RING
	bool "Test the log ring buffer and fault snapshot"
	default n

config TEST_FEATURE_REASON
	bool "Test the reset-record ring"
	default n

config TEST_FEATURE_SHELL
	bool "Test the trace shell command interface"
	default n

endmenu

# Include Zephyr's Kconfig
source "Kconfig"
```

## prj.conf
```kconfig
CONFIG_ZTEST=y
CONFIG_MAIN_STACK_SIZE=4096

CONFIG_LOG=y
CONFIG_LOG_FUNC_NAME_PREFIX_ERR=y
CONFIG_LOG_FUNC_NAME_PREFIX_WRN=y
CONFIG_LOG_FUNC_NAME_PREFIX_INF=y
CONFIG_LOG_FUNC_NAME_PREFIX_DBG=y

CONFIG_REQUIRES_FULL_LIBC=y

# Retained memory framework (the mock device provides the storage; the real
# zephyr-ram driver is disabled in boards/native_sim.conf).
CONFIG_RETAINED_MEM=y

CONFIG_HWINFO=y

# The subsystem source is compiled directly into each test via #include
# "ctr_trace.c" (white-box access to its statics), so it must NOT also be linked
# through the chester module library -- that would double-define its global
# symbols (fatal-error handler, log backend, shell command set). The board
# overlay enables the chosen `ctr,trace_mem` node, which would otherwise make the
# subsystem Kconfig default to y, so force it off. The CONFIG_CTR_TRACE_* knobs
# the source needs are supplied as compile definitions in CMakeLists.txt.
CONFIG_CTR_TRACE=n

# Dummy shell backend so no UART/serial is needed.
CONFIG_SHELL=y
CONFIG_SHELL_BACKEND_SERIAL=n
CONFIG_SHELL_BACKEND_DUMMY=y
CONFIG_SHELL_BACKEND_DUMMY_BUF_SIZE=4096
CONFIG_SHELL_LOG_BACKEND=n

CONFIG_HEAP_MEM_POOL_SIZE=4096
```

## boards/native_sim.conf
```kconfig
# The mock in src/mock_retmem.c provides the retained_mem device, so disable the
# real zephyr-ram driver (it would otherwise also bind the chosen node).
CONFIG_RETAINED_MEM_ZEPHYR_RAM=n

# ctr_trace requires the retained_mem mutex to be disabled (its fatal-error
# handler writes the fault marker from a context with interrupts locked).
CONFIG_RETAINED_MEM_MUTEX_FORCE_DISABLE=y
```

## boards/native_sim.overlay
```dts
/ {
	chosen {
		ctr,trace_mem = &ctr_trace_mem;
	};

	/* Plain container carrying #address-cells/#size-cells so the child's reg
	 * parses. No `zephyr,memory-region`/`mmio-sram` so native_sim does not try
	 * to allocate a fixed-address linker region. The real driver is disabled
	 * (see boards/native_sim.conf); src/mock_retmem.c provides the device. The
	 * reg size below feeds ctr_trace's compile-time region-size assertion and
	 * must match MOCK_RETMEM_SIZE. */
	ctr_trace_container {
		#address-cells = <1>;
		#size-cells = <1>;

		ctr_trace_mem: retainedmem@0 {
			compatible = "zephyr,retained-ram";
			reg = <0x0 0x2000>;
		};
	};
};
```

## src/mock_retmem.c
```c
/*
 * Copyright (c) 2026 HARDWARIO a.s.
 *
 * SPDX-License-Identifier: LicenseRef-HARDWARIO-5-Clause
 */

#include "mock_retmem.h"

#include <zephyr/device.h>
#include <zephyr/devicetree.h>
#include <zephyr/drivers/retained_mem.h>
#include <zephyr/kernel.h>

#include <string.h>

struct mock_retmem_config {
	uint8_t *base;
	size_t size;
};

static uint8_t mock_chosen_backing[MOCK_RETMEM_SIZE];
uint8_t mock_test_backing[MOCK_RETMEM_SIZE];

static int mock_retmem_init(const struct device *dev)
{
	ARG_UNUSED(dev);
	return 0;
}

static ssize_t mock_retmem_size(const struct device *dev)
{
	const struct mock_retmem_config *config = dev->config;

	return (ssize_t)config->size;
}

static int mock_retmem_read(const struct device *dev, off_t offset, uint8_t *buffer, size_t size)
{
	const struct mock_retmem_config *config = dev->config;

	memcpy(buffer, config->base + offset, size);
	return 0;
}

static int mock_retmem_write(const struct device *dev, off_t offset, const uint8_t *buffer,
			     size_t size)
{
	const struct mock_retmem_config *config = dev->config;

	memcpy(config->base + offset, buffer, size);
	return 0;
}

static int mock_retmem_clear(const struct device *dev)
{
	const struct mock_retmem_config *config = dev->config;

	memset(config->base, 0, config->size);
	return 0;
}

static const struct retained_mem_driver_api mock_retmem_api = {
	.size = mock_retmem_size,
	.read = mock_retmem_read,
	.write = mock_retmem_write,
	.clear = mock_retmem_clear,
};

/* Device bound to the DT chosen node, used by the ctr_trace subsystem. */
static const struct mock_retmem_config mock_chosen_config = {
	.base = mock_chosen_backing,
	.size = MOCK_RETMEM_SIZE,
};

DEVICE_DT_DEFINE(DT_CHOSEN(ctr_trace_mem), mock_retmem_init, NULL, NULL, &mock_chosen_config,
		 POST_KERNEL, CONFIG_KERNEL_INIT_PRIORITY_DEVICE, &mock_retmem_api);

/* Standalone scratch device for the unit tests. */
static const struct mock_retmem_config mock_test_config = {
	.base = mock_test_backing,
	.size = MOCK_RETMEM_SIZE,
};

DEVICE_DEFINE(mock_test_retmem, "MOCK_TEST_RETMEM", mock_retmem_init, NULL, NULL,
	      &mock_test_config, POST_KERNEL, CONFIG_KERNEL_INIT_PRIORITY_DEVICE, &mock_retmem_api);

const struct device *mock_test_dev(void)
{
	return DEVICE_GET(mock_test_retmem);
}

void mock_test_reset(void)
{
	memset(mock_test_backing, 0, sizeof(mock_test_backing));
}
```

## src/mock_retmem.h
```c
/*
 * Copyright (c) 2026 HARDWARIO a.s.
 *
 * SPDX-License-Identifier: LicenseRef-HARDWARIO-5-Clause
 *
 * Mock retained_mem device backed by a plain static array. Two instances are
 * provided:
 *   - the DT `ctr,trace_mem` chosen device, used by the ctr_trace subsystem's
 *     own SYS_INIT (backing store hidden), and
 *   - a standalone scratch device (`mock_test_dev()` / `mock_test_backing`) that
 *     the ring/reason unit tests drive directly, so the subsystem's live log
 *     backend never races the test data.
 */

#ifndef MOCK_RETMEM_H_
#define MOCK_RETMEM_H_

#include <zephyr/device.h>

#include <stddef.h>
#include <stdint.h>

#define MOCK_RETMEM_SIZE 8192

/** Backing store of the standalone scratch device (white-box access). */
extern uint8_t mock_test_backing[MOCK_RETMEM_SIZE];

/** Standalone scratch retained_mem device for unit tests. */
const struct device *mock_test_dev(void);

/** Zero the scratch backing store. */
void mock_test_reset(void);

#endif /* MOCK_RETMEM_H_ */
```

## src/test_layout.c
```c
/*
 * Copyright (c) 2026 HARDWARIO a.s.
 *
 * SPDX-License-Identifier: LicenseRef-HARDWARIO-5-Clause
 *
 * Pure-logic tests for the retained-region partitioning (layout_compute) and the
 * fault decision (reset_is_fault). No device required.
 *
 * The subsystem source is compiled in directly for white-box access to its
 * static helpers.
 */

#include "ctr_trace.c"

#include <zephyr/drivers/hwinfo.h>
#include <zephyr/ztest.h>

#include <errno.h>
#include <stdint.h>

ZTEST_SUITE(ctr_trace_layout, NULL, NULL, NULL, NULL, NULL);

ZTEST(ctr_trace_layout, test_layout_valid)
{
	struct ctr_trace_layout l;
	size_t region = 8192;
	uint16_t reasons = 8;

	zassert_ok(layout_compute(region, reasons, &l));

	size_t hdr = sizeof(struct ctr_trace_header);
	size_t reason_bytes = (size_t)reasons * sizeof(struct ctr_trace_boot_rec);

	/* Reset records sit right after the header. */
	zassert_equal((size_t)l.reasons_off, hdr);
	zassert_equal(l.reason_cap, reasons);

	/* Primary follows the reset records; secondary follows the primary. */
	zassert_equal((size_t)l.primary_off, hdr + reason_bytes);
	zassert_equal((size_t)l.secondary_off, hdr + reason_bytes + l.log_size);

	/* Both log buffers are equal and account for the whole remainder. */
	zassert_true(l.log_size >= CTR_TRACE_MIN_LOG_SIZE);
	zassert_true((size_t)l.secondary_off + l.log_size <= region,
		     "layout must not exceed the region");
	zassert_equal(l.log_size, (region - hdr - reason_bytes) / 2);
}

ZTEST(ctr_trace_layout, test_layout_too_small)
{
	struct ctr_trace_layout l;

	/* A region that cannot hold header + records + two minimal log buffers. */
	size_t hdr = sizeof(struct ctr_trace_header);
	size_t tiny = hdr + 8 * sizeof(struct ctr_trace_boot_rec) + CTR_TRACE_MIN_LOG_SIZE;

	zassert_equal(layout_compute(tiny, 8, &l), -ENOMEM,
		      "must reject a region too small for two log buffers");
}

ZTEST(ctr_trace_layout, test_layout_boundary)
{
	struct ctr_trace_layout l;
	size_t hdr = sizeof(struct ctr_trace_header);
	uint16_t reasons = 4;
	size_t reason_bytes = (size_t)reasons * sizeof(struct ctr_trace_boot_rec);

	/* Exactly large enough: header + records + 2 * minimal log buffer. */
	size_t exact = hdr + reason_bytes + 2 * CTR_TRACE_MIN_LOG_SIZE;

	zassert_ok(layout_compute(exact, reasons, &l));
	zassert_equal(l.log_size, CTR_TRACE_MIN_LOG_SIZE);

	/* One byte short must fail. */
	zassert_equal(layout_compute(exact - 1, reasons, &l), -ENOMEM);
}

ZTEST(ctr_trace_layout, test_fault_decision)
{
	/* Marker alone is a fault. */
	zassert_true(reset_is_fault(0, true));

	/* Watchdog and lockup are faults. */
	zassert_true(reset_is_fault(RESET_WATCHDOG, false));
	zassert_true(reset_is_fault(RESET_CPU_LOCKUP, false));
	zassert_true(reset_is_fault(RESET_WATCHDOG | RESET_PIN, false));

	/* A plain software or power-on reset is NOT a fault (clean reboot looks
	 * identical to a crash-triggered software reset). */
	zassert_false(reset_is_fault(RESET_SOFTWARE, false));
	zassert_false(reset_is_fault(RESET_POR, false));
	zassert_false(reset_is_fault(RESET_PIN, false));
	zassert_false(reset_is_fault(0, false));

	/* But a software reset with the marker set is a fault. */
	zassert_true(reset_is_fault(RESET_SOFTWARE, true));
}
```

## src/test_reason.c
```c
/*
 * Copyright (c) 2026 HARDWARIO a.s.
 *
 * SPDX-License-Identifier: LicenseRef-HARDWARIO-5-Clause
 *
 * Tests for the saturating reset-record ring, driven against the standalone
 * mock retained_mem device.
 */

#include "mock_retmem.h"

/* Compile the subsystem source in directly for white-box access to its static
 * reset-record ring helpers. */
#include "ctr_trace.c"

#include <zephyr/drivers/hwinfo.h>
#include <zephyr/ztest.h>

#include <stdint.h>

#define REASONS_OFF 0
#define CAP         4

/* Renamed from m_dev to avoid clashing with the static m_dev in the #included
 * ctr_trace.c. This points at the standalone scratch device. */
static const struct device *test_dev;

static void test_before(void *f)
{
	ARG_UNUSED(f);
	test_dev = mock_test_dev();
	mock_test_reset();
}

ZTEST_SUITE(ctr_trace_reason, NULL, NULL, test_before, NULL, NULL);

static void append_rec(uint16_t *head, uint16_t *count, uint16_t boot_num, uint32_t cause)
{
	struct ctr_trace_boot_rec rec = {0};

	rec.boot_num = boot_num;
	rec.reset_cause = cause;
	zassert_ok(reason_append(test_dev, REASONS_OFF, CAP, head, count, &rec));
}

ZTEST(ctr_trace_reason, test_below_capacity)
{
	uint16_t head = 0, count = 0;

	append_rec(&head, &count, 1, RESET_POR);
	append_rec(&head, &count, 2, RESET_SOFTWARE);

	zassert_equal(count, 2);

	struct ctr_trace_boot_rec out[CAP];
	uint16_t n = 0;

	zassert_ok(reason_get(test_dev, REASONS_OFF, CAP, head, count, out, CAP, &n));
	zassert_equal(n, 2);
	zassert_equal(out[0].boot_num, 1, "oldest first");
	zassert_equal(out[1].boot_num, 2);
	zassert_equal(out[0].reset_cause, RESET_POR);
	zassert_equal(out[1].reset_cause, RESET_SOFTWARE);
}

ZTEST(ctr_trace_reason, test_overflow_saturates)
{
	uint16_t head = 0, count = 0;

	/* Append CAP + 3 records; only the most recent CAP survive. */
	for (uint16_t i = 1; i <= CAP + 3; i++) {
		append_rec(&head, &count, i, RESET_WATCHDOG);
	}

	zassert_equal(count, CAP, "count must saturate at capacity");

	struct ctr_trace_boot_rec out[CAP];
	uint16_t n = 0;

	zassert_ok(reason_get(test_dev, REASONS_OFF, CAP, head, count, out, CAP, &n));
	zassert_equal(n, CAP);

	/* Retained = the last CAP boot numbers, oldest-of-retained first. */
	uint16_t first = (CAP + 3) - CAP + 1;

	for (uint16_t i = 0; i < CAP; i++) {
		zassert_equal(out[i].boot_num, first + i, "retained record %u wrong", i);
	}
}

ZTEST(ctr_trace_reason, test_get_clamps_to_max)
{
	uint16_t head = 0, count = 0;

	for (uint16_t i = 1; i <= CAP; i++) {
		append_rec(&head, &count, i, 0);
	}

	struct ctr_trace_boot_rec out[CAP];
	uint16_t n = 999;

	zassert_ok(reason_get(test_dev, REASONS_OFF, CAP, head, count, out, 2, &n));
	zassert_equal(n, 2, "get must clamp to max");
	zassert_equal(out[0].boot_num, 1);
	zassert_equal(out[1].boot_num, 2);
}
```

## src/test_ring.c
```c
/*
 * Copyright (c) 2026 HARDWARIO a.s.
 *
 * SPDX-License-Identifier: LicenseRef-HARDWARIO-5-Clause
 *
 * Tests for the circular log-region primitives (append / read) and the
 * fault-snapshot copy, driven against the standalone mock retained_mem device.
 */

#include "mock_retmem.h"

/* Compile the subsystem source in directly for white-box access to its static
 * ring/snapshot helpers. */
#include "ctr_trace.c"

static int log_read(const struct device *dev, off_t data_off, size_t size, uint32_t head,
		    uint32_t count, uint8_t *out, size_t max, size_t *copied)
{
	int ret;
	size_t n = MIN((size_t)count, max);

	if (n == 0 || size == 0) {
		*copied = 0;
		return 0;
	}

	uint32_t oldest = (uint32_t)(((size_t)head + size - count) % size);
	size_t first = MIN(n, size - oldest);

	ret = retained_mem_read(dev, data_off + (off_t)oldest, out, first);
	if (ret) {
		return ret;
	}

	if (n > first) {
		ret = retained_mem_read(dev, data_off, out + first, n - first);
		if (ret) {
			return ret;
		}
	}

	*copied = n;

	return 0;
}

#include <zephyr/ztest.h>

#include <stdint.h>
#include <string.h>

#define RING_OFF  0
#define RING_SIZE 256
#define SNAP_OFF  1024

/* Renamed from m_dev to avoid clashing with the static m_dev in the #included
 * ctr_trace.c. This points at the standalone scratch device. */
static const struct device *test_dev;

static void test_before(void *f)
{
	ARG_UNUSED(f);
	test_dev = mock_test_dev();
	mock_test_reset();
}

ZTEST_SUITE(ctr_trace_ring, NULL, NULL, test_before, NULL, NULL);

/* Append a run of `n` bytes starting at value `start` (wrapping mod 256). */
static void append_seq(uint32_t *head, uint32_t *count, uint8_t start, size_t n)
{
	uint8_t tmp[512];

	for (size_t i = 0; i < n; i++) {
		tmp[i] = (uint8_t)(start + i);
	}
	zassert_ok(log_append(test_dev, RING_OFF, RING_SIZE, head, count, tmp, n));
}

ZTEST(ctr_trace_ring, test_empty)
{
	uint8_t out[RING_SIZE];
	size_t copied = 12345;

	zassert_ok(log_read(test_dev, RING_OFF, RING_SIZE, 0, 0, out, sizeof(out), &copied));
	zassert_equal(copied, 0, "empty ring must read 0 bytes");
}

ZTEST(ctr_trace_ring, test_below_capacity)
{
	uint32_t head = 0, count = 0;
	uint8_t out[RING_SIZE];
	size_t copied = 0;

	append_seq(&head, &count, 0, 100);
	zassert_equal(count, 100);
	zassert_equal(head, 100);

	zassert_ok(log_read(test_dev, RING_OFF, RING_SIZE, head, count, out, sizeof(out), &copied));
	zassert_equal(copied, 100);
	for (size_t i = 0; i < 100; i++) {
		zassert_equal(out[i], (uint8_t)i, "byte %d mismatch (oldest first)", (int)i);
	}
}

ZTEST(ctr_trace_ring, test_overflow_saturates)
{
	uint32_t head = 0, count = 0;
	uint8_t out[RING_SIZE];
	size_t copied = 0;

	/* Write 700 bytes into a 256-byte ring; only the last 256 survive. */
	append_seq(&head, &count, 0, 300);
	append_seq(&head, &count, (uint8_t)300, 400);

	zassert_equal(count, RING_SIZE, "count must saturate at ring size");

	zassert_ok(log_read(test_dev, RING_OFF, RING_SIZE, head, count, out, sizeof(out), &copied));
	zassert_equal(copied, RING_SIZE);

	/* Total written = 700; last 256 correspond to values 444..699 (mod 256). */
	for (size_t i = 0; i < RING_SIZE; i++) {
		uint8_t expect = (uint8_t)((700 - RING_SIZE) + i);

		zassert_equal(out[i], expect, "retained byte %d mismatch", (int)i);
	}
}

ZTEST(ctr_trace_ring, test_single_write_larger_than_ring)
{
	uint32_t head = 0, count = 0;
	uint8_t out[RING_SIZE];
	size_t copied = 0;

	/* One append bigger than the ring keeps only its last RING_SIZE bytes. */
	append_seq(&head, &count, 0, 400);

	zassert_equal(count, RING_SIZE);
	zassert_ok(log_read(test_dev, RING_OFF, RING_SIZE, head, count, out, sizeof(out), &copied));
	zassert_equal(copied, RING_SIZE);
	for (size_t i = 0; i < RING_SIZE; i++) {
		zassert_equal(out[i], (uint8_t)((400 - RING_SIZE) + i), "byte %d mismatch", (int)i);
	}
}

ZTEST(ctr_trace_ring, test_read_clamps_to_max)
{
	uint32_t head = 0, count = 0;
	uint8_t out[RING_SIZE];
	size_t copied = 0;

	append_seq(&head, &count, 10, 50);

	/* Poison the destination beyond `max` to confirm it is not written. */
	memset(out, 0xAA, sizeof(out));

	zassert_ok(log_read(test_dev, RING_OFF, RING_SIZE, head, count, out, 20, &copied));
	zassert_equal(copied, 20, "read must clamp to max");
	for (size_t i = 0; i < 20; i++) {
		zassert_equal(out[i], (uint8_t)(10 + i));
	}
	zassert_equal(out[20], 0xAA, "read must not write past max");

	/* max == 0 copies nothing. */
	copied = 999;
	zassert_ok(log_read(test_dev, RING_OFF, RING_SIZE, head, count, out, 0, &copied));
	zassert_equal(copied, 0);
}

ZTEST(ctr_trace_ring, test_snapshot)
{
	uint32_t head = 0, count = 0;

	/* Fill the ring past capacity so the logical content wraps. */
	append_seq(&head, &count, 0, 400);
	zassert_equal(count, RING_SIZE);

	uint32_t snap_len = 0;

	zassert_ok(snapshot(test_dev, RING_OFF, SNAP_OFF, RING_SIZE, head, count, &snap_len));
	zassert_equal(snap_len, RING_SIZE, "snapshot must copy the whole valid content");

	/* The snapshot is linear and oldest-first: read it straight back. */
	uint8_t snap[RING_SIZE];

	zassert_ok(log_read(test_dev, SNAP_OFF, RING_SIZE, RING_SIZE, RING_SIZE, snap, sizeof(snap),
			    &(size_t){0}));

	/* Also read raw so we compare linear bytes exactly. */
	uint8_t raw[RING_SIZE];

	memcpy(raw, mock_test_backing + SNAP_OFF, RING_SIZE);
	for (size_t i = 0; i < RING_SIZE; i++) {
		zassert_equal(raw[i], (uint8_t)((400 - RING_SIZE) + i), "snapshot byte %d mismatch",
			      (int)i);
	}
}

ZTEST(ctr_trace_ring, test_snapshot_empty)
{
	uint32_t snap_len = 999;

	zassert_ok(snapshot(test_dev, RING_OFF, SNAP_OFF, RING_SIZE, 0, 0, &snap_len));
	zassert_equal(snap_len, 0, "snapshot of empty ring copies nothing");
}
```

## src/test_shell.c
```c
/*
 * Copyright (c) 2026 HARDWARIO a.s.
 *
 * SPDX-License-Identifier: LicenseRef-HARDWARIO-5-Clause
 *
 * Black-box tests of the `trace` shell command interface, driven through the
 * dummy shell backend. Exercises the real subsystem state initialized by
 * ctr_trace's SYS_INIT (which recorded this boot into the chosen retained_mem
 * device).
 */

/* Compile the subsystem source in directly (it is not linked via
 * CONFIG_CTR_TRACE): this brings in its SYS_INIT, log backend and the `trace`
 * shell command set that these black-box tests drive. */
#include "ctr_trace.c"

#include <zephyr/kernel.h>
#include <zephyr/shell/shell.h>
#include <zephyr/shell/shell_dummy.h>
#include <zephyr/ztest.h>

#include <string.h>

static int run_cmd(const char *cmd, const char **out)
{
	const struct shell *sh = shell_backend_dummy_get_ptr();

	shell_backend_dummy_clear_output(sh);

	int ret = shell_execute_cmd(sh, cmd);

	size_t size;
	*out = shell_backend_dummy_get_output(sh, &size);

	return ret;
}

static void *suite_setup(void)
{
	/* Let the shell backend finish initializing before driving it. */
	k_sleep(K_MSEC(500));
	return NULL;
}

ZTEST_SUITE(ctr_trace_shell, NULL, suite_setup, NULL, NULL, NULL);

/* Tests are prefixed to force run order: the read-only "show" checks run before
 * the destructive "clear" tests (ztest executes tests alphabetically). */
ZTEST(ctr_trace_shell, test_1_reset_show_has_boot_record)
{
	const char *out;
	int ret = run_cmd("trace reset show", &out);

	zassert_ok(ret, "command returned %d, output: %s", ret, out);
	/* SYS_INIT recorded the first boot. */
	zassert_true(strstr(out, "boot 1") != NULL, "expected a boot record, output: %s", out);
}

ZTEST(ctr_trace_shell, test_2_fault_show_empty_on_clean_boot)
{
	const char *out;
	int ret = run_cmd("trace fault show", &out);

	zassert_ok(ret, "command returned %d, output: %s", ret, out);
	zassert_true(strstr(out, "no fault snapshot") != NULL, "output: %s", out);
}

ZTEST(ctr_trace_shell, test_3_log_show_and_clear)
{
	const char *out;

	/* The primary ring already holds boot-time logs; just confirm show works. */
	int ret = run_cmd("trace log show", &out);

	zassert_ok(ret, "command returned %d, output: %s", ret, out);

	/* Clear and confirm it empties. */
	ret = run_cmd("trace log clear", &out);
	zassert_ok(ret, "clear returned %d, output: %s", ret, out);
	zassert_true(strstr(out, "command succeeded") != NULL, "output: %s", out);

	ret = run_cmd("trace log show", &out);
	zassert_ok(ret, "command returned %d, output: %s", ret, out);
	zassert_true(strstr(out, "<empty>") != NULL, "log must be empty after clear, output: %s",
		     out);
}

ZTEST(ctr_trace_shell, test_4_reset_clear)
{
	const char *out;

	int ret = run_cmd("trace reset clear", &out);

	zassert_ok(ret, "clear returned %d, output: %s", ret, out);

	ret = run_cmd("trace reset show", &out);
	zassert_ok(ret, "command returned %d, output: %s", ret, out);
	zassert_true(strstr(out, "<empty>") != NULL,
		     "records must be empty after clear, output: %s", out);
}
```
