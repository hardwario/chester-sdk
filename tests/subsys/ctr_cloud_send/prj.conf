## CMakeLists.txt
```
cmake_minimum_required(VERSION 3.20.0)

find_package(Zephyr REQUIRED HINTS $ENV{ZEPHYR_BASE})
project(test)

# CTR_CLOUD depends on the CHESTER LTE shield, so its Kconfig symbols are not
# visible here and the sources under test are compiled by hand with these values.
add_compile_definitions(CONFIG_CTR_CLOUD_LOG_LEVEL=3)
add_compile_definitions(CONFIG_CTR_CLOUD_TRANSFER_BUF_SIZE=16384)
add_compile_definitions(CONFIG_CTR_CLOUD_ENCODE_ZCBOR_STATES=2)
if(NOT DEFINED TEST_SPOOL)
  set(TEST_SPOOL 1)
endif()
if(TEST_SPOOL)
  add_compile_definitions(CONFIG_CTR_CLOUD_SPOOL=1)
endif()
# Firmware update confirmed by the init work, see src/mock_boot.c
if(NOT DEFINED TEST_FW)
  set(TEST_FW 1)
endif()
add_compile_definitions(TEST_FW=${TEST_FW})
# The uploads of the init steps fail, see init_setup() in src/test_send_data_cb.c
if(NOT DEFINED TEST_INIT_RETRY)
  set(TEST_INIT_RETRY 0)
endif()
add_compile_definitions(TEST_INIT_RETRY=${TEST_INIT_RETRY})
# `config show` fails, so the config cannot be packed, see init_setup()
if(NOT DEFINED TEST_CONFIG_SHOW_FAIL)
  set(TEST_CONFIG_SHOW_FAIL 0)
endif()
add_compile_definitions(TEST_CONFIG_SHOW_FAIL=${TEST_CONFIG_SHOW_FAIL})

# The real ctr_cloud.c; only the transport (ctr_cloud_transfer_*) and the spool
# backend (ctr_cloud_spool_*) are mocked.
set(CLOUD_DIR ${CMAKE_CURRENT_SOURCE_DIR}/../../../subsys/ctr_cloud)
set(MOCK_DIR ${CMAKE_CURRENT_SOURCE_DIR}/../ctr_cloud/src)

include_directories(${CLOUD_DIR})
include_directories(${MOCK_DIR})
target_sources(app PRIVATE ${CLOUD_DIR}/ctr_cloud.c)
# Only ctr_cloud.c: MCUboot itself is mocked (src/mock_boot.c)
set_source_files_properties(${CLOUD_DIR}/ctr_cloud.c PROPERTIES COMPILE_DEFINITIONS
                            CONFIG_MCUBOOT_IMG_MANAGER=1)
target_sources(app PRIVATE ${CLOUD_DIR}/ctr_cloud_cbor.c)
target_sources(app PRIVATE ${CLOUD_DIR}/ctr_cloud_msg_data.c)
target_sources(app PRIVATE ${CLOUD_DIR}/ctr_cloud_msg.c)
target_sources(app PRIVATE ${CLOUD_DIR}/ctr_cloud_process.c)
target_sources(app PRIVATE ${CLOUD_DIR}/ctr_cloud_util.c)

target_sources(app PRIVATE ${MOCK_DIR}/mock.c)
target_sources(app PRIVATE ${MOCK_DIR}/mock_ctr_info.c)
target_sources(app PRIVATE ${MOCK_DIR}/mock_ctr_lte_v2.c)
target_sources(app PRIVATE ${MOCK_DIR}/mock_ctr_rtc.c)

target_sources(app PRIVATE src/common.c)
target_sources(app PRIVATE src/mock_boot.c)
target_sources(app PRIVATE src/mock_spool.c)
target_sources(app PRIVATE src/mock_transfer.c)

target_sources(app PRIVATE src/test_send_data.c)
target_sources(app PRIVATE src/test_send_data_cb.c)
target_sources(app PRIVATE src/test_firmware.c)
target_sources(app PRIVATE src/test_init.c)
```

## prj.conf
```kconfig
CONFIG_LOG=y

CONFIG_EVENTS=y

CONFIG_SHELL=y
CONFIG_SHELL_LOG_BACKEND=n
CONFIG_SHELL_BACKEND_SERIAL=n
CONFIG_SHELL_BACKEND_DUMMY=y
CONFIG_SHELL_CMD_BUFF_SIZE=90
CONFIG_SHELL_BACKEND_DUMMY_BUF_SIZE=4096

CONFIG_CTR_BUF=y
CONFIG_CTR_UTIL=y
CONFIG_CTR_CONFIG=y
CONFIG_CTR_CONFIG_FACTORY_RESET=n
CONFIG_BASE64=y

CONFIG_SETTINGS=y
CONFIG_SETTINGS_FILE=y

CONFIG_ZCBOR=y
CONFIG_ZCBOR_STOP_ON_ERROR=y
CONFIG_ZCBOR_VERBOSE=n

CONFIG_ZTEST=y

CONFIG_HEAP_MEM_POOL_SIZE=256
CONFIG_MAIN_STACK_SIZE=2048

CONFIG_REBOOT=y

# PSA crypto API (backend selection is per-board; see boards/*.conf)
CONFIG_PSA_WANT_ALG_SHA_256=y

CONFIG_ZTEST_STACK_SIZE=4096

CONFIG_THREAD_NAME=y
CONFIG_THREAD_MONITOR=y
```

## src/common.c
```c
/*
 * Copyright (c) 2026 HARDWARIO a.s.
 *
 * SPDX-License-Identifier: LicenseRef-HARDWARIO-5-Clause
 */

#include "common.h"
#include "mock.h"

/* CHESTER includes */
#include <chester/ctr_cloud.h>

/* Zephyr includes */
#include <zephyr/kernel.h>
#include <zephyr/ztest.h>

/* Standard includes */
#include <string.h>

#define HELPER_STACK_SIZE 4096
#define HELPER_PRIORITY   K_PRIO_PREEMPT(1)

const uint8_t PAYLOAD_A[5] = {0xbf, 0x01, 0x18, 0x2a, 0xff};
const uint8_t MSG_A[TEST_HDR_LEN + 5] = {0x06, 0x01, 0x02, 0x03, 0x04, 0x05, 0x06,
					 0x07, 0x08, 0xbf, 0x01, 0x18, 0x2a, 0xff};
const uint8_t PAYLOAD_B[3] = {0x82, 0x07, 0x08};
const uint8_t MSG_B[TEST_HDR_LEN + 3] = {0x06, 0x01, 0x02, 0x03, 0x04, 0x05,
					 0x06, 0x07, 0x08, 0x82, 0x07, 0x08};

#if TEST_INIT_RETRY
/* Uploaded by the init work */
static const uint8_t m_decoder[] = {'d', 'e', 'c'};
static const uint8_t m_encoder[] = {'e', 'n', 'c'};
#endif

/* Different hashes, so that a message with the wrong one is told apart */
static struct ctr_cloud_options m_options = {
	.decoder_hash = 0x0102030405060708ULL,
	.encoder_hash = 0x1112131415161718ULL,
#if TEST_INIT_RETRY
	.decoder_buf = m_decoder,
	.decoder_len = sizeof(m_decoder),
	.encoder_buf = m_encoder,
	.encoder_len = sizeof(m_encoder),
#endif
};

static K_THREAD_STACK_DEFINE(m_helper_stack, HELPER_STACK_SIZE);
static struct k_thread m_helper_thread;
static int (*m_helper_fn)(void *arg);
static void *m_helper_arg;
static int m_helper_ret;
static bool m_helper_running;

int common_init_start(void)
{
	static bool started;

	if (started) {
		return 0;
	}

	/* The shell must be up before the init work uploads the configuration */
	mock_global_setup_suite();

	started = true;

	return ctr_cloud_init(&m_options);
}

void *common_setup_initialized(void)
{
	zassert_ok(common_init_start());
	zassert_ok(ctr_cloud_wait_initialized(TEST_INIT_TIMEOUT));

	return NULL;
}

void common_before(void *fixture)
{
	ARG_UNUSED(fixture);

	mock_transfer_reset();
	mock_spool_reset();
}

uint32_t uplink_data_count(void)
{
	struct ctr_cloud_metrics metrics;

	zassert_ok(ctr_cloud_get_metrics(&metrics));

	return metrics.uplink_data_count;
}

void assert_uplink(int index, const uint8_t *msg, size_t len)
{
	const struct mock_uplink *u = mock_transfer_uplink(index);

	zassert_not_null(u, "no uplink %d", index);
	zassert_equal(u->len, len, "uplink %d length %zu", index, u->len);
	zassert_mem_equal(u->mem, msg, len, "uplink %d bytes", index);
}

void assert_no_transfer(void)
{
	zassert_equal(mock_transfer_uplink_count(), 0);
	zassert_equal(mock_transfer_downlink_count(), 0);
	zassert_equal(mock_spool_save_count(), 0);
	zassert_equal(mock_spool_stored(), 0);
}

void assert_timeout_left(const struct mock_uplink *u, uint32_t min_ms, uint32_t max_ms)
{
	zassert_false(K_TIMEOUT_EQ(u->timeout, K_FOREVER));
	zassert_true(u->timeout.ticks > (k_ticks_t)k_ms_to_ticks_floor64(min_ms),
		     "timeout %lld ticks too short", (long long)u->timeout.ticks);
	zassert_true(u->timeout.ticks <= (k_ticks_t)k_ms_to_ticks_ceil64(max_ms),
		     "timeout %lld ticks too long", (long long)u->timeout.ticks);
}

static void helper_entry(void *p1, void *p2, void *p3)
{
	m_helper_ret = m_helper_fn(m_helper_arg);
}

void helper_start(int (*fn)(void *arg), void *arg)
{
	m_helper_fn = fn;
	m_helper_arg = arg;
	m_helper_ret = INT32_MIN;
	m_helper_running = true;

	k_thread_create(&m_helper_thread, m_helper_stack, K_THREAD_STACK_SIZEOF(m_helper_stack),
			helper_entry, NULL, NULL, NULL, HELPER_PRIORITY, 0, K_NO_WAIT);
}

int helper_join(void)
{
	zassert_ok(k_thread_join(&m_helper_thread, K_SECONDS(10)), "helper thread stuck");
	m_helper_running = false;

	return m_helper_ret;
}

void common_after(void *fixture)
{
	ARG_UNUSED(fixture);

	if (!m_helper_running) {
		return;
	}

	/* A failed test left the helper behind: let it finish, so that later tests run */
	mock_transfer_release();
	if (k_thread_join(&m_helper_thread, K_SECONDS(2))) {
		k_thread_abort(&m_helper_thread);
	}
	m_helper_running = false;
}

void assert_spooled_once(const uint8_t *msg, size_t len, int deleted)
{
	if (!IS_ENABLED(CONFIG_CTR_CLOUD_SPOOL)) {
		zassert_equal(mock_spool_save_count(), 0);
		return;
	}

	size_t saved_len;
	const uint8_t *saved = mock_spool_last_saved(&saved_len);

	zassert_equal(mock_spool_save_count(), 1);
	zassert_equal(saved_len, len);
	zassert_mem_equal(saved, msg, len);
	zassert_equal(mock_spool_delete_count(), deleted);
}

void assert_one_data_uplink(const uint8_t *msg, size_t len, uint32_t base)
{
	zassert_equal(mock_transfer_uplink_count(), 1);
	assert_uplink(0, msg, len);
	zassert_true(K_TIMEOUT_EQ(mock_transfer_uplink(0)->timeout, K_FOREVER));
	zassert_equal(mock_transfer_downlink_count(), 0);
	zassert_equal(uplink_data_count(), base + 1);
}

int send_a_forever(void *arg)
{
	return ctr_cloud_send_data(PAYLOAD_A, sizeof(PAYLOAD_A), K_FOREVER);
}

void assert_deadline_after_lock_wait(int (*send_b)(void))
{
	mock_transfer_gate_next_uplink();
	helper_start(send_a_forever, NULL);
	zassert_ok(mock_transfer_wait_entered(K_SECONDS(5)));

	/* The other sender holds the lock for 300 ms of the 1000 ms deadline */
	mock_transfer_release_after(K_MSEC(300));

	zassert_ok(send_b());
	zassert_ok(helper_join());

	zassert_equal(mock_transfer_uplink_count(), 2);
	assert_uplink(0, MSG_A, sizeof(MSG_A));
	assert_uplink(1, MSG_B, sizeof(MSG_B));

	/* The transfer gets what is left of the deadline */
	assert_timeout_left(mock_transfer_uplink(1), 600, 700);
}

void run_error_kept_then_drained(send_fn send_a, send_fn send_b)
{
	uint32_t base = uplink_data_count();

	mock_transfer_fail_next_uplink(-EIO);

	zassert_equal(send_a(), -EIO);

	zassert_equal(mock_transfer_uplink_count(), 1);
	assert_uplink(0, MSG_A, sizeof(MSG_A));
	zassert_equal(uplink_data_count(), base);
	zassert_equal(mock_spool_stored(), IS_ENABLED(CONFIG_CTR_CLOUD_SPOOL) ? 1 : 0);
	assert_spooled_once(MSG_A, sizeof(MSG_A), 0);

	/* The lock is usable after the error */
	assert_lock_free();

	zassert_ok(send_b());

	/* Newest first, then the spooled one */
	assert_uplink(1, MSG_B, sizeof(MSG_B));

	if (IS_ENABLED(CONFIG_CTR_CLOUD_SPOOL)) {
		zassert_equal(mock_transfer_uplink_count(), 3);
		assert_uplink(2, MSG_A, sizeof(MSG_A));
		zassert_equal(mock_spool_load_count(), 1);
		zassert_equal(uplink_data_count(), base + 2);
	} else {
		zassert_equal(mock_transfer_uplink_count(), 2);
		zassert_equal(uplink_data_count(), base + 1);
	}
	zassert_equal(mock_spool_stored(), 0);
}

static int downlink_no_wait(void *arg)
{
	return ctr_cloud_downlink(K_NO_WAIT);
}

void assert_lock_free(void)
{
	helper_start(downlink_no_wait, NULL);
	zassert_ok(helper_join(), "cloud lock not free for another thread");
}
```

## src/common.h
```c
/*
 * Copyright (c) 2026 HARDWARIO a.s.
 *
 * SPDX-License-Identifier: LicenseRef-HARDWARIO-5-Clause
 */

#ifndef TESTS_SUBSYS_CTR_CLOUD_SEND_SRC_COMMON_H_
#define TESTS_SUBSYS_CTR_CLOUD_SEND_SRC_COMMON_H_

#include "ctr_cloud_spool.h"

/* Zephyr includes */
#include <zephyr/kernel.h>

/* Standard includes */
#include <stdbool.h>
#include <stddef.h>
#include <stdint.h>

#define TEST_BUF_SIZE CONFIG_CTR_CLOUD_TRANSFER_BUF_SIZE
#define TEST_HDR_LEN  9

/* {1: 42} exactly as zcbor encodes it (indefinite-length map) */
extern const uint8_t PAYLOAD_A[5];
extern const uint8_t MSG_A[TEST_HDR_LEN + 5];
/* [7, 8]; differs from PAYLOAD_A already in the first byte */
extern const uint8_t PAYLOAD_B[3];
extern const uint8_t MSG_B[TEST_HDR_LEN + 3];

/* ---- Mock transport (ctr_cloud_transfer_*) ---- */

#define MOCK_UPLINK_MAX     8
#define MOCK_UPLINK_MEM_MAX 32

struct mock_uplink {
	size_t len;
	uint8_t mem[MOCK_UPLINK_MEM_MAX];
	k_timeout_t timeout;
	int ret;
};

void mock_transfer_reset(void);
void mock_transfer_set_init_ret(int ret);
/* Next uplink is recorded and then fails with `err` */
void mock_transfer_fail_next_uplink(int err);
/* Next uplink gives `entered` and waits for mock_transfer_release() */
void mock_transfer_gate_next_uplink(void);
int mock_transfer_wait_entered(k_timeout_t timeout);
void mock_transfer_release(void);
/* Release the gated uplink from a timer after `delay` */
void mock_transfer_release_after(k_timeout_t delay);
int mock_transfer_uplink_count(void);
const struct mock_uplink *mock_transfer_uplink(int index);
int mock_transfer_downlink_count(void);

/* Every uplink since the start, also the session request of the init work; unlike the
 * above, not cleared by mock_transfer_reset()
 */
#define MOCK_LOG_MAX     32
#define MOCK_LOG_MEM_MAX 64

struct mock_log_entry {
	size_t len;
	uint8_t mem[MOCK_LOG_MEM_MAX];
	int ret;
	/* Uptime of the call in ms */
	int64_t at;
};

int mock_transfer_log_count(void);
const struct mock_log_entry *mock_transfer_log(int index);
/* Index of the first logged uplink of message `type`, or -1 */
int mock_transfer_log_find(uint8_t type);
/* The first `count` uplinks of message `type` fail with `err`; not cleared by
 * mock_transfer_reset()
 */
void mock_transfer_fail_first_of_type(uint8_t type, int err, int count);
/* The first session response comes without an id; not cleared by mock_transfer_reset() */
void mock_transfer_session_without_id_first(void);

/* ---- Mock MCUboot image state and the firmware update scenario (TEST_FW) ---- */

/* TEST_FW 0: no update id stored, 1: id stored and acked, 2: id stored, the first ack fails,
 * 3: id stored, but the image is confirmed (MCUboot reverted the update), 4: id stored, but the
 * image cannot be confirmed
 */
extern const uint8_t TEST_FW_UPDATE_ID[16];

/* Before ctr_cloud_init(): an unconfirmed image and the update id of TEST_FW */
void mock_fw_setup(void);
int mock_boot_confirm_calls(void);

/* ---- Mock spool backend (ctr_cloud_spool_*) ---- */

void mock_spool_reset(void);
void mock_spool_fail_next_save(int err);
void mock_spool_fail_next_delete(int err);
int mock_spool_save_count(void);
int mock_spool_delete_count(void);
int mock_spool_load_count(void);
/* Bytes of the most recent successful save */
const uint8_t *mock_spool_last_saved(size_t *len);
/* Number of stored messages */
int mock_spool_stored(void);

/* ---- Helpers ---- */

/* For the init work, which pauses 10 s between the failed attempts of a step (TEST_INIT_RETRY,
 * TEST_FW 2)
 */
#define TEST_INIT_TIMEOUT K_SECONDS(60)

/* Call ctr_cloud_init() once with the test options; later calls return 0 */
int common_init_start(void);
/* common_init_start() and wait for the session (over the mock transport) */
void *common_setup_initialized(void);
/* Reset the mocks */
void common_before(void *fixture);

uint32_t uplink_data_count(void);

/* Assert that uplink `index` carried exactly `msg` */
void assert_uplink(int index, const uint8_t *msg, size_t len);
/* Assert that the uplink got a timeout in (min_ms, max_ms] */
void assert_timeout_left(const struct mock_uplink *u, uint32_t min_ms, uint32_t max_ms);
/* Assert that nothing was sent, saved or downlinked since common_before() */
void assert_no_transfer(void);

/* Run `fn(arg)` in the helper thread (one at a time) */
void helper_start(int (*fn)(void *arg), void *arg);
/* Join the helper thread and return the value of its function */
int helper_join(void);
/* After each test: clean up a helper thread a failed test left behind */
void common_after(void *fixture);

/* Assert that the message went through the spool (when enabled) as exactly one save of
 * `msg`, with `deleted` deletes; without the spool, that it was never saved */
void assert_spooled_once(const uint8_t *msg, size_t len, int deleted);
/* Assert one uplink of `msg` with K_FOREVER, no downlink, uplink_data_count() == base + 1 */
void assert_one_data_uplink(const uint8_t *msg, size_t len, uint32_t base);

/* ctr_cloud_send_data(PAYLOAD_A, K_FOREVER): the "other sender" of the helper thread */
int send_a_forever(void *arg);

/* A sender under test: ctr_cloud_send_data*() of PAYLOAD_A / PAYLOAD_B, K_FOREVER */
typedef int (*send_fn)(void);

/* Another sender holds the lock for 300 ms of the 1000 ms deadline of `send_b`; assert
 * that both messages are sent and the transfer of `send_b` gets what is left (600-700 ms) */
void assert_deadline_after_lock_wait(int (*send_b)(void));
/* The first send fails (-EIO) and stays spooled (when enabled); the next one sends the
 * newest first and then drains the spool */
void run_error_kept_then_drained(send_fn send_a, send_fn send_b);

/* Assert that another thread can take the cloud lock with K_NO_WAIT (counts a downlink) */
void assert_lock_free(void);

#endif /* TESTS_SUBSYS_CTR_CLOUD_SEND_SRC_COMMON_H_ */
```

## src/mock_boot.c
```c
/*
 * Copyright (c) 2026 HARDWARIO a.s.
 *
 * SPDX-License-Identifier: LicenseRef-HARDWARIO-5-Clause
 */

/*
 * Mock MCUboot image state for the firmware confirmation of ctr_cloud.c (compiled with
 * CONFIG_MCUBOOT_IMG_MANAGER) and the firmware update scenario selected by TEST_FW.
 */

#include "common.h"
#include "ctr_cloud_msg.h"
#include "ctr_cloud_util.h"

/* Zephyr includes */
#include <zephyr/dfu/mcuboot.h>
#include <zephyr/settings/settings.h>
#include <zephyr/ztest.h>

/* Standard includes */
#include <errno.h>
#include <stdbool.h>

const uint8_t TEST_FW_UPDATE_ID[16] = {0xf0, 0xe1, 0xd2, 0xc3, 0xb4, 0xa5, 0x96, 0x87,
				       0x78, 0x69, 0x5a, 0x4b, 0x3c, 0x2d, 0x1e, 0x0f};

static bool m_confirmed = true;
static int m_confirm_calls;

bool boot_is_img_confirmed(void)
{
	return m_confirmed;
}

int boot_write_img_confirmed(void)
{
	m_confirm_calls++;

#if TEST_FW == 4
	/* The flash write fails */
	return -EIO;
#else
	m_confirmed = true;

	return 0;
#endif
}

int mock_boot_confirm_calls(void)
{
	return m_confirm_calls;
}

void mock_fw_setup(void)
{
	zassert_ok(settings_subsys_init());

	/* The flash simulator keeps its content from a previous run */
	zassert_ok(ctr_cloud_util_delete_firmware_update_id());

#if TEST_FW == 3
	/* MCUboot reverted the update: the old image runs, confirmed */
	m_confirmed = true;
#else
	/* Just swapped in by MCUboot and not confirmed yet */
	m_confirmed = false;
#endif

#if TEST_FW >= 1
	zassert_ok(ctr_cloud_util_save_firmware_update_id(TEST_FW_UPDATE_ID));
#endif

#if TEST_FW == 2
	mock_transfer_fail_first_of_type(UL_UPLOAD_FIRMWARE, -EIO, 1);
#endif
}
```

## src/mock_spool.c
```c
/*
 * Copyright (c) 2026 HARDWARIO a.s.
 *
 * SPDX-License-Identifier: LicenseRef-HARDWARIO-5-Clause
 */

/*
 * Mock spool backend in RAM, with the semantics of ctr_cloud_spool.h (oldest first,
 * load appends, ids never reused) plus counters and error injection.
 */

#include "common.h"
#include "ctr_cloud_spool.h"

/* CHESTER includes */
#include <chester/ctr_buf.h>

/* Standard includes */
#include <errno.h>
#include <stdbool.h>
#include <string.h>

#define SLOTS     8
#define SLOT_SIZE 64

struct slot {
	bool used;
	ctr_cloud_spool_id id;
	size_t len;
	uint8_t mem[SLOT_SIZE];
};

static struct slot m_slots[SLOTS];
static ctr_cloud_spool_id m_next_id = 1;
static int m_save_count;
static int m_delete_count;
static int m_load_count;
static int m_fail_next_save;
static int m_fail_next_delete;
static uint8_t m_last_saved[SLOT_SIZE];
static size_t m_last_saved_len;

void mock_spool_reset(void)
{
	memset(m_slots, 0, sizeof(m_slots));
	m_save_count = 0;
	m_delete_count = 0;
	m_load_count = 0;
	m_fail_next_save = 0;
	m_fail_next_delete = 0;
	m_last_saved_len = 0;
}

void mock_spool_fail_next_save(int err)
{
	m_fail_next_save = err;
}

void mock_spool_fail_next_delete(int err)
{
	m_fail_next_delete = err;
}

int mock_spool_save_count(void)
{
	return m_save_count;
}

int mock_spool_delete_count(void)
{
	return m_delete_count;
}

int mock_spool_load_count(void)
{
	return m_load_count;
}

const uint8_t *mock_spool_last_saved(size_t *len)
{
	*len = m_last_saved_len;

	return m_last_saved;
}

int mock_spool_stored(void)
{
	int count = 0;

	for (int i = 0; i < SLOTS; i++) {
		count += m_slots[i].used;
	}

	return count;
}

static struct slot *find(ctr_cloud_spool_id id)
{
	for (int i = 0; i < SLOTS; i++) {
		if (m_slots[i].used && m_slots[i].id == id) {
			return &m_slots[i];
		}
	}

	return NULL;
}

static struct slot *oldest(void)
{
	struct slot *found = NULL;

	for (int i = 0; i < SLOTS; i++) {
		if (m_slots[i].used && (!found || m_slots[i].id < found->id)) {
			found = &m_slots[i];
		}
	}

	return found;
}

int ctr_cloud_spool_save(const void *buf, size_t len, ctr_cloud_spool_id *id)
{
	if (m_fail_next_save) {
		int err = m_fail_next_save;

		m_fail_next_save = 0;
		return err;
	}

	if (!len || len > SLOT_SIZE) {
		return -EFBIG;
	}

	struct slot *s = NULL;

	for (int i = 0; i < SLOTS; i++) {
		if (!m_slots[i].used) {
			s = &m_slots[i];
			break;
		}
	}

	if (!s) {
		/* Full - drop the oldest message */
		s = oldest();
	}

	s->used = true;
	s->id = m_next_id++;
	s->len = len;
	memcpy(s->mem, buf, len);

	memcpy(m_last_saved, buf, len);
	m_last_saved_len = len;
	m_save_count++;

	if (id) {
		*id = s->id;
	}

	return 0;
}

int ctr_cloud_spool_peek(ctr_cloud_spool_id *id)
{
	struct slot *s = oldest();

	if (!s) {
		return 1;
	}

	*id = s->id;

	return 0;
}

int ctr_cloud_spool_load(ctr_cloud_spool_id id, struct ctr_buf *buf)
{
	struct slot *s = find(id);

	if (!s) {
		return -ENOENT;
	}

	m_load_count++;

	return ctr_buf_append_mem(buf, s->mem, s->len) ? -EFBIG : 0;
}

int ctr_cloud_spool_delete(ctr_cloud_spool_id id)
{
	if (m_fail_next_delete) {
		int err = m_fail_next_delete;

		m_fail_next_delete = 0;
		return err;
	}

	struct slot *s = find(id);

	if (!s) {
		return -ENOENT;
	}

	s->used = false;
	m_delete_count++;

	return 0;
}

int ctr_cloud_spool_count(int *count)
{
	*count = mock_spool_stored();

	return 0;
}

int ctr_cloud_spool_clear(void)
{
	memset(m_slots, 0, sizeof(m_slots));

	return 0;
}
```

## src/mock_transfer.c
```c
/*
 * Copyright (c) 2026 HARDWARIO a.s.
 *
 * SPDX-License-Identifier: LicenseRef-HARDWARIO-5-Clause
 */

/*
 * Mock transport: records every uplink (the exact bytes of m_transfer_buf handed over by
 * ctr_cloud.c) and answers the session request, so that ctr_cloud_init() completes.
 */

#include "common.h"
#include "ctr_cloud_msg.h"
#include "ctr_cloud_transfer.h"

/* CHESTER includes */
#include <chester/ctr_buf.h>

/* Zephyr includes */
#include <zephyr/kernel.h>
#include <zephyr/sys/util.h>

/* Standard includes */
#include <errno.h>
#include <string.h>

/* DL_SET_SESSION: id 0x64ba538f, timestamp 0x64ba538e, device id and name
 * (payload of the "download session" packet in ../ctr_cloud/src/test_cloud.c) */
static const uint8_t m_session_msg[] = {
	0x80, 0xa4, 0x00, 0x1a, 0x64, 0xba, 0x53, 0x8f, 0x04, 0x1a, 0x64, 0xba, 0x53, 0x8e, 0x05,
	0x78, 0x24, '0',  '1',  '8',  '8',  'd',  '8',  '5',  'c',  '-',  '8',  '9',  '6',  '2',
	'-',  '7',  '8',  '6',  'f',  '-',  'c',  '9',  '8',  '5',  '-',  'a',  '6',  '7',  'f',
	'e',  'e',  '7',  'b',  'b',  '1',  '4',  '4',  0x06, 0x72, 't',  'e',  's',  't',  '-',
	'd',  'e',  'v',  'i',  'c',  'e',  '-',  's',  '0',  '-',  '9',  '8',  '5',
};

static int m_init_ret;
static bool m_session_pending;

static int m_uplink_count;
static struct mock_uplink m_uplinks[MOCK_UPLINK_MAX];
static int m_fail_next_uplink;
static bool m_gate;
static int m_downlink_count;

static int m_log_count;
static struct mock_log_entry m_log[MOCK_LOG_MAX];
/* Error of the first uplinks of each message type (UL_*), and how many of them fail */
static int m_fail_type_err[UL_UPLOAD_FIRMWARE + 1];
static int m_fail_type_count[UL_UPLOAD_FIRMWARE + 1];
static bool m_session_without_id;

static K_SEM_DEFINE(m_entered, 0, 1);
static K_SEM_DEFINE(m_release, 0, 1);

static void release_timer_handler(struct k_timer *timer)
{
	k_sem_give(&m_release);
}

static K_TIMER_DEFINE(m_release_timer, release_timer_handler, NULL);

void mock_transfer_reset(void)
{
	m_uplink_count = 0;
	memset(m_uplinks, 0, sizeof(m_uplinks));
	m_fail_next_uplink = 0;
	m_gate = false;
	m_downlink_count = 0;
	k_timer_stop(&m_release_timer);
	k_sem_reset(&m_entered);
	k_sem_reset(&m_release);
}

void mock_transfer_set_init_ret(int ret)
{
	m_init_ret = ret;
}

void mock_transfer_fail_next_uplink(int err)
{
	m_fail_next_uplink = err;
}

void mock_transfer_gate_next_uplink(void)
{
	m_gate = true;
}

int mock_transfer_wait_entered(k_timeout_t timeout)
{
	return k_sem_take(&m_entered, timeout);
}

void mock_transfer_release(void)
{
	k_sem_give(&m_release);
}

void mock_transfer_release_after(k_timeout_t delay)
{
	k_timer_start(&m_release_timer, delay, K_NO_WAIT);
}

int mock_transfer_uplink_count(void)
{
	return m_uplink_count;
}

const struct mock_uplink *mock_transfer_uplink(int index)
{
	if (index < 0 || index >= MIN(m_uplink_count, MOCK_UPLINK_MAX)) {
		return NULL;
	}

	return &m_uplinks[index];
}

int mock_transfer_downlink_count(void)
{
	return m_downlink_count;
}

int mock_transfer_log_count(void)
{
	return m_log_count;
}

const struct mock_log_entry *mock_transfer_log(int index)
{
	if (index < 0 || index >= MIN(m_log_count, MOCK_LOG_MAX)) {
		return NULL;
	}

	return &m_log[index];
}

int mock_transfer_log_find(uint8_t type)
{
	for (int i = 0; i < MIN(m_log_count, MOCK_LOG_MAX); i++) {
		if (m_log[i].len && m_log[i].mem[0] == type) {
			return i;
		}
	}

	return -1;
}

void mock_transfer_fail_first_of_type(uint8_t type, int err, int count)
{
	__ASSERT_NO_MSG(type < ARRAY_SIZE(m_fail_type_err));

	m_fail_type_err[type] = err;
	m_fail_type_count[type] = count;
}

void mock_transfer_session_without_id_first(void)
{
	m_session_without_id = true;
}

int ctr_cloud_transfer_init(uint32_t serial_number, uint8_t token[16], ctr_cloud_transfer_cb cb)
{
	return m_init_ret;
}

int ctr_cloud_transfer_wait_for_ready(k_timeout_t timeout)
{
	return 0;
}

int ctr_cloud_transfer_uplink(struct ctr_buf *buf, bool *has_downlink, k_timeout_t timeout)
{
	const uint8_t *mem = ctr_buf_get_mem(buf);
	size_t len = ctr_buf_get_used(buf);
	int ret = 0;

	if (m_gate) {
		m_gate = false;
		k_sem_give(&m_entered);
		k_sem_take(&m_release, K_FOREVER);
	}

	struct mock_log_entry *e = NULL;

	if (m_log_count < MOCK_LOG_MAX) {
		e = &m_log[m_log_count];
		e->len = len;
		memcpy(e->mem, mem, MIN(len, sizeof(e->mem)));
		e->at = k_uptime_get();
	}

	m_log_count++;

	if (len && mem[0] == UL_CREATE_SESSION) {
		m_session_pending = true;
		*has_downlink = true;
		return 0;
	}

	if (m_fail_next_uplink) {
		ret = m_fail_next_uplink;
		m_fail_next_uplink = 0;
	}

	if (len && mem[0] < ARRAY_SIZE(m_fail_type_count) && m_fail_type_count[mem[0]]) {
		ret = m_fail_type_err[mem[0]];
		m_fail_type_count[mem[0]]--;
	}

	if (e) {
		e->ret = ret;
	}

	if (m_uplink_count < MOCK_UPLINK_MAX) {
		struct mock_uplink *u = &m_uplinks[m_uplink_count];

		u->len = len;
		memcpy(u->mem, mem, MIN(len, sizeof(u->mem)));
		u->timeout = timeout;
		u->ret = ret;
	}

	m_uplink_count++;

	return ret;
}

int ctr_cloud_transfer_downlink(struct ctr_buf *buf, bool *has_downlink, k_timeout_t timeout)
{
	*has_downlink = false;

	if (m_session_pending) {
		m_session_pending = false;

		if (m_session_without_id) {
			m_session_without_id = false;

			/* The map with one pair less: without the id (key 0) */
			const uint8_t head[] = {m_session_msg[0], 0xa3};
			int ret = ctr_buf_append_mem(buf, head, sizeof(head));

			if (ret) {
				return ret;
			}

			return ctr_buf_append_mem(buf, &m_session_msg[8],
						  sizeof(m_session_msg) - 8);
		}

		return ctr_buf_append_mem(buf, m_session_msg, sizeof(m_session_msg));
	}

	m_downlink_count++;

	return 0;
}
```

## src/test_firmware.c
```c
/*
 * Copyright (c) 2026 HARDWARIO a.s.
 *
 * SPDX-License-Identifier: LicenseRef-HARDWARIO-5-Clause
 */

/*
 * The confirmation of the running image and the ack of a firmware update done by the init
 * work (scenario TEST_FW, see mock_fw_setup()), and the stored update id.
 */

#include "common.h"
#include "ctr_cloud_msg.h"
#include "ctr_cloud_util.h"

/* Zephyr includes */
#include <zephyr/kernel.h>
#include <zephyr/settings/settings.h>
#include <zephyr/ztest.h>

/* Standard includes */
#include <errno.h>
#include <stdbool.h>
#include <string.h>

ZTEST_SUITE(ctr_cloud_send_3_fw, NULL, common_setup_initialized, common_before, common_after, NULL);

#if TEST_FW == 1 || TEST_FW == 2
static bool contains(const uint8_t *mem, size_t len, const uint8_t *what, size_t what_len)
{
	for (size_t i = 0; i + what_len <= len; i++) {
		if (!memcmp(&mem[i], what, what_len)) {
			return true;
		}
	}

	return false;
}
#endif

ZTEST(ctr_cloud_send_3_fw, test_firmware_update_ack)
{
	uint8_t id[16];
	int session = mock_transfer_log_find(UL_CREATE_SESSION);
	int ack = mock_transfer_log_find(UL_UPLOAD_FIRMWARE);
	int config = mock_transfer_log_find(UL_UPLOAD_CONFIG);

	zassert_true(session >= 0);
#if TEST_CONFIG_SHOW_FAIL
	/* The config cannot be packed, so it is not uploaded */
	zassert_equal(config, -1, "config at %d", config);
#else
	zassert_true(config > session);
#endif

#if TEST_FW == 0
	/* No update id stored (an update over BLE, or the id got lost): the image is confirmed,
	 * but there is nothing to ack (no ack with an uninitialized id)
	 */
	zassert_equal(ack, -1, "ack at %d", ack);
	zassert_equal(mock_boot_confirm_calls(), 1);
	zassert_equal(ctr_cloud_util_get_firmware_update_id(id), -ENOENT);
#elif TEST_FW == 3
	/* An update id stored, but the image was confirmed before (MCUboot reverted the
	 * update): no ack, and the id is dropped
	 */
	zassert_equal(ack, -1, "ack at %d", ack);
	zassert_equal(mock_boot_confirm_calls(), 0);
	zassert_equal(ctr_cloud_util_get_firmware_update_id(id), -ENOENT);
#elif TEST_FW == 4
	/* The image cannot be confirmed, so MCUboot reverts it at the next reset: no ack, but
	 * the init goes on (the config above), and the id stays for the old image to drop
	 */
	zassert_equal(ack, -1, "ack at %d", ack);
	zassert_equal(mock_boot_confirm_calls(), 1);
	zassert_ok(ctr_cloud_util_get_firmware_update_id(id));
#else
	/* Confirmed and acked right after the session, before the uploads */
	zassert_equal(ack, session + 1, "ack at %d, session at %d", ack, session);
	zassert_equal(mock_boot_confirm_calls(), 1);

	const struct mock_log_entry *e = mock_transfer_log(ack);

	zassert_true(contains(e->mem, MIN(e->len, sizeof(e->mem)), TEST_FW_UPDATE_ID,
			      sizeof(TEST_FW_UPDATE_ID)),
		     "ack without the stored update id");

#if TEST_FW == 2
	/* The first ack fails and goes again 10 s later, in the same boot: that the image is
	 * confirmed by then must not drop the id
	 */
	zassert_equal(e->ret, -EIO);

	const struct mock_log_entry *again = mock_transfer_log(ack + 1);
	int64_t after_ms = again->at - e->at;

	zassert_equal(again->mem[0], UL_UPLOAD_FIRMWARE,
		      "uplink after the failed ack of type 0x%02x", again->mem[0]);
	zassert_true(contains(again->mem, MIN(again->len, sizeof(again->mem)), TEST_FW_UPDATE_ID,
			      sizeof(TEST_FW_UPDATE_ID)),
		     "ack again without the stored update id");
	zassert_within(after_ms, 10010, 10, "ack again %lld ms after the failed one", after_ms);

	e = again;
#endif

	zassert_equal(e->ret, 0);
	/* Acked: the id is dropped */
	zassert_equal(ctr_cloud_util_get_firmware_update_id(id), -ENOENT);
#endif
}

ZTEST(ctr_cloud_send_3_fw, test_update_id_wrong_length)
{
	static const uint8_t short_id[8] = {1, 2, 3, 4, 5, 6, 7, 8};
	uint8_t id[16];

	/* Would leave half of the id uninitialized */
	zassert_ok(settings_save_one("cloud/firmware/update_id", short_id, sizeof(short_id)));
	zassert_equal(ctr_cloud_util_get_firmware_update_id(id), -ENOENT);

	zassert_ok(ctr_cloud_util_delete_firmware_update_id());
}
```

## src/test_init.c
```c
/*
 * Copyright (c) 2026 HARDWARIO a.s.
 *
 * SPDX-License-Identifier: LicenseRef-HARDWARIO-5-Clause
 */

/*
 * ctr_cloud_init() and the API before it.
 */

#include "common.h"
#include "ctr_cloud_msg.h"

/* CHESTER includes */
#include <chester/ctr_cloud.h>

/* Zephyr includes */
#include <zephyr/kernel.h>
#include <zephyr/ztest.h>

/* Standard includes */
#include <errno.h>
#include <string.h>

/* ---- Before a successful ctr_cloud_init() (suite ctr_cloud_send_0_init) ---- */

static void assert_api_eperm(void)
{
	zassert_equal(ctr_cloud_send_data(PAYLOAD_A, sizeof(PAYLOAD_A), K_FOREVER), -EPERM);
	zassert_equal(ctr_cloud_send(PAYLOAD_A, sizeof(PAYLOAD_A)), -EPERM);
	zassert_equal(ctr_cloud_downlink(K_FOREVER), -EPERM);
	zassert_equal(ctr_cloud_poll_immediately(), -EPERM);
	zassert_equal(ctr_cloud_firmware_update("fw"), -EPERM);

	assert_no_transfer();
	zassert_equal(mock_transfer_downlink_count(), 0);
}

ZTEST(ctr_cloud_send_0_init, test_1_api_eperm_before_init)
{
	/* No ctr_cloud_init() at all yet: no options, transfer layer or work queue */
	assert_api_eperm();
}

/* Runs after test_2_cb_eperm_after_failed_init */
ZTEST(ctr_cloud_send_0_init, test_2_data_eperm_after_failed_init)
{
	assert_api_eperm();
}

/* ---- After ctr_cloud_init() ---- */

ZTEST_SUITE(ctr_cloud_send_4_init, NULL, common_setup_initialized, common_before, common_after,
	    NULL);

ZTEST(ctr_cloud_send_4_init, test_init_again_ealready)
{
	static struct ctr_cloud_options options = {
		.decoder_hash = 0xdeaddeaddeaddeadULL,
	};

	zassert_equal(ctr_cloud_init(&options), -EALREADY);

	/* Still the options of the first init: MSG_A carries their decoder hash */
	zassert_ok(ctr_cloud_send_data(PAYLOAD_A, sizeof(PAYLOAD_A), K_FOREVER));
	assert_uplink(0, MSG_A, sizeof(MSG_A));
}

static void match_thread_name(const struct k_thread *thread, void *user_data)
{
	const char *name = k_thread_name_get((k_tid_t)thread);
	bool *found = user_data;

	if (name && !strcmp(name, "ctr_cloud")) {
		*found = true;
	}
}

#if TEST_INIT_RETRY
/* A failed step is run again 10 s later, one that requires a session starts over from CREATE
 * SESSION at once
 */
ZTEST(ctr_cloud_send_4_init, test_init_steps_retried)
{
	/* clang-format off */
	static const struct {
		uint8_t type;
		int ret;
		/* Since the previous uplink */
		int64_t after_ms;
	} expected[] = {
		/* Without an id: the ack goes, then the decoder requires a session */
		{UL_CREATE_SESSION, 0, 0},
		{UL_UPLOAD_FIRMWARE, 0, 0},
		{UL_CREATE_SESSION, 0, 0},
		/* A failed step runs again, without a new session */
		{UL_UPLOAD_DECODER, -EIO, 0},
		{UL_UPLOAD_DECODER, 0, 10000},
		{UL_UPLOAD_ENCODER, 0, 0},
		/* Also the config, which used to be given up after a failed upload */
		{UL_UPLOAD_CONFIG, -EIO, 0},
		{UL_UPLOAD_CONFIG, -EIO, 10000},
		{UL_UPLOAD_CONFIG, 0, 10000},
	};
	/* clang-format on */

	zassert_true(mock_transfer_log_count() >= ARRAY_SIZE(expected), "%d uplinks",
		     mock_transfer_log_count());

	for (size_t i = 0; i < ARRAY_SIZE(expected); i++) {
		const struct mock_log_entry *e = mock_transfer_log(i);

		zassert_equal(e->mem[0], expected[i].type,
			      "uplink %zu of type 0x%02x, expected 0x%02x", i, e->mem[0],
			      expected[i].type);
		zassert_equal(e->ret, expected[i].ret, "uplink %zu failed with %d, expected %d", i,
			      e->ret, expected[i].ret);

		if (i > 0) {
			int64_t after_ms = e->at - mock_transfer_log(i - 1)->at;

			/* A sleep may end a tick late */
			zassert_within(after_ms, expected[i].after_ms + 10, 10,
				       "uplink %zu %lld ms after the previous one, expected %lld",
				       i, after_ms, expected[i].after_ms);
		}
	}
}
#endif

#if TEST_CONFIG_SHOW_FAIL
/* A config that cannot be packed is not retried: the init goes on without it, and data go
 * out
 */
ZTEST(ctr_cloud_send_4_init, test_init_config_show_fail)
{
	/* Initialized: the suite setup waited for it */
	zassert_equal(mock_transfer_log_find(UL_UPLOAD_CONFIG), -1);

	zassert_ok(ctr_cloud_send_data(PAYLOAD_A, sizeof(PAYLOAD_A), K_FOREVER));
	assert_uplink(0, MSG_A, sizeof(MSG_A));
}
#endif

ZTEST(ctr_cloud_send_4_init, test_work_queue_thread_name)
{
	bool found = false;

	k_thread_foreach(match_thread_name, &found);
	zassert_true(found, "no thread named ctr_cloud");
}
```

## src/test_send_data.c
```c
/*
 * Copyright (c) 2026 HARDWARIO a.s.
 *
 * SPDX-License-Identifier: LicenseRef-HARDWARIO-5-Clause
 */

/*
 * Characterization of the buffer API (ctr_cloud_send_data(), ctr_cloud_send()) through
 * the real ctr_cloud.c: message bytes, spool, metrics, deadline and return codes. Uses
 * only the API that existed before ctr_cloud_send_data_cb(), so it runs unchanged
 * against the previous ctr_cloud.c as well.
 */

#include "common.h"

/* CHESTER includes */
#include <chester/ctr_cloud.h>

/* Zephyr includes */
#include <zephyr/kernel.h>
#include <zephyr/ztest.h>

/* Standard includes */
#include <errno.h>
#include <string.h>

ZTEST_SUITE(ctr_cloud_send_1_data, NULL, common_setup_initialized, common_before, common_after,
	    NULL);

ZTEST(ctr_cloud_send_1_data, test_einval)
{
	zassert_equal(ctr_cloud_send_data(NULL, 4, K_FOREVER), -EINVAL);
	zassert_equal(ctr_cloud_send_data(PAYLOAD_A, 0, K_FOREVER), -EINVAL);
	zassert_equal(ctr_cloud_send(NULL, 4), -EINVAL);
	zassert_equal(ctr_cloud_send(PAYLOAD_A, 0), -EINVAL);

	assert_no_transfer();
}

ZTEST(ctr_cloud_send_1_data, test_msg)
{
	uint32_t base = uplink_data_count();

	zassert_ok(ctr_cloud_send_data(PAYLOAD_A, sizeof(PAYLOAD_A), K_FOREVER));

	assert_one_data_uplink(MSG_A, sizeof(MSG_A), base);
	assert_spooled_once(MSG_A, sizeof(MSG_A), 1);
	zassert_equal(mock_spool_stored(), 0);

	/* ctr_cloud_send() is the same with K_FOREVER */
	zassert_ok(ctr_cloud_send(PAYLOAD_B, sizeof(PAYLOAD_B)));

	zassert_equal(mock_transfer_uplink_count(), 2);
	assert_uplink(1, MSG_B, sizeof(MSG_B));
	zassert_true(K_TIMEOUT_EQ(mock_transfer_uplink(1)->timeout, K_FOREVER));
	zassert_equal(uplink_data_count(), base + 2);
}

static int send_a(void)
{
	return ctr_cloud_send_data(PAYLOAD_A, sizeof(PAYLOAD_A), K_FOREVER);
}

static int send_b(void)
{
	return ctr_cloud_send_data(PAYLOAD_B, sizeof(PAYLOAD_B), K_FOREVER);
}

static int send_b_deadline(void)
{
	return ctr_cloud_send_data(PAYLOAD_B, sizeof(PAYLOAD_B), K_MSEC(1000));
}

ZTEST(ctr_cloud_send_1_data, test_error_kept_then_drained)
{
	run_error_kept_then_drained(send_a, send_b);
}

ZTEST(ctr_cloud_send_1_data, test_spool_save_error_still_sends)
{
	if (!IS_ENABLED(CONFIG_CTR_CLOUD_SPOOL)) {
		ztest_test_skip();
	}

	uint32_t base = uplink_data_count();

	mock_spool_fail_next_save(-EIO);

	zassert_ok(ctr_cloud_send_data(PAYLOAD_A, sizeof(PAYLOAD_A), K_FOREVER));

	zassert_equal(mock_transfer_uplink_count(), 1);
	assert_uplink(0, MSG_A, sizeof(MSG_A));
	zassert_equal(mock_spool_save_count(), 0);
	zassert_equal(mock_spool_delete_count(), 0);
	zassert_equal(uplink_data_count(), base + 1);
}

ZTEST(ctr_cloud_send_1_data, test_spool_delete_error_no_drain)
{
	if (!IS_ENABLED(CONFIG_CTR_CLOUD_SPOOL)) {
		ztest_test_skip();
	}

	uint32_t base = uplink_data_count();

	/* An older unsent message waits in the spool */
	zassert_ok(ctr_cloud_spool_save(MSG_B, sizeof(MSG_B), NULL));

	mock_spool_fail_next_delete(-EIO);

	/* Sent, so 0 even though the delete failed; the spool is not drained */
	zassert_ok(ctr_cloud_send_data(PAYLOAD_A, sizeof(PAYLOAD_A), K_FOREVER));

	zassert_equal(mock_transfer_uplink_count(), 1);
	assert_uplink(0, MSG_A, sizeof(MSG_A));
	zassert_equal(mock_spool_load_count(), 0);
	zassert_equal(mock_spool_stored(), 2);
	zassert_equal(uplink_data_count(), base + 1);
}

ZTEST(ctr_cloud_send_1_data, test_enospc)
{
	static uint8_t big[TEST_BUF_SIZE - TEST_HDR_LEN + 1];
	uint32_t base = uplink_data_count();

	memset(big, 0x5a, sizeof(big));

	zassert_equal(ctr_cloud_send_data(big, sizeof(big), K_FOREVER), -ENOSPC);

	assert_no_transfer();
	zassert_equal(uplink_data_count(), base);

	/* The lock is usable after the error */
	assert_lock_free();

	/* Exactly full transfer buffer is fine (too big for the mock spool: sent without it) */
	zassert_ok(ctr_cloud_send_data(big, sizeof(big) - 1, K_FOREVER));

	zassert_equal(mock_transfer_uplink_count(), 1);
	zassert_equal(mock_transfer_uplink(0)->len, TEST_BUF_SIZE);
	zassert_mem_equal(mock_transfer_uplink(0)->mem, MSG_A, TEST_HDR_LEN);
	zassert_equal(mock_transfer_uplink(0)->mem[TEST_HDR_LEN], 0x5a);
}

ZTEST(ctr_cloud_send_1_data, test_lock_busy)
{
	mock_transfer_gate_next_uplink();
	helper_start(send_a_forever, NULL);
	zassert_ok(mock_transfer_wait_entered(K_SECONDS(5)));

	/* The raw k_mutex_lock() codes */
	zassert_equal(ctr_cloud_send_data(PAYLOAD_B, sizeof(PAYLOAD_B), K_NO_WAIT), -EBUSY);
	zassert_equal(ctr_cloud_send_data(PAYLOAD_B, sizeof(PAYLOAD_B), K_MSEC(10)), -EAGAIN);

	mock_transfer_release();
	zassert_ok(helper_join());

	zassert_equal(mock_transfer_uplink_count(), 1);
	assert_uplink(0, MSG_A, sizeof(MSG_A));
	assert_spooled_once(MSG_A, sizeof(MSG_A), 1);
}

ZTEST(ctr_cloud_send_1_data, test_deadline_lock_wait)
{
	assert_deadline_after_lock_wait(send_b_deadline);
}
```
