## CMakeLists.txt
```
cmake_minimum_required(VERSION 3.20.0)

find_package(Zephyr REQUIRED HINTS $ENV{ZEPHYR_BASE})
project(test)

# The modules under test are application sources without Zephyr device or
# configuration dependencies; compile them directly from the application tree.
set(SERIAL_SRC ${CMAKE_CURRENT_SOURCE_DIR}/../../../../applications/serial/src)

include_directories(${SERIAL_SRC})

target_sources(app PRIVATE ${SERIAL_SRC}/app_driver_store.c)
target_sources(app PRIVATE ${SERIAL_SRC}/app_modbus_addr.c)
target_sources(app PRIVATE src/test_plan.c)
target_sources(app PRIVATE src/test_records.c)
target_sources(app PRIVATE src/test_items.c)
target_sources(app PRIVATE src/test_modbus_decode.c)
target_sources(app PRIVATE src/test_modbus_addr.c)
```

## prj.conf
```kconfig
CONFIG_ZTEST=y
CONFIG_MAIN_STACK_SIZE=4096
CONFIG_ZTEST_STACK_SIZE=4096

CONFIG_REQUIRES_FULL_LIBC=y

# app_driver_store.c asserts that every slot uses exactly the planned memory
CONFIG_ASSERT=y
```

## src/test_items.c
```c
/*
 * Copyright (c) 2026 HARDWARIO a.s.
 *
 * SPDX-License-Identifier: LicenseRef-HARDWARIO-5-Clause
 *
 * Tests for the item store: the four aggregation modes, the window ring and its
 * timeline.
 */

#include "app_driver_store.h"

#include <zephyr/ztest.h>

#include <math.h>
#include <stdint.h>

#define INTERVAL    300
#define WIN_CAP     4
#define SAMPLES_CAP 4
#define T0          1700000000

enum {
	K_STATS = 1,
	K_STATS__MEASUREMENTS,
	K_LAST,
	K_LAST__MEASUREMENTS,
	K_COUNTER,
	K_COUNTER__MEASUREMENTS,
	K_DIR,
	K_DIR__MEASUREMENTS,
};

enum {
	I_STATS,
	I_LAST,
	I_COUNTER,
	I_DIR,
};

static const struct app_driver_item m_items[] = {
	[I_STATS] = APP_DRIVER_ITEM("stats", "", 0, APP_MODBUS_S32_HI, 1.f, APP_DRIVER_AGGREG_STATS,
				    1.f, K_STATS),
	[I_LAST] = APP_DRIVER_ITEM("last", "", 2, APP_MODBUS_U16, 1.f, APP_DRIVER_AGGREG_LAST, 1.f,
				   K_LAST),
	[I_COUNTER] = APP_DRIVER_ITEM("counter", "", 4, APP_MODBUS_U32_HI, 1.f,
				      APP_DRIVER_AGGREG_COUNTER, 1.f, K_COUNTER),
	[I_DIR] = APP_DRIVER_ITEM("dir", "", 6, APP_MODBUS_U16, 1.f, APP_DRIVER_AGGREG_CIRCULAR,
				  1.f, K_DIR),
};

static const struct app_driver_demand m_demand = {
	.items = m_items,
	.item_count = ARRAY_SIZE(m_items),
};

static uint8_t m_mem[1024] __aligned(8);
static struct app_driver_slot m_slot;

static void before(void *fixture)
{
	struct app_driver_slot_plan plan = {.win_cap = WIN_CAP, .samples_cap = SAMPLES_CAP};

	ARG_UNUSED(fixture);

	plan.bytes = app_driver_slot_bytes(&m_demand, 0, plan.win_cap, plan.samples_cap);
	zassert_true(plan.bytes <= sizeof(m_mem));

	memset(&m_slot, 0, sizeof(m_slot));
	app_driver_slot_setup(&m_slot, &m_demand, &plan, m_mem, INTERVAL);
}

static void put(size_t idx, float value)
{
	app_driver_items_put(&m_slot, idx, value);
}

/* Close the windows on the given number of timer ticks, at an RTC time with the uptime clock
 * moving in step with it
 */
static void aggreg_ticks(int64_t ts, uint32_t ticks)
{
	app_driver_items_aggreg(&m_slot, ts, (ts - T0 + 1000000) * 1000, ticks);
}

/* Close the windows on a single tick */
static void aggreg(int64_t ts)
{
	aggreg_ticks(ts, 1);
}

static uint32_t newest(void)
{
	return app_driver_win_end(&m_slot) - 1;
}

ZTEST(items, test_stats)
{
	put(I_STATS, 3.f);
	put(I_STATS, NAN); /* failed read: ignored */
	put(I_STATS, 1.f);
	put(I_STATS, 2.f);

	zassert_equal(app_driver_items_last(&m_slot, I_STATS), 2.f);

	aggreg(T0);

	const struct ctr_data_aggreg *w = app_driver_win_stats(&m_slot, I_STATS, newest());

	zassert_not_null(w);
	zassert_equal(w->min, 1.f);
	zassert_equal(w->max, 3.f);
	zassert_within(w->avg, 2.f, 1e-6f);
	zassert_equal(w->mdn, 2.f);
	zassert_within(app_driver_win_value(&m_slot, I_STATS, newest()), 2.f, 1e-6f);
}

ZTEST(items, test_stats_beyond_median_buffer)
{
	/* Running min / max / avg use every sample, the median the first SAMPLES_CAP */
	for (int i = 1; i <= 10; i++) {
		put(I_STATS, (float)i);
	}

	aggreg(T0);

	const struct ctr_data_aggreg *w = app_driver_win_stats(&m_slot, I_STATS, newest());

	zassert_equal(w->min, 1.f);
	zassert_equal(w->max, 10.f);
	zassert_within(w->avg, 5.5f, 1e-6f);
	zassert_equal(w->mdn, 3.f);
}

ZTEST(items, test_last_and_counter)
{
	put(I_LAST, 7.f);
	put(I_LAST, 8.f);
	put(I_COUNTER, 100.f);
	put(I_COUNTER, 104.5f);

	aggreg(T0);

	zassert_equal(app_driver_win_value(&m_slot, I_LAST, newest()), 8.f);
	zassert_equal(app_driver_win_value(&m_slot, I_COUNTER, newest()), 104.5f);
	zassert_is_null(app_driver_win_stats(&m_slot, I_COUNTER, newest()));
}

ZTEST(items, test_circular)
{
	put(I_DIR, 350.f);
	put(I_DIR, 10.f);
	aggreg(T0);

	float mean = app_driver_win_value(&m_slot, I_DIR, newest());

	zassert_true(mean < 0.01f || mean > 359.99f, "mean %f", (double)mean);

	put(I_DIR, 90.f);
	put(I_DIR, 180.f);
	aggreg(T0 + INTERVAL);
	zassert_within(app_driver_win_value(&m_slot, I_DIR, newest()), 135.f, 0.01f);

	put(I_DIR, 270.f);
	put(I_DIR, 300.f);
	aggreg(T0 + 2 * INTERVAL);
	zassert_within(app_driver_win_value(&m_slot, I_DIR, newest()), 285.f, 0.01f);

	/* Opposite directions: no mean direction */
	put(I_DIR, 0.f);
	put(I_DIR, 180.f);
	aggreg(T0 + 3 * INTERVAL);
	zassert_true(isnan(app_driver_win_value(&m_slot, I_DIR, newest())));
}

ZTEST(items, test_empty_window)
{
	put(I_STATS, 1.f);
	aggreg(T0);
	aggreg(T0 + INTERVAL);

	const struct ctr_data_aggreg *w = app_driver_win_stats(&m_slot, I_STATS, newest());

	zassert_true(isnan(w->min) && isnan(w->max) && isnan(w->avg) && isnan(w->mdn));
	zassert_true(isnan(app_driver_win_value(&m_slot, I_LAST, newest())));
	zassert_true(isnan(app_driver_win_value(&m_slot, I_DIR, newest())));

	/* The last sample survives the window */
	zassert_equal(app_driver_items_last(&m_slot, I_STATS), 1.f);
}

ZTEST(items, test_timeline)
{
	for (int i = 0; i < 3; i++) {
		put(I_STATS, (float)i);
		aggreg(T0 + i * INTERVAL);
	}

	zassert_equal(app_driver_win_count(&m_slot), 3);

	for (uint32_t seq = 0; seq < 3; seq++) {
		zassert_equal(app_driver_win_ts(&m_slot, seq), T0 + seq * INTERVAL);
	}
}

ZTEST(items, test_ring_drops_oldest)
{
	for (int i = 0; i < WIN_CAP + 2; i++) {
		put(I_STATS, (float)i);
		aggreg(T0 + i * INTERVAL);
	}

	zassert_equal(app_driver_win_count(&m_slot), WIN_CAP);
	zassert_equal(app_driver_win_first(&m_slot), 2);
	zassert_equal(m_slot.drops, 2);
	zassert_is_null(app_driver_win_stats(&m_slot, I_STATS, 1));
	zassert_equal(app_driver_win_stats(&m_slot, I_STATS, 2)->avg, 2.f);

	/* Timestamps of the remaining windows are unaffected */
	zassert_equal(app_driver_win_ts(&m_slot, 2), T0 + 2 * INTERVAL);
}

ZTEST(items, test_missed_ticks_are_filled)
{
	put(I_STATS, 1.f);
	aggreg(T0);

	/* The work queue was blocked: two ticks coalesced, this one 20 s late */
	put(I_STATS, 2.f);
	aggreg_ticks(T0 + 3 * INTERVAL + 20, 3);

	zassert_equal(app_driver_win_count(&m_slot), 4);
	zassert_true(isnan(app_driver_win_value(&m_slot, I_STATS, 1)));
	zassert_true(isnan(app_driver_win_value(&m_slot, I_STATS, 2)));
	zassert_equal(app_driver_win_value(&m_slot, I_STATS, 3), 2.f);
	zassert_equal(app_driver_win_ts(&m_slot, 3), T0 + 3 * INTERVAL);

	/* A late tick that did not miss a window adds no empty window */
	aggreg(T0 + 4 * INTERVAL + 100);
	zassert_equal(app_driver_win_end(&m_slot), 5);
}

ZTEST(items, test_late_tick_adds_no_window)
{
	put(I_STATS, 1.f);
	aggreg(T0);

	/* Closed more than half an interval late (behind a long LTE send), no tick missed */
	put(I_STATS, 2.f);
	aggreg(T0 + INTERVAL + INTERVAL * 6 / 10);
	zassert_equal(app_driver_win_count(&m_slot), 2);
	zassert_equal(app_driver_win_value(&m_slot, I_STATS, 1), 2.f);

	/* The next tick is on time again */
	put(I_STATS, 3.f);
	aggreg(T0 + 2 * INTERVAL);
	zassert_equal(app_driver_win_count(&m_slot), 3);
	zassert_equal(m_slot.drops, 0);
	zassert_equal(app_driver_win_value(&m_slot, I_STATS, 2), 3.f);

	for (uint32_t seq = 0; seq < 3; seq++) {
		zassert_equal(app_driver_win_ts(&m_slot, seq), T0 + seq * INTERVAL);
	}
}

ZTEST(items, test_coalesced_late_ticks)
{
	put(I_STATS, 1.f);
	aggreg(T0);

	/* Two ticks coalesced and this one runs more than half an interval late */
	put(I_STATS, 2.f);
	aggreg_ticks(T0 + 3 * INTERVAL + INTERVAL * 6 / 10, 3);

	zassert_equal(app_driver_win_count(&m_slot), 4);
	zassert_equal(m_slot.drops, 0);
	zassert_true(isnan(app_driver_win_value(&m_slot, I_STATS, 1)));
	zassert_true(isnan(app_driver_win_value(&m_slot, I_STATS, 2)));
	zassert_equal(app_driver_win_value(&m_slot, I_STATS, 3), 2.f);
	zassert_equal(app_driver_win_ts(&m_slot, 3), T0 + 3 * INTERVAL);

	put(I_STATS, 3.f);
	aggreg(T0 + 4 * INTERVAL);
	zassert_equal(app_driver_win_end(&m_slot), 5);
	zassert_equal(app_driver_win_value(&m_slot, I_STATS, 4), 3.f);
	zassert_equal(app_driver_win_ts(&m_slot, 4), T0 + 4 * INTERVAL);
}

ZTEST(items, test_missed_ticks_on_empty_ring)
{
	put(I_STATS, 1.f);
	aggreg(T0);
	app_driver_win_pop_until(&m_slot, app_driver_win_end(&m_slot));

	/* Blocked for two ticks right after a report emptied the ring: there is nothing to keep
	 * apart, the timeline anchors at this window
	 */
	put(I_STATS, 2.f);
	aggreg_ticks(T0 + 3 * INTERVAL, 3);

	zassert_equal(app_driver_win_count(&m_slot), 1);
	zassert_equal(m_slot.drops, 0);
	zassert_equal(app_driver_win_value(&m_slot, I_STATS, newest()), 2.f);
	zassert_equal(app_driver_win_ts(&m_slot, newest()), T0 + 3 * INTERVAL);
}

ZTEST(items, test_no_tick_is_noop)
{
	/* The work ran again for an expiration the previous run already counted */
	aggreg_ticks(T0 - 10, 0);
	zassert_equal(app_driver_win_count(&m_slot), 0);

	put(I_STATS, 1.f);
	aggreg(T0);

	put(I_STATS, 2.f);
	aggreg_ticks(T0 + 10, 0);
	zassert_equal(app_driver_win_count(&m_slot), 1);

	/* The open window kept its samples */
	put(I_STATS, 4.f);
	aggreg(T0 + INTERVAL);
	zassert_equal(app_driver_win_count(&m_slot), 2);
	zassert_within(app_driver_win_value(&m_slot, I_STATS, 1), 3.f, 1e-6f);
	zassert_equal(app_driver_win_ts(&m_slot, 1), T0 + INTERVAL);
}

ZTEST(items, test_late_tick_is_not_a_clock_set)
{
	const int64_t late = INTERVAL * 9 / 10;

	put(I_STATS, 1.f);
	app_driver_items_aggreg(&m_slot, T0, 1000 * 1000, 1);

	/* Late by 0.9 interval; the RTC second rounds up */
	put(I_STATS, 2.f);
	app_driver_items_aggreg(&m_slot, T0 + INTERVAL + late + 1,
				(1000 + INTERVAL + late) * 1000 + 400, 1);
	zassert_equal(app_driver_win_count(&m_slot), 2);
	zassert_equal(app_driver_win_ts(&m_slot, newest()), T0 + INTERVAL);

	/* One tick missed, again late */
	put(I_STATS, 3.f);
	app_driver_items_aggreg(&m_slot, T0 + 3 * INTERVAL + late,
				(1000 + 3 * INTERVAL + late) * 1000, 2);
	zassert_equal(app_driver_win_count(&m_slot), 4);
	zassert_equal(m_slot.drops, 0);
	zassert_true(isnan(app_driver_win_value(&m_slot, I_STATS, 2)));
	zassert_equal(app_driver_win_value(&m_slot, I_STATS, 3), 3.f);
	zassert_equal(app_driver_win_ts(&m_slot, 3), T0 + 3 * INTERVAL);
}

ZTEST(items, test_clock_set_with_missed_ticks)
{
	put(I_STATS, 1.f);
	app_driver_items_aggreg(&m_slot, T0, 1000 * 1000, 1);

	/* A long LTE attach blocked the work queue for three ticks and set the clock */
	put(I_STATS, 2.f);
	app_driver_items_aggreg(&m_slot, T0 + 86400 + 3 * INTERVAL, (1000 + 3 * INTERVAL) * 1000,
				3);

	/* The missed windows are kept apart, the timeline follows the new clock */
	zassert_equal(app_driver_win_count(&m_slot), 4);
	zassert_equal(app_driver_win_value(&m_slot, I_STATS, 0), 1.f);
	zassert_equal(app_driver_win_value(&m_slot, I_STATS, 3), 2.f);
	zassert_equal(app_driver_win_ts(&m_slot, 0), T0 + 86400);
	zassert_equal(app_driver_win_ts(&m_slot, newest()), T0 + 86400 + 3 * INTERVAL);
}

ZTEST(items, test_reanchor_after_pop)
{
	put(I_STATS, 1.f);
	app_driver_items_aggreg(&m_slot, 1000, 1000 * 1000, 1);
	put(I_STATS, 2.f);
	app_driver_items_aggreg(&m_slot, 1000 + INTERVAL, (1000 + INTERVAL) * 1000, 1);

	/* Everything sent: the next window anchors the timeline again (the RTC was set
	 * in between, with an empty ring that needs no detection)
	 */
	app_driver_win_pop_until(&m_slot, app_driver_win_end(&m_slot));
	zassert_equal(app_driver_win_count(&m_slot), 0);

	put(I_STATS, 3.f);
	app_driver_items_aggreg(&m_slot, T0, (1000 + 2 * INTERVAL) * 1000, 1);
	zassert_equal(app_driver_win_ts(&m_slot, newest()), T0);
}

ZTEST(items, test_clock_set)
{
	put(I_STATS, 1.f);
	app_driver_items_aggreg(&m_slot, T0, 1000 * 1000, 1);

	/* One interval later on the uptime clock, the RTC was set back */
	put(I_STATS, 2.f);
	app_driver_items_aggreg(&m_slot, T0 - 5000, (1000 + INTERVAL) * 1000, 1);
	zassert_equal(app_driver_win_count(&m_slot), 2);
	zassert_equal(app_driver_win_ts(&m_slot, newest()), T0 - 5000);

	/* ...and forward by a day: no empty windows for that day */
	put(I_STATS, 3.f);
	app_driver_items_aggreg(&m_slot, T0 + 86400, (1000 + 2 * INTERVAL) * 1000, 1);
	zassert_equal(app_driver_win_count(&m_slot), 3);
	zassert_equal(app_driver_win_value(&m_slot, I_STATS, newest()), 3.f);
	zassert_equal(app_driver_win_ts(&m_slot, newest()), T0 + 86400);
}

ZTEST(items, test_long_outage_restarts_ring)
{
	for (int i = 0; i < 3; i++) {
		put(I_STATS, (float)i);
		aggreg(T0 + i * INTERVAL);
	}

	/* The work queue was blocked for ten intervals: none of the buffered windows would
	 * survive the empty ones, the ring restarts with the current window
	 */
	put(I_STATS, 9.f);
	aggreg_ticks(T0 + 12 * INTERVAL, 10);

	zassert_equal(app_driver_win_count(&m_slot), 1);
	zassert_equal(m_slot.drops, 3);
	zassert_equal(app_driver_win_value(&m_slot, I_STATS, newest()), 9.f);
	zassert_equal(app_driver_win_ts(&m_slot, newest()), T0 + 12 * INTERVAL);
}

ZTEST(items, test_short_interval_jitter)
{
	struct app_driver_slot slot = {0};
	struct app_driver_slot_plan plan = {.win_cap = WIN_CAP, .samples_cap = SAMPLES_CAP};
	static uint8_t mem[1024] __aligned(8);

	plan.bytes = app_driver_slot_bytes(&m_demand, 0, plan.win_cap, plan.samples_cap);
	app_driver_slot_setup(&slot, &m_demand, &plan, mem, 1);

	/* 1 s windows closed 300 ms late and then on time: the RTC second ticks twice, no
	 * window was missed
	 */
	app_driver_items_aggreg(&slot, T0, 10000, 1);
	app_driver_items_aggreg(&slot, T0 + 2, 11300, 1);
	app_driver_items_aggreg(&slot, T0 + 3, 12000, 1);

	zassert_equal(app_driver_win_count(&slot), 3);
	zassert_equal(slot.drops, 0);
}

ZTEST(items, test_out_of_range)
{
	put(99, 1.f);
	zassert_true(isnan(app_driver_items_last(&m_slot, 99)));
	zassert_true(isnan(app_driver_win_value(&m_slot, I_STATS, 0)));
	zassert_is_null(app_driver_win_stats(&m_slot, I_STATS, 0));
}

ZTEST(items, test_aggreg_samples)
{
	float samples[] = {4.f, 1.f, 3.f, 2.f};
	struct ctr_data_aggreg out;

	app_driver_aggreg_samples(samples, ARRAY_SIZE(samples), &out);

	zassert_equal(out.min, 1.f);
	zassert_equal(out.max, 4.f);
	zassert_within(out.avg, 2.5f, 1e-6f);
	zassert_equal(out.mdn, 3.f);

	float with_nan[] = {1.f, NAN};

	app_driver_aggreg_samples(with_nan, ARRAY_SIZE(with_nan), &out);
	zassert_true(isnan(out.min) && isnan(out.avg));

	app_driver_aggreg_samples(samples, 0, &out);
	zassert_true(isnan(out.mdn));
}

ZTEST(items, test_value_to_int32)
{
	int32_t v;

	/* Rounded, not truncated: 0.251 * 1000 is 250.99998 in float */
	zassert_true(app_driver_value_to_int32(0.251f, 1000.f, &v));
	zassert_equal(v, 251);
	zassert_true(app_driver_value_to_int32(0.53f, 100.f, &v));
	zassert_equal(v, 53);
	zassert_true(app_driver_value_to_int32(12.7f, 1.f, &v));
	zassert_equal(v, 13);
	zassert_true(app_driver_value_to_int32(-12.7f, 1.f, &v));
	zassert_equal(v, -13);
	zassert_true(app_driver_value_to_int32(2.5f, 1.f, &v));
	zassert_equal(v, 3);

	/* Limits of the int32 range */
	zassert_true(app_driver_value_to_int32(-2147483648.f, 1.f, &v));
	zassert_equal(v, INT32_MIN);
	zassert_true(app_driver_value_to_int32(2147483520.f, 1.f, &v));
	zassert_equal(v, 2147483520);

	/* Not available or out of range: nil on the wire */
	zassert_false(app_driver_value_to_int32(NAN, 1000.f, &v));
	zassert_false(app_driver_value_to_int32(INFINITY, 1.f, &v));
	zassert_false(app_driver_value_to_int32(-INFINITY, 1.f, &v));
	zassert_false(app_driver_value_to_int32(2147483648.f, 1.f, &v));
	zassert_false(app_driver_value_to_int32(3e6f, 1000.f, &v));
}

ZTEST_SUITE(items, NULL, NULL, before, NULL, NULL);
```

## src/test_modbus_addr.c
```c
/*
 * Copyright (c) 2026 HARDWARIO a.s.
 *
 * SPDX-License-Identifier: LicenseRef-HARDWARIO-5-Clause
 *
 * Tests for changing a Modbus device address, with a fake bus of devices that keep their
 * address in a holding register, and of OR-WE-504 meters that take a new address only after
 * an unlock.
 */

#include "app_modbus_addr.h"

#include <zephyr/ztest.h>

#include <errno.h>
#include <string.h>

#define REG_CUBIC    2
#define REG_SENSECAP 0x1000

/* OR-WE-504: the register the change is checked at (voltage) and the function codes */
#define REG_OR_WE_504_VOLTAGE 0x0000
#define FC_WRITE_REGS         0x10
#define FC_UNLOCK             0x28
#define FC_EXCEPTION          0x80

/* Modbus exception codes, returned by the Zephyr client as a positive value */
#define EXC_ILLEGAL_FUNCTION     1
#define EXC_ILLEGAL_DATA_ADDRESS 2
#define EXC_ILLEGAL_DATA_VALUE   3

/* Bus time of an answered request and of a request without a reply */
#define FRAME_MS   50
#define TIMEOUT_MS 1000

struct fake_device {
	bool present;
	uint8_t addr;        /* address the device answers at */
	uint16_t reg;        /* holding register that holds the address */
	uint16_t stored;     /* value of that register */
	bool apply_on_write; /* takes the new address at once, not after a power cycle */
	bool reply_from_new; /* answers the address write from the new address */
	bool garble_reply;   /* stores the write, but its reply is unreadable */
	bool lose_reply;     /* stores the write, but its reply never arrives */
	int miss_reads;      /* reads the device does not answer */
	/* OR-WE-504, see fake_unlock() and fake_write_regs() */
	bool or_we_504;
	int64_t unlocked_at;    /* bus time of the last unlock, -1 if none */
	int miss_unlocks;       /* unlocks the meter misses */
	int bad_unlock_replies; /* unlocks answered with an unexpected frame, not taken */
	bool refuse_unlock;     /* another password is set: the unlock gets an exception */
	bool refuse_write;      /* the address write gets an exception */
	bool miss_write;        /* the meter misses the address write */
};

struct fake_bus {
	struct fake_device dev[2];
	int bus_error;     /* returned by every read and write when non-zero */
	int write_error;   /* returned by every write when non-zero, nothing stored */
	int disturb_reads; /* reads after the first write that fail with -EIO */
	int64_t now_ms;    /* bus time */
	int reads;
	int writes; /* FC06 writes and FC16 frames */
	int unlocks;
	uint8_t write_addr;
	uint16_t write_reg;
	uint16_t write_value;
	struct app_modbus_addr_frame unlock;      /* the last unlock frame */
	struct app_modbus_addr_frame write_frame; /* the last FC16 frame */
};

static struct fake_bus m_bus;

static struct fake_device cubic(uint8_t addr)
{
	return (struct fake_device){.present = true,
				    .addr = addr,
				    .reg = REG_CUBIC,
				    .stored = addr,
				    .apply_on_write = true,
				    .reply_from_new = true};
}

static struct fake_device sensecap(uint8_t addr)
{
	return (struct fake_device){
		.present = true, .addr = addr, .reg = REG_SENSECAP, .stored = addr};
}

static struct fake_device or_we_504(uint8_t addr)
{
	return (struct fake_device){.present = true,
				    .addr = addr,
				    .apply_on_write = true,
				    .reply_from_new = true,
				    .or_we_504 = true,
				    .unlocked_at = -1};
}

static struct fake_device *find(uint8_t addr)
{
	for (size_t i = 0; i < ARRAY_SIZE(m_bus.dev); i++) {
		if (m_bus.dev[i].present && m_bus.dev[i].addr == addr) {
			return &m_bus.dev[i];
		}
	}

	return NULL;
}

static int fake_read(uint8_t addr, uint16_t reg, uint16_t *value, void *user)
{
	struct fake_device *dev = find(addr);

	ARG_UNUSED(user);

	m_bus.reads++;

	if (m_bus.bus_error) {
		return m_bus.bus_error;
	}

	if (m_bus.writes > 0 && m_bus.disturb_reads > 0) {
		m_bus.disturb_reads--;
		return -EIO;
	}

	if (dev == NULL || dev->miss_reads > 0) {
		if (dev != NULL) {
			dev->miss_reads--;
		}

		m_bus.now_ms += TIMEOUT_MS;
		return -ETIMEDOUT;
	}

	m_bus.now_ms += FRAME_MS;

	/* Reading the OR-WE-504 address register was never tried on hardware */
	if (dev->or_we_504 ? reg != REG_OR_WE_504_VOLTAGE : reg != dev->reg) {
		return EXC_ILLEGAL_DATA_ADDRESS;
	}

	*value = dev->or_we_504 ? 2300 : dev->stored;
	return 0;
}

static int fake_write(uint8_t addr, uint16_t reg, uint16_t value, void *user)
{
	struct fake_device *dev = find(addr);

	ARG_UNUSED(user);

	m_bus.writes++;
	m_bus.write_addr = addr;
	m_bus.write_reg = reg;
	m_bus.write_value = value;

	if (m_bus.bus_error) {
		return m_bus.bus_error;
	}

	if (dev == NULL) {
		return -ETIMEDOUT;
	}

	if (m_bus.write_error) {
		return m_bus.write_error;
	}

	/* The OR-WE-504 takes its address only by FC16 after an unlock */
	if (dev->or_we_504 || reg != dev->reg) {
		return EXC_ILLEGAL_DATA_ADDRESS;
	}

	dev->stored = value;

	if (dev->apply_on_write) {
		dev->addr = (uint8_t)value;
	}

	if (dev->lose_reply) {
		return -ETIMEDOUT;
	}

	/* The Zephyr client rejects a reply from another unit ID with -EIO */
	return dev->reply_from_new || dev->garble_reply ? -EIO : 0;
}

static int reply(struct app_modbus_addr_frame *rsp, uint8_t unit_id, uint8_t fc,
		 const uint8_t *data, uint8_t len)
{
	rsp->unit_id = unit_id;
	rsp->fc = fc;
	rsp->len = len;
	memcpy(rsp->data, data, len);

	return 0;
}

static int exception(struct app_modbus_addr_frame *rsp, uint8_t unit_id, uint8_t fc, uint8_t code)
{
	return reply(rsp, unit_id, fc | FC_EXCEPTION, &code, 1);
}

/* The OR-WE-504 unlock: function 0x28, address 0xFE01, 2 registers, 4 bytes of password */
static int fake_unlock(struct fake_device *dev, const struct app_modbus_addr_frame *req,
		       struct app_modbus_addr_frame *rsp)
{
	static const uint8_t request[] = {0xFE, 0x01, 0x00, 0x02, 0x04, 0x00, 0x00, 0x00, 0x00};
	static const uint8_t answer[] = {0xFE, 0x01, 0x00, 0x01};
	static const uint8_t unexpected[] = {0x00, 0x00, 0x00, 0x00};

	if (dev->miss_unlocks > 0) {
		dev->miss_unlocks--;
		m_bus.now_ms += TIMEOUT_MS;
		return -ETIMEDOUT;
	}

	m_bus.now_ms += FRAME_MS;

	if (dev->refuse_unlock || req->len != sizeof(request) ||
	    memcmp(req->data, request, sizeof(request)) != 0) {
		return exception(rsp, dev->addr, req->fc, EXC_ILLEGAL_DATA_VALUE);
	}

	if (dev->bad_unlock_replies > 0) {
		dev->bad_unlock_replies--;
		return reply(rsp, dev->addr, req->fc, unexpected, sizeof(unexpected));
	}

	dev->unlocked_at = m_bus.now_ms;

	return reply(rsp, dev->addr, req->fc, answer, sizeof(answer));
}

/* The OR-WE-504 takes FC16 to its address register 0x000F within 10 s after an unlock. A PC
 * tool wrote it 8 s after the unlock on hardware and earlier writes were never tried, so the
 * fake takes it only from 8 s on. The meter answers from the new address. */
static int fake_write_regs(struct fake_device *dev, const struct app_modbus_addr_frame *req,
			   struct app_modbus_addr_frame *rsp)
{
	/* Register 0x000F, 1 register, 2 bytes, the high byte of the value */
	static const uint8_t header[] = {0x00, 0x0F, 0x00, 0x01, 0x02, 0x00};
	int64_t since_unlock = m_bus.now_ms - dev->unlocked_at;
	uint8_t old_addr = dev->addr;
	uint8_t new_addr;

	if (dev->miss_write) {
		m_bus.now_ms += TIMEOUT_MS;
		return -ETIMEDOUT;
	}

	m_bus.now_ms += FRAME_MS;

	if (dev->refuse_write || dev->unlocked_at < 0 || since_unlock < 8000 ||
	    since_unlock >= 10000 || req->len != sizeof(header) + 1 ||
	    memcmp(req->data, header, sizeof(header)) != 0) {
		return exception(rsp, dev->addr, req->fc, EXC_ILLEGAL_DATA_ADDRESS);
	}

	new_addr = req->data[sizeof(header)];
	dev->stored = new_addr;

	if (dev->apply_on_write) {
		dev->addr = new_addr;
	}

	if (dev->lose_reply) {
		m_bus.now_ms += TIMEOUT_MS - FRAME_MS;
		return -ETIMEDOUT;
	}

	if (dev->garble_reply) {
		return -EIO;
	}

	/* The echo of the register address and count */
	return reply(rsp, dev->reply_from_new ? new_addr : old_addr, req->fc, req->data, 4);
}

/* A frame without the checks of the Zephyr client: the reply comes as the device sends it */
static int fake_transact(const struct app_modbus_addr_frame *req, struct app_modbus_addr_frame *rsp,
			 void *user)
{
	struct fake_device *dev = find(req->unit_id);

	ARG_UNUSED(user);

	if (req->fc == FC_UNLOCK) {
		m_bus.unlocks++;
		m_bus.unlock = *req;
	} else {
		m_bus.writes++;
		m_bus.write_frame = *req;
	}

	if (m_bus.bus_error) {
		return m_bus.bus_error;
	}

	if (dev == NULL) {
		m_bus.now_ms += TIMEOUT_MS;
		return -ETIMEDOUT;
	}

	if (dev->or_we_504 && req->fc == FC_UNLOCK) {
		return fake_unlock(dev, req, rsp);
	}

	if (dev->or_we_504 && req->fc == FC_WRITE_REGS) {
		return fake_write_regs(dev, req, rsp);
	}

	m_bus.now_ms += FRAME_MS;

	return exception(rsp, dev->addr, req->fc, EXC_ILLEGAL_FUNCTION);
}

static void fake_sleep(int32_t ms, void *user)
{
	ARG_UNUSED(user);

	m_bus.now_ms += ms;
}

static const struct app_modbus_addr_bus m_fake = {
	.read_reg = fake_read,
	.write_reg = fake_write,
	.transact = fake_transact,
	.sleep = fake_sleep,
};

static void before(void *fixture)
{
	ARG_UNUSED(fixture);

	memset(&m_bus, 0, sizeof(m_bus));
}

ZTEST(modbus_addr, test_applied_from_new_address)
{
	enum app_modbus_addr_result result;

	/* Cubic: takes the new address at once and answers the write from it */
	m_bus.dev[0] = cubic(1);

	zassert_equal(app_modbus_addr_change(&m_fake, 1, 5, REG_CUBIC, &result), 0);
	zassert_equal(result, APP_MODBUS_ADDR_APPLIED);
	zassert_equal(m_bus.writes, 1);
	zassert_equal(m_bus.write_addr, 1);
	zassert_equal(m_bus.write_reg, REG_CUBIC);
	zassert_equal(m_bus.write_value, 5);
}

ZTEST(modbus_addr, test_applied_after_disturbed_read_back)
{
	enum app_modbus_addr_result result;

	/* One unreadable frame right after the change must not report a failure */
	m_bus.dev[0] = cubic(1);
	m_bus.disturb_reads = 1;

	zassert_equal(app_modbus_addr_change(&m_fake, 1, 5, REG_CUBIC, &result), 0);
	zassert_equal(result, APP_MODBUS_ADDR_APPLIED);
}

ZTEST(modbus_addr, test_pending_until_power_cycle)
{
	enum app_modbus_addr_result result;

	/* SenseCAP: confirms the write from the old address, moves after a power cycle */
	m_bus.dev[0] = sensecap(10);

	zassert_equal(app_modbus_addr_change(&m_fake, 10, 20, REG_SENSECAP, &result), 0);
	zassert_equal(result, APP_MODBUS_ADDR_PENDING);
	zassert_equal(m_bus.writes, 1);
	zassert_equal(m_bus.write_reg, REG_SENSECAP);
}

ZTEST(modbus_addr, test_pending_after_garbled_reply)
{
	enum app_modbus_addr_result result;

	/* The write was stored, the reply was unreadable, the device answers at the old one */
	m_bus.dev[0] = sensecap(10);
	m_bus.dev[0].garble_reply = true;

	zassert_equal(app_modbus_addr_change(&m_fake, 10, 20, REG_SENSECAP, &result), 0);
	zassert_equal(result, APP_MODBUS_ADDR_PENDING);
}

ZTEST(modbus_addr, test_pending_after_lost_reply)
{
	enum app_modbus_addr_result result;

	/* The write was stored, but its reply never arrived */
	m_bus.dev[0] = sensecap(10);
	m_bus.dev[0].lose_reply = true;

	zassert_equal(app_modbus_addr_change(&m_fake, 10, 20, REG_SENSECAP, &result), 0);
	zassert_equal(result, APP_MODBUS_ADDR_PENDING);
}

ZTEST(modbus_addr, test_new_address_taken)
{
	enum app_modbus_addr_result result;

	m_bus.dev[0] = sensecap(10);
	m_bus.dev[1] = sensecap(1);

	zassert_equal(app_modbus_addr_change(&m_fake, 10, 1, REG_SENSECAP, &result), -EADDRINUSE);
	zassert_equal(m_bus.writes, 0);
}

ZTEST(modbus_addr, test_exception_at_new_address)
{
	enum app_modbus_addr_result result;

	/* The Cubic at the new address has no register 0x1000 and answers with an exception */
	m_bus.dev[0] = sensecap(10);
	m_bus.dev[1] = cubic(1);

	zassert_equal(app_modbus_addr_change(&m_fake, 10, 1, REG_SENSECAP, &result), -EADDRINUSE);
	zassert_equal(m_bus.writes, 0);
}

ZTEST(modbus_addr, test_bus_not_running)
{
	enum app_modbus_addr_result result;

	/* The Zephyr client returns -ENODEV while Modbus is not initialized */
	m_bus.dev[0] = cubic(1);
	m_bus.bus_error = -ENODEV;

	zassert_equal(app_modbus_addr_change(&m_fake, 1, 5, REG_CUBIC, &result), -ENODEV);
	zassert_equal(m_bus.writes, 0);
}

ZTEST(modbus_addr, test_no_device)
{
	enum app_modbus_addr_result result;

	zassert_equal(app_modbus_addr_change(&m_fake, 1, 5, REG_CUBIC, &result), -ETIMEDOUT);
}

ZTEST(modbus_addr, test_write_exception)
{
	enum app_modbus_addr_result result;

	m_bus.dev[0] = cubic(1);
	m_bus.write_error = 3;

	zassert_equal(app_modbus_addr_change(&m_fake, 1, 5, REG_CUBIC, &result), -EIO);
}

ZTEST(modbus_addr, test_same_address)
{
	enum app_modbus_addr_result result;

	m_bus.dev[0] = cubic(1);

	zassert_equal(app_modbus_addr_change(&m_fake, 1, 1, REG_CUBIC, &result), -EINVAL);
	zassert_equal(m_bus.reads + m_bus.writes, 0);
}

ZTEST(modbus_addr, test_or_we_504_applied)
{
	/* The frames of the vendor example, for address 2 -> 10 */
	static const uint8_t unlock[] = {0xFE, 0x01, 0x00, 0x02, 0x04, 0x00, 0x00, 0x00, 0x00};
	static const uint8_t write[] = {0x00, 0x0F, 0x00, 0x01, 0x02, 0x00, 0x0A};

	/* Unlocked, written inside the window, answered from the new address */
	m_bus.dev[0] = or_we_504(2);

	zassert_equal(app_modbus_addr_change_or_we_504(&m_fake, 2, 10), 0);
	zassert_equal(m_bus.dev[0].addr, 10);
	zassert_equal(m_bus.unlocks, 1);
	zassert_equal(m_bus.unlock.unit_id, 2);
	zassert_equal(m_bus.unlock.fc, 0x28);
	zassert_equal(m_bus.unlock.len, sizeof(unlock));
	zassert_mem_equal(m_bus.unlock.data, unlock, sizeof(unlock));
	zassert_equal(m_bus.writes, 1);
	zassert_equal(m_bus.write_frame.unit_id, 2);
	zassert_equal(m_bus.write_frame.fc, 0x10);
	zassert_equal(m_bus.write_frame.len, sizeof(write));
	zassert_mem_equal(m_bus.write_frame.data, write, sizeof(write));
}

ZTEST(modbus_addr, test_or_we_504_unlock_missed_once)
{
	/* The meter misses a request now and then: the second unlock opens the window */
	m_bus.dev[0] = or_we_504(2);
	m_bus.dev[0].miss_unlocks = 1;

	zassert_equal(app_modbus_addr_change_or_we_504(&m_fake, 2, 10), 0);
	zassert_equal(m_bus.unlocks, 2);
	zassert_equal(m_bus.dev[0].addr, 10);
}

ZTEST(modbus_addr, test_or_we_504_unexpected_unlock_reply)
{
	m_bus.dev[0] = or_we_504(2);
	m_bus.dev[0].bad_unlock_replies = 1;

	zassert_equal(app_modbus_addr_change_or_we_504(&m_fake, 2, 10), 0);
	zassert_equal(m_bus.unlocks, 2);
	zassert_equal(m_bus.dev[0].addr, 10);
}

ZTEST(modbus_addr, test_or_we_504_write_reply_lost)
{
	/* The meter moved, but its reply from the new address never arrived */
	m_bus.dev[0] = or_we_504(2);
	m_bus.dev[0].lose_reply = true;

	zassert_equal(app_modbus_addr_change_or_we_504(&m_fake, 2, 10), 0);
}

ZTEST(modbus_addr, test_or_we_504_check_disturbed)
{
	/* An unreadable reply and one disturbed check: the second check finds the meter */
	m_bus.dev[0] = or_we_504(2);
	m_bus.dev[0].garble_reply = true;
	m_bus.disturb_reads = 1;

	zassert_equal(app_modbus_addr_change_or_we_504(&m_fake, 2, 10), 0);
}

ZTEST(modbus_addr, test_or_we_504_write_missed)
{
	m_bus.dev[0] = or_we_504(2);
	m_bus.dev[0].miss_write = true;

	zassert_equal(app_modbus_addr_change_or_we_504(&m_fake, 2, 10), -EIO);
	zassert_equal(m_bus.dev[0].addr, 2);
}

ZTEST(modbus_addr, test_or_we_504_confirmed_from_old_address)
{
	/* An echo from the old address does not show that the meter moved */
	m_bus.dev[0] = or_we_504(2);
	m_bus.dev[0].apply_on_write = false;
	m_bus.dev[0].reply_from_new = false;

	zassert_equal(app_modbus_addr_change_or_we_504(&m_fake, 2, 10), -EIO);
}

ZTEST(modbus_addr, test_or_we_504_unlock_refused)
{
	/* Another password than the default 00000000 */
	m_bus.dev[0] = or_we_504(2);
	m_bus.dev[0].refuse_unlock = true;

	zassert_equal(app_modbus_addr_change_or_we_504(&m_fake, 2, 10), -EACCES);
	zassert_equal(m_bus.unlocks, 1);
	zassert_equal(m_bus.writes, 0);
}

ZTEST(modbus_addr, test_or_we_504_write_refused)
{
	m_bus.dev[0] = or_we_504(2);
	m_bus.dev[0].refuse_write = true;

	zassert_equal(app_modbus_addr_change_or_we_504(&m_fake, 2, 10), -EACCES);
	zassert_equal(m_bus.dev[0].addr, 2);
}

ZTEST(modbus_addr, test_or_we_504_no_meter)
{
	zassert_equal(app_modbus_addr_change_or_we_504(&m_fake, 2, 10), -ETIMEDOUT);
	zassert_equal(m_bus.unlocks, 2);
	zassert_equal(m_bus.writes, 0);
}

ZTEST(modbus_addr, test_or_we_504_new_address_taken)
{
	/* The Cubic at the new address answers the voltage read with an exception */
	m_bus.dev[0] = or_we_504(2);
	m_bus.dev[1] = cubic(10);

	zassert_equal(app_modbus_addr_change_or_we_504(&m_fake, 2, 10), -EADDRINUSE);
	zassert_equal(m_bus.unlocks + m_bus.writes, 0);
}

ZTEST(modbus_addr, test_or_we_504_new_address_missed_once)
{
	/* A device at the new address that misses one request must not end up sharing it */
	m_bus.dev[0] = or_we_504(2);
	m_bus.dev[1] = or_we_504(10);
	m_bus.dev[1].miss_reads = 1;

	zassert_equal(app_modbus_addr_change_or_we_504(&m_fake, 2, 10), -EADDRINUSE);
	zassert_equal(m_bus.unlocks + m_bus.writes, 0);
}

ZTEST(modbus_addr, test_or_we_504_bus_not_running)
{
	m_bus.dev[0] = or_we_504(2);
	m_bus.bus_error = -ENODEV;

	zassert_equal(app_modbus_addr_change_or_we_504(&m_fake, 2, 10), -ENODEV);
	zassert_equal(m_bus.unlocks + m_bus.writes, 0);
}

ZTEST(modbus_addr, test_or_we_504_same_address)
{
	m_bus.dev[0] = or_we_504(2);

	zassert_equal(app_modbus_addr_change_or_we_504(&m_fake, 2, 2), -EINVAL);
	zassert_equal(m_bus.reads + m_bus.unlocks + m_bus.writes, 0);
}

ZTEST_SUITE(modbus_addr, NULL, NULL, before, NULL, NULL);
```

## src/test_modbus_decode.c
```c
/*
 * Copyright (c) 2026 HARDWARIO a.s.
 *
 * SPDX-License-Identifier: LicenseRef-HARDWARIO-5-Clause
 *
 * Tests for the Modbus register decoders.
 */

#include "app_modbus_decode.h"

#include <zephyr/ztest.h>

#include <math.h>
#include <stdint.h>

ZTEST(modbus_decode, test_u32_s32)
{
	const uint16_t regs[2] = {0x1234, 0x5678};
	const uint16_t neg[2] = {0xFFFF, 0xFFFE};

	zassert_equal(app_modbus_decode_u32(regs, APP_MODBUS_WO_HI_FIRST), 0x12345678);
	zassert_equal(app_modbus_decode_u32(regs, APP_MODBUS_WO_LO_FIRST), 0x56781234);
	zassert_equal(app_modbus_decode_s32(neg, APP_MODBUS_WO_HI_FIRST), -2);
	zassert_equal(
		app_modbus_decode_s32((const uint16_t[]){0xFFFE, 0xFFFF}, APP_MODBUS_WO_LO_FIRST),
		-2);
}

ZTEST(modbus_decode, test_float)
{
	/* 1.5f = 0x3FC00000 */
	const uint16_t hi[2] = {0x3FC0, 0x0000};
	const uint16_t lo[2] = {0x0000, 0x3FC0};

	zassert_equal(app_modbus_decode_float(hi, APP_MODBUS_WO_HI_FIRST), 1.5f);
	zassert_equal(app_modbus_decode_float(lo, APP_MODBUS_WO_LO_FIRST), 1.5f);
}

ZTEST(modbus_decode, test_s64)
{
	const uint16_t hi[4] = {0x0000, 0x0000, 0x0001, 0x86A0};
	const uint16_t lo[4] = {0x86A0, 0x0001, 0x0000, 0x0000};
	const uint16_t neg[4] = {0xFFFF, 0xFFFF, 0xFFFF, 0xFFFF};

	zassert_equal(app_modbus_decode_s64(hi, APP_MODBUS_WO_HI_FIRST), 100000);
	zassert_equal(app_modbus_decode_s64(lo, APP_MODBUS_WO_LO_FIRST), 100000);
	zassert_equal(app_modbus_decode_s64(neg, APP_MODBUS_WO_HI_FIRST), -1);
}

ZTEST(modbus_decode, test_value)
{
	const uint16_t one[1] = {0xFF38};         /* -200 as s16, 65336 as u16 */
	const uint16_t two[2] = {0xFFFF, 0xFC18}; /* -1000 as s32 hi-first */

	zassert_equal(app_modbus_format_regs(APP_MODBUS_U16), 1);
	zassert_equal(app_modbus_format_regs(APP_MODBUS_S16), 1);
	zassert_equal(app_modbus_format_regs(APP_MODBUS_FLOAT_LO), 2);

	zassert_equal(app_modbus_decode_value(one, APP_MODBUS_U16), 65336.f);
	zassert_equal(app_modbus_decode_value(one, APP_MODBUS_S16), -200.f);
	zassert_equal(app_modbus_decode_value(two, APP_MODBUS_S32_HI), -1000.f);
	zassert_equal(app_modbus_decode_value(two, APP_MODBUS_U32_HI), 4294966296.f);
	zassert_equal(
		app_modbus_decode_value((const uint16_t[]){0xFC18, 0xFFFF}, APP_MODBUS_S32_LO),
		-1000.f);
	zassert_equal(
		app_modbus_decode_value((const uint16_t[]){0x0000, 0x3FC0}, APP_MODBUS_FLOAT_LO),
		1.5f);
	zassert_true(isnan(app_modbus_decode_value(two, (enum app_modbus_format)99)));
}

/* Register values of the OR-WE-504 table (drv_or_we_504.c): a raw value is decoded by its
 * format and divided by the divisor of the table. The same raw 0xFFFF is 65535 unsigned but -1
 * signed, so exported power must stay negative.
 */
ZTEST(modbus_decode, test_or_we_504_registers)
{
	const uint16_t voltage[1] = {2301};
	const uint16_t all_ones[1] = {0xFFFF};
	const uint16_t power[1] = {1000};
	const uint16_t s16_min[1] = {0x8000};
	const uint16_t energy[2] = {0x0001, 0x0002};
	const uint16_t energy_max[2] = {0xABCD, 0xEF01};

	zassert_within(app_modbus_decode_value(voltage, APP_MODBUS_U16) / 10.f, 230.1f, 0.001f);
	zassert_within(app_modbus_decode_value(all_ones, APP_MODBUS_U16) / 10.f, 6553.5f, 0.01f);
	zassert_within(app_modbus_decode_value(power, APP_MODBUS_S16) / 1000.f, 1.f, 0.0001f);
	zassert_within(app_modbus_decode_value(all_ones, APP_MODBUS_S16) / 1000.f, -0.001f,
		       0.0001f);
	zassert_within(app_modbus_decode_value(s16_min, APP_MODBUS_S16), -32768.f, 0.5f);
	zassert_equal(app_modbus_decode_u32(energy, APP_MODBUS_WO_HI_FIRST), 0x00010002);
	zassert_equal(app_modbus_decode_u32(energy_max, APP_MODBUS_WO_HI_FIRST), 0xABCDEF01);
}

ZTEST_SUITE(modbus_decode, NULL, NULL, NULL, NULL, NULL);
```

## src/test_plan.c
```c
/*
 * Copyright (c) 2026 HARDWARIO a.s.
 *
 * SPDX-License-Identifier: LicenseRef-HARDWARIO-5-Clause
 *
 * Tests for the pool plan and the slot memory layout.
 */

#include "app_driver_store.h"

#include <zephyr/ztest.h>

#include <errno.h>
#include <stdint.h>

#define POOL_SIZE (16 * 1024)

/* Sizes of an EM5xx-like legacy driver: private state and one sample record */
struct meter_record {
	uint64_t timestamp;
	float values[20];
};

static const struct app_driver_demand m_meter = {
	.ctx_size = 96,
	.rec_size = sizeof(struct meter_record),
};

enum {
	K_A = 1,
	K_A__MEASUREMENTS,
	K_B,
	K_B__MEASUREMENTS,
	K_C,
	K_C__MEASUREMENTS,
};

static const struct app_driver_item m_items[] = {
	APP_DRIVER_ITEM("a", "", 0, APP_MODBUS_S32_HI, 1000.f, APP_DRIVER_AGGREG_STATS, 1000.f,
			K_A),
	APP_DRIVER_ITEM("b", "", 2, APP_MODBUS_S32_HI, 1000.f, APP_DRIVER_AGGREG_CIRCULAR, 1000.f,
			K_B),
	APP_DRIVER_ITEM("c", "", 4, APP_MODBUS_S32_HI, 1000.f, APP_DRIVER_AGGREG_COUNTER, 1000.f,
			K_C),
};

static const struct app_driver_demand m_station = {
	.items = m_items,
	.item_count = ARRAY_SIZE(m_items),
};

static const struct app_driver_plan_params m_lte = {
	.interval_sample = 60,
	.interval_aggreg = 300,
	.interval_report = 1800,
	.keep_history = true,
};

static size_t total(const struct app_driver_slot_plan *plans, size_t count)
{
	size_t sum = 0;

	for (size_t i = 0; i < count; i++) {
		sum += plans[i].bytes;
	}

	return sum;
}

ZTEST(plan, test_item_macro)
{
	zassert_equal(m_items[1].key, K_B);
	zassert_equal(m_items[1].key_measurements, K_B__MEASUREMENTS);
	zassert_equal(m_items[1].lrw, APP_DRIVER_LRW_AUTO);
}

ZTEST(plan, test_base_fits_and_grows)
{
	const struct app_driver_demand *demands[] = {&m_meter, NULL, &m_station};
	struct app_driver_slot_plan plans[3];

	int ret = app_driver_pool_plan(demands, 3, &m_lte, POOL_SIZE, plans);

	zassert_ok(ret);
	zassert_true(total(plans, 3) <= POOL_SIZE);

	/* One report period: 1800 / 60 + 1 records, 1800 / 300 + 1 windows, then grown */
	zassert_true(plans[0].rec_cap > 31, "rec_cap %u", plans[0].rec_cap);
	zassert_true(plans[2].win_cap > 7, "win_cap %u", plans[2].win_cap);
	zassert_equal(plans[2].samples_cap, 5);

	/* Unused slot */
	zassert_equal(plans[1].bytes, 0);
	zassert_equal(plans[1].rec_cap, 0);
}

ZTEST(plan, test_growth_is_capped)
{
	static const struct app_driver_demand small = {.rec_size = 16};
	const struct app_driver_demand *demands[] = {&small};
	struct app_driver_slot_plan plan;

	zassert_ok(app_driver_pool_plan(demands, 1, &m_lte, POOL_SIZE, &plan));
	zassert_equal(plan.rec_cap, APP_DRIVER_RING_GROW_MAX);
}

ZTEST(plan, test_no_history_keeps_minimum)
{
	const struct app_driver_plan_params lrw = {
		.interval_sample = 60,
		.interval_aggreg = 300,
		.interval_report = 1800,
		.keep_history = false,
	};
	const struct app_driver_demand *demands[] = {&m_meter, &m_station};
	struct app_driver_slot_plan plans[2];

	zassert_ok(app_driver_pool_plan(demands, 2, &lrw, POOL_SIZE, plans));
	zassert_equal(plans[0].rec_cap, APP_DRIVER_RING_MIN);
	zassert_equal(plans[1].win_cap, APP_DRIVER_RING_MIN);
}

ZTEST(plan, test_fixed_and_unbounded_report)
{
	static const struct app_driver_demand fixed = {.rec_size = 16, .rec_fixed = 32};
	const struct app_driver_plan_params on_demand = {
		.interval_sample = 60,
		.interval_aggreg = 300,
		.interval_report = 0,
		.keep_history = true,
	};
	const struct app_driver_demand *demands[] = {&fixed, &m_meter, &m_station};
	struct app_driver_slot_plan plans[3];

	/* A pool that holds exactly the base plan: no growth */
	size_t base = app_driver_slot_bytes(&fixed, 32, 0, 0) +
		      app_driver_slot_bytes(&m_meter, APP_DRIVER_REC_BASE_MAX / 2, 0, 0) +
		      app_driver_slot_bytes(&m_station, 0, APP_DRIVER_WIN_BASE_MAX, 5);

	zassert_ok(app_driver_pool_plan(demands, 3, &on_demand, base, plans));
	zassert_equal(plans[0].rec_cap, 32);
	zassert_equal(plans[1].rec_cap, APP_DRIVER_REC_BASE_MAX / 2);
	zassert_equal(plans[2].win_cap, APP_DRIVER_WIN_BASE_MAX);
}

ZTEST(plan, test_fixed_records_not_scaled)
{
	static const struct app_driver_demand fixed = {.rec_size = 16, .rec_fixed = 32};
	const struct app_driver_demand *demands[8] = {&fixed};
	struct app_driver_slot_plan plans[8];

	/* Leftover pool does not grow it */
	zassert_ok(app_driver_pool_plan(demands, 1, &m_lte, POOL_SIZE, plans));
	zassert_equal(plans[0].rec_cap, 32);

	/* A tight pool does not shrink it */
	for (int i = 1; i < 8; i++) {
		demands[i] = &m_meter;
	}

	zassert_equal(app_driver_pool_plan(demands, 8, &m_lte, POOL_SIZE, plans), -ENOSPC);
	zassert_equal(plans[0].rec_cap, 32);
	zassert_true(plans[1].rec_cap < 31);
}

ZTEST(plan, test_samples_cap)
{
	const struct app_driver_plan_params fast = {
		.interval_sample = 1,
		.interval_aggreg = 300,
		.interval_report = 1800,
		.keep_history = true,
	};
	static const struct app_driver_item last[] = {
		APP_DRIVER_ITEM("c", "", 4, APP_MODBUS_U16, 1.f, APP_DRIVER_AGGREG_LAST, 1.f, K_C),
	};
	static const struct app_driver_demand no_stats = {.items = last, .item_count = 1};
	const struct app_driver_demand *demands[] = {&m_station, &no_stats};
	struct app_driver_slot_plan plans[2];

	zassert_ok(app_driver_pool_plan(demands, 2, &fast, POOL_SIZE, plans));
	zassert_equal(plans[0].samples_cap, APP_DRIVER_MAX_WINDOW_SAMPLES);
	zassert_equal(plans[1].samples_cap, 0);
}

ZTEST(plan, test_shrink_when_base_does_not_fit)
{
	const struct app_driver_demand *demands[8];
	struct app_driver_slot_plan plans[8];

	for (int i = 0; i < 8; i++) {
		demands[i] = &m_meter;
	}

	int ret = app_driver_pool_plan(demands, 8, &m_lte, POOL_SIZE, plans);

	zassert_equal(ret, -ENOSPC);
	zassert_true(total(plans, 8) <= POOL_SIZE);

	for (int i = 0; i < 8; i++) {
		zassert_true(plans[i].rec_cap >= APP_DRIVER_RING_MIN);
		zassert_true(plans[i].rec_cap < 31, "rec_cap %u", plans[i].rec_cap);
	}
}

ZTEST(plan, test_nomem)
{
	const struct app_driver_demand *demands[] = {&m_meter, &m_meter};
	struct app_driver_slot_plan plans[2];

	zassert_equal(app_driver_pool_plan(demands, 2, &m_lte, 256, plans), -ENOMEM);
}

ZTEST(plan, test_setup_layout_aligned)
{
	static uint8_t pool[POOL_SIZE] __aligned(8);
	const struct app_driver_demand *demands[] = {&m_meter, &m_station};
	struct app_driver_slot_plan plans[2];
	struct app_driver_slot slots[2] = {0};
	uint8_t *p = pool;

	zassert_ok(app_driver_pool_plan(demands, 2, &m_lte, POOL_SIZE, plans));

	for (int i = 0; i < 2; i++) {
		app_driver_slot_setup(&slots[i], demands[i], &plans[i], p, 300);
		p += plans[i].bytes;
		zassert_true(p <= pool + POOL_SIZE);
	}

	zassert_equal((uintptr_t)slots[0].ctx % 8, 0);
	zassert_equal((uintptr_t)slots[0].rec.buf % 8, 0);
	zassert_equal(slots[0].rec.cap, plans[0].rec_cap);
	zassert_is_null(slots[1].ctx);
	zassert_equal((uintptr_t)slots[1].items.state % 8, 0);

	for (size_t i = 0; i < ARRAY_SIZE(m_items); i++) {
		struct app_driver_item_state *st = &slots[1].items.state[i];

		zassert_equal((uintptr_t)st->windows % 8, 0);
		zassert_true(isnan(st->last));

		if (m_items[i].mode == APP_DRIVER_AGGREG_STATS) {
			zassert_equal((uintptr_t)st->samples % 8, 0);
		}
	}

	/* Every record slot is 8-byte aligned too */
	struct meter_record rec = {.timestamp = 1};

	for (int i = 0; i < 3; i++) {
		app_driver_rec_push(&slots[0], &rec);
	}

	zassert_equal((uintptr_t)app_driver_rec_get(&slots[0], 1) % 8, 0);
}

ZTEST_SUITE(plan, NULL, NULL, NULL, NULL, NULL);
```

## src/test_records.c
```c
/*
 * Copyright (c) 2026 HARDWARIO a.s.
 *
 * SPDX-License-Identifier: LicenseRef-HARDWARIO-5-Clause
 *
 * Tests for the raw record ring.
 */

#include "app_driver_store.h"

#include <zephyr/ztest.h>

#include <stdint.h>

#define CAP 4

struct record {
	uint64_t timestamp;
	uint32_t value;
};

static const struct app_driver_demand m_demand = {
	.ctx_size = 12,
	.rec_size = sizeof(struct record),
};

static uint8_t m_mem[256] __aligned(8);
static struct app_driver_slot m_slot;

static void *setup(void)
{
	return NULL;
}

static void before(void *fixture)
{
	struct app_driver_slot_plan plan = {.rec_cap = CAP};

	ARG_UNUSED(fixture);

	plan.bytes = app_driver_slot_bytes(&m_demand, plan.rec_cap, 0, 0);
	zassert_true(plan.bytes <= sizeof(m_mem));

	memset(&m_slot, 0, sizeof(m_slot));
	app_driver_slot_setup(&m_slot, &m_demand, &plan, m_mem, 0);
}

static void push(uint32_t value)
{
	struct record rec = {.timestamp = 1000 + value, .value = value};

	app_driver_rec_push(&m_slot, &rec);
}

static uint32_t value_at(uint32_t seq)
{
	const struct record *rec = app_driver_rec_get(&m_slot, seq);

	zassert_not_null(rec, "seq %u", seq);

	return rec->value;
}

ZTEST(records, test_push_get)
{
	zassert_equal(app_driver_rec_count(&m_slot), 0);
	zassert_is_null(app_driver_rec_get(&m_slot, 0));

	push(10);
	push(11);

	zassert_equal(app_driver_rec_count(&m_slot), 2);
	zassert_equal(app_driver_rec_first(&m_slot), 0);
	zassert_equal(app_driver_rec_end(&m_slot), 2);
	zassert_equal(value_at(0), 10);
	zassert_equal(value_at(1), 11);
	zassert_is_null(app_driver_rec_get(&m_slot, 2));
}

ZTEST(records, test_full_ring_drops_oldest)
{
	for (uint32_t i = 0; i < CAP + 2; i++) {
		push(i);
	}

	zassert_equal(app_driver_rec_count(&m_slot), CAP);
	zassert_equal(app_driver_rec_first(&m_slot), 2);
	zassert_equal(m_slot.drops, 2);
	zassert_is_null(app_driver_rec_get(&m_slot, 1));
	zassert_equal(value_at(2), 2);
	zassert_equal(value_at(CAP + 1), CAP + 1);
}

ZTEST(records, test_pop_until_after_concurrent_push)
{
	push(0);
	push(1);
	push(2);

	/* Sender encodes [first, end) */
	uint32_t end = app_driver_rec_end(&m_slot);

	/* Meanwhile the ring overflows: records 0 and 1 are dropped */
	push(3);
	push(4);
	push(5);

	zassert_equal(app_driver_rec_first(&m_slot), 2);

	/* Only what was encoded is removed; 3, 4 and 5 stay */
	app_driver_rec_pop_until(&m_slot, end);

	zassert_equal(app_driver_rec_first(&m_slot), 3);
	zassert_equal(app_driver_rec_count(&m_slot), 3);
	zassert_equal(value_at(3), 3);
}

ZTEST(records, test_pop_until_bounds)
{
	push(0);
	push(1);

	/* Stale end before tail: no change */
	app_driver_rec_pop_until(&m_slot, 0);
	zassert_equal(app_driver_rec_count(&m_slot), 2);

	/* End beyond head: everything */
	app_driver_rec_pop_until(&m_slot, 100);
	zassert_equal(app_driver_rec_count(&m_slot), 0);
	zassert_equal(app_driver_rec_first(&m_slot), 2);

	/* Sequence numbers continue */
	push(7);
	zassert_equal(value_at(2), 7);
}

ZTEST(records, test_clear)
{
	push(0);
	push(1);

	app_driver_slot_clear(&m_slot);

	zassert_equal(app_driver_rec_count(&m_slot), 0);
	zassert_equal(app_driver_rec_end(&m_slot), 2);
}

ZTEST(records, test_no_capacity)
{
	struct app_driver_slot probe = {0};
	struct app_driver_slot_plan plan = {0};
	uint8_t mem[16] __aligned(8);

	plan.bytes = app_driver_slot_bytes(&m_demand, 0, 0, 0);
	app_driver_slot_setup(&probe, &m_demand, &plan, mem, 0);

	struct record rec = {0};

	app_driver_rec_push(&probe, &rec);

	zassert_equal(app_driver_rec_count(&probe), 0);
	zassert_is_null(app_driver_rec_get(&probe, 0));
	zassert_not_null(probe.ctx);
}

ZTEST_SUITE(records, NULL, setup, before, NULL, NULL);
```
