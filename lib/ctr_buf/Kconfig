## subsys/ctr_lte_v2/Kconfig
```kconfig
#
# Copyright (c) 2023 HARDWARIO a.s.
#
# SPDX-License-Identifier: LicenseRef-HARDWARIO-5-Clause
#

config CTR_LTE_V2
	bool "CTR_LTE_V2"
	select CTR_LTE_LINK if !ZTEST
	select CTR_RFMUX if !ZTEST
	select CTR_INFO if !ZTEST
	select CTR_CONFIG
	select CTR_UTIL
	select PM_DEVICE
	select RING_BUFFER

if CTR_LTE_V2

choice
	prompt "CTR_LTE_V2_CONFIG_ANTENNA"
	default CTR_LTE_V2_CONFIG_ANTENNA_INT

config CTR_LTE_V2_CONFIG_ANTENNA_INT
	bool "CTR_LTE_V2_CONFIG_ANTENNA_INT"

config CTR_LTE_V2_CONFIG_ANTENNA_EXT
	bool "CTR_LTE_V2_CONFIG_ANTENNA_EXT"
endchoice

config CTR_LTE_V2_CONFIG_ANTENNA
	int "CTR_LTE_V2_CONFIG_ANTENNA"
	default 0 if CTR_LTE_V2_CONFIG_ANTENNA_INT
	default 1 if CTR_LTE_V2_CONFIG_ANTENNA_EXT

config CTR_LTE_V2_DEFAULT_MODE
	string "CTR_LTE_V2_DEFAULT_MODE"
	default "nb-iot"

config CTR_LTE_V2_DEFAULT_BANDS
	string "CTR_LTE_V2_DEFAULT_BANDS"
	default ""
	help
		original value: "2,4,5,8,12,13,17,18,19,20,25,26,28,66"

config CTR_LTE_V2_DEFAULT_NETWORK
	string "CTR_LTE_V2_DEFAULT_NETWORK"
	default ""

config CTR_LTE_V2_DEFAULT_APN
	string "CTR_LTE_V2_DEFAULT_APN"
	default ""
	help
		original value: "hardwario"

config CTR_LTE_V2_DEFAULT_ADDR
	string "CTR_LTE_V2_DEFAULT_ADDR"
	default "192.168.192.4"

config CTR_LTE_V2_PORT
	int "CTR_LTE_V2_PORT"
	default 5003

config CTR_LTE_V2_INIT_PRIORITY
	int "CTR_LTE_V2_INIT_PRIORITY"
	default 99

config CTR_LTE_V2_THREAD_STACK_SIZE
	int "CTR_LTE_V2_THREAD_STACK_SIZE"
	default 4096

config CTR_LTE_V2_THREAD_PRIORITY
	int "CTR_LTE_V2_THREAD_PRIORITY"
	default 10

config CTR_LTE_V2_GNSS
	bool "CTR_LTE_V2_GNSS"
	default y

# === Phase 2: multi-consumer registration ===
# Zero registered consumers ⇒ all new code paths are no-ops ⇒ behaviour is
# bit-identical to pre-Phase-2.

config CTR_LTE_V2_MAX_CONSUMERS
	int "Max registered LTE consumers"
	default 4
	range 1 16
	help
	  Capacity of the runtime consumer registry used by
	  ctr_lte_v2_consumer_register(). 4 is enough for ctr_cloud +
	  belter_mqtt + future growth without overshooting RAM.

# === Phase 2: idle profile (PSM vs eDRX-no-PSM) ===
# The default (CTR_LTE_V2_IDLE_PROFILE_PSM) reproduces the pre-Phase-2
# behaviour: AT+CPSMS=1,,,"00111000","00000000" issued during flow_prepare.
# Existing builds that do not select the EDRX_NO_PSM variant compile and
# behave bit-identically.

choice CTR_LTE_V2_IDLE_PROFILE
	prompt "LTE idle profile"
	default CTR_LTE_V2_IDLE_PROFILE_PSM

config CTR_LTE_V2_IDLE_PROFILE_PSM
	bool "PSM (legacy, downlink unreachable during PSM)"
	help
	  AT+CPSMS=1,,,"00111000","00000000". Lowest idle current but the
	  modem is unreachable for downlink during PSM. Use for upstream-
	  only sensor workloads (e.g. HARDWARIO Cloud-only ctr_cloud).

config CTR_LTE_V2_IDLE_PROFILE_EDRX_NO_PSM
	bool "eDRX-no-PSM (reachable downlink, higher idle)"
	help
	  AT+CPSMS=0 + AT+CEDRXS=2,<act>,"<cycle>". Required for any
	  consumer that needs downlink reachability inside one eDRX cycle
	  (e.g. MQTT subscribe). Idle current is higher than PSM but the
	  modem responds to paging within the configured cycle.

endchoice

config CTR_LTE_V2_EDRX_CYCLE_LTEM
	string "eDRX cycle on LTE-M (4-bit binary)"
	default "0001"
	depends on CTR_LTE_V2_IDLE_PROFILE_EDRX_NO_PSM
	help
	  3GPP TS 24.008 Table 10.5.5.32 (eDRX value), AcT=4 / LTE-M.
	  "0001" = 10.24 s (LTE-M minimum useful). "0010" = 20.48 s.
	  "0011" = 40.96 s. Shorter cycle = lower downlink latency, higher
	  idle current.

config CTR_LTE_V2_EDRX_CYCLE_NBIOT
	string "eDRX cycle on NB-IoT (4-bit binary)"
	default "0010"
	depends on CTR_LTE_V2_IDLE_PROFILE_EDRX_NO_PSM
	help
	  3GPP TS 24.008 Table 10.5.5.32, AcT=5 / NB-IoT. "0010" = 20.48 s
	  is the NB-IoT minimum valid value. "0001" is invalid on NB-IoT
	  and the network will silently refuse. See memory anchor
	  project_nb_iot_edrx_encoding_per_rat.

config HEAP_MEM_POOL_SIZE
	int "HEAP_MEM_POOL_SIZE"
	default 8192

module = CTR_LTE_V2
module-str = CHESTER LTE Subsystem
source "subsys/logging/Kconfig.template.log_config"

endif # CTR_LTE_V2
```

## subsys/ctr_machine_probe/Kconfig
```kconfig
#
# Copyright (c) 2023 HARDWARIO a.s.
#
# SPDX-License-Identifier: LicenseRef-HARDWARIO-5-Clause
#

config CTR_MACHINE_PROBE
	bool "CTR_MACHINE_PROBE"
	select CBPRINTF_FP_SUPPORT if CTR_MACHINE_PROBE_DBG
	select CTR_W1
	select DS28E17
	select GPIO
	select I2C
	select REQUIRES_FULL_LIBC
	select W1_DS2484

if CTR_MACHINE_PROBE

module = CTR_MACHINE_PROBE
module-str = CHESTER Machine Probe Subsystem
source "subsys/logging/Kconfig.template.log_config"

endif # CTR_MACHINE_PROBE
```

## subsys/ctr_radon/Kconfig
```kconfig
#
# Copyright (c) 2023 HARDWARIO a.s.
#
# SPDX-License-Identifier: LicenseRef-HARDWARIO-5-Clause
#

config CTR_RADON
	bool "CTR_RADON"
	default n
	depends on CTR_CONFIG
	depends on DT_HAS_NXP_SC16IS7XX_ENABLED
	depends on MODBUS

if CTR_RADON

module = CTR_RADON
module-str = CHESTER Piketronic Radon Subsystem
source "subsys/logging/Kconfig.template.log_config"

config CTR_RADON_SHELL
	bool "CTR_RADON_SHELL"
	depends on SHELL
	default y
	
choice CTR_RADON_SLOT
	bool "CTR_RADON_SLOT"
	default CTR_RADON_SLOT_A
	default CTR_RADON_SLOT_B if CTR_X2_MODBUS_B

config CTR_RADON_SLOT_A
	bool "Slot A"

config CTR_RADON_SLOT_B
	bool "Slot B"

endchoice

endif # CTR_RADON
```

## subsys/ctr_rtc/Kconfig
```kconfig
#
# Copyright (c) 2023 HARDWARIO a.s.
#
# SPDX-License-Identifier: LicenseRef-HARDWARIO-5-Clause
#

config CTR_RTC
	bool "CTR_RTC"
	depends on SHELL
	select EVENTS
	select NRFX_RTC2
	select POLL

if CTR_RTC

module = CTR_RTC
module-str = CHESTER Real-time Clock Subsystem
source "subsys/logging/Kconfig.template.log_config"

config CTR_RTC_INIT_PRIORITY
	int "Initialization priority"
	default 3

endif # CTR_RTC
```

## subsys/ctr_rtd/Kconfig
```kconfig
#
# Copyright (c) 2023 HARDWARIO a.s.
#
# SPDX-License-Identifier: LicenseRef-HARDWARIO-5-Clause
#

config CTR_RTD
	bool "CTR_RTD"
	depends on CTR_X3
	select CBPRINTF_FP_SUPPORT if CTR_RTD_LOG_LEVEL_DBG || CTR_RTD_SHELL
	select REQUIRES_FULL_LIBC

if CTR_RTD

module = CTR_RTD
module-str = CHESTER Resistance Temperature Detectors Subsystem
source "subsys/logging/Kconfig.template.log_config"

config CTR_RTD_SHELL
	bool "CTR_RTD_SHELL"
	depends on SHELL
	default y

endif # CTR_RTD
```
