## lib/ctr_buf/Kconfig
```kconfig
#
# Copyright (c) 2023 HARDWARIO a.s.
#
# SPDX-License-Identifier: LicenseRef-HARDWARIO-5-Clause
#

config CTR_BUF
	bool "CTR_BUF"
```

## subsys/Kconfig
```kconfig
#
# Copyright (c) 2023 HARDWARIO a.s.
#
# SPDX-License-Identifier: LicenseRef-HARDWARIO-5-Clause
#

menu "Subsystems"

rsource "ctr_accel/Kconfig"
rsource "ctr_adc/Kconfig"
rsource "ctr_ble/Kconfig"
rsource "ctr_button/Kconfig"
rsource "ctr_config/Kconfig"
rsource "ctr_ds18b20/Kconfig"
rsource "ctr_edge/Kconfig"
rsource "ctr_flash/Kconfig"
rsource "ctr_gnss/Kconfig"
rsource "ctr_gpio/Kconfig"
rsource "ctr_hygro/Kconfig"
rsource "ctr_info/Kconfig"
rsource "ctr_led/Kconfig"
rsource "ctr_lrw/Kconfig"
rsource "ctr_lte/Kconfig"
rsource "ctr_machine_probe/Kconfig"
rsource "ctr_rtc/Kconfig"
rsource "ctr_rtd/Kconfig"
rsource "ctr_signal/Kconfig"
rsource "ctr_soil_sensor/Kconfig"
rsource "ctr_test/Kconfig"
rsource "ctr_therm/Kconfig"
rsource "ctr_w1/Kconfig"
rsource "ctr_wdog/Kconfig"
rsource "ctr_weight_probe/Kconfig"

endmenu
```

## subsys/ctr_accel/Kconfig
```kconfig
#
# Copyright (c) 2023 HARDWARIO a.s.
#
# SPDX-License-Identifier: LicenseRef-HARDWARIO-5-Clause
#

config CTR_ACCEL
	bool "CTR_ACCEL"
	select CBPRINTF_FP_SUPPORT if CTR_ACCEL_LOG_LEVEL_DBG || CTR_ACCEL_SHELL
	select I2C
	select LIS2DH
	select REQUIRES_FULL_LIBC
	select SENSOR

if CTR_ACCEL

module = CTR_ACCEL
module-str = CHESTER Accelerometer Subsystem
source "subsys/logging/Kconfig.template.log_config"

config CTR_ACCEL_SHELL
	bool "CTR_ACCEL_SHELL"
	depends on SHELL
	default y

choice LIS2DH_ACCEL_RANGE
	default LIS2DH_ACCEL_RANGE_4G
endchoice

config LIS2DH_BLOCK_DATA_UPDATE
	default y

choice LIS2DH_ODR
	default LIS2DH_ODR_2
endchoice

choice LIS2DH_TRIGGER_MODE
	default LIS2DH_TRIGGER_GLOBAL_THREAD
endchoice

endif # CTR_ACCEL
```

## subsys/ctr_adc/Kconfig
```kconfig
#
# Copyright (c) 2023 HARDWARIO a.s.
#
# SPDX-License-Identifier: LicenseRef-HARDWARIO-5-Clause
#

config CTR_ADC
	bool "CTR_ADC"
	select ADC

if CTR_ADC

module = CTR_ADC
module-str = CHESTER ADC Subsystem
source "subsys/logging/Kconfig.template.log_config"

endif # CTR_ADC
```

## subsys/ctr_ble/Kconfig
```kconfig
#
# Copyright (c) 2025 HARDWARIO a.s.
#
# SPDX-License-Identifier: LicenseRef-HARDWARIO-5-Clause
#

config CTR_BLE
	bool "CTR_BLE"
	select BT
	select BT_CTLR
	select BT_DEVICE_NAME_DYNAMIC
	select BT_FIXED_PASSKEY
	select BT_NUS
	select BT_NUS_AUTHEN
	select BT_PERIPHERAL
	select BT_SETTINGS
	select BT_SMP
	select BT_SMP_SC_ONLY
	select BT_TINYCRYPT_ECC
	select CRC
	select CTR_CONFIG
	select CTR_INFO
	select CTR_SHELL
	select SHELL_BACKEND_DUMMY
	select NET_BUF
	select ZCBOR

if CTR_BLE

module = CTR_BLE
module-str = CHESTER BLE Subsystem
source "subsys/logging/Kconfig.template.log_config"

config CTR_BLE_DFU
	bool "Enable DFU over BLE"
	default y
	select DFU_TARGET
	select DFU_TARGET_STREAM
	select DFU_TARGET_MCUBOOT
	select IMG_MANAGER
	select BOOTLOADER_MCUBOOT
	select STREAM_FLASH
	select STREAM_FLASH_ERASE
	select MCUMGR
	select MCUMGR_GRP_IMG
	select MCUMGR_GRP_OS
	select MCUMGR_GRP_SHELL
	select MCUMGR_TRANSPORT_BT
	select MCUMGR_TRANSPORT_BT_CONN_PARAM_CONTROL
	select MCUMGR_TRANSPORT_BT_REASSEMBLY
	select OS_MGMT_MCUMGR_PARAMS

config CTR_BLE_CLIENT
	bool "Enable BLE client"
	default n
	select BT_GATT_CLIENT
	select BT_CENTRAL
	select BT_SMP

choice BT_CTLR_TX_PWR
	default BT_CTLR_TX_PWR_PLUS_8
endchoice

config BT_AUTO_PHY_UPDATE
	default n

config BT_BUF_ACL_RX_SIZE
	default 502

config BT_BUF_ACL_TX_COUNT
	default 10

config BT_BUF_ACL_TX_SIZE
	default 251

config BT_CONN_TX_MAX
	default 10

config BT_CTLR_DATA_LENGTH_MAX
	default 251

config BT_CTLR_RX_BUFFERS
	default 10

config BT_DEVICE_NAME
	default "CHESTER"

config BT_LONG_WQ_STACK_SIZE
	default 2048

config BT_HCI_TX_STACK_SIZE
	default 2048

config BT_ID_MAX
	default 5

config BT_L2CAP_TX_BUF_COUNT
	default 10

config BT_L2CAP_TX_MTU
	default 498

config BT_MAX_CONN
	default 4

config BT_MAX_PAIRED
	default 8

config BT_PERIPHERAL_PREF_MAX_INT
	default 6

config BT_PERIPHERAL_PREF_MIN_INT
	default 6

config BT_PERIPHERAL_PREF_TIMEOUT
	default 400

config BT_RX_STACK_SIZE
	default 4096

config MPSL_WORK_STACK_SIZE
	default 2048

config SHELL_BT_NUS_RX_RING_BUFFER_SIZE
	default 1024

config SHELL_BT_NUS_TX_RING_BUFFER_SIZE
	default 1024

endif # CTR_BLE
```

## subsys/ctr_button/Kconfig
```kconfig
#
# Copyright (c) 2023 HARDWARIO a.s.
#
# SPDX-License-Identifier: LicenseRef-HARDWARIO-5-Clause
#

config CTR_BUTTON
	bool "CTR_BUTTON"
	depends on SHELL
	select GPIO
	select CTR_EDGE

if CTR_BUTTON

module = CTR_BUTTON
module-str = CHESTER Button Subsystem
source "subsys/logging/Kconfig.template.log_config"

config CTR_BUTTON_INIT_PRIORITY
	int "Initialization priority"
	default APPLICATION_INIT_PRIORITY

endif # CTR_BUTTON
```

## subsys/ctr_cloud/Kconfig
```kconfig
#
# Copyright (c) 2023 HARDWARIO a.s.
#
# SPDX-License-Identifier: LicenseRef-HARDWARIO-5-Clause
#

config CTR_CLOUD
	bool "CTR_CLOUD"
	depends on SHIELD_CTR_LTE_V2
	select CTR_BUF
	select CTR_INFO
	select CTR_RTC
	select EVENTS
	select TINYCRYPT_SHA256
	select TINYCRYPT
	select ZCBOR
	select ZCBOR_STOP_ON_ERROR
	select SHELL
	select SHELL_BACKEND_DUMMY
	select BASE64

if CTR_CLOUD

module = CTR_CLOUD
module-str = CHESTER CLOUD Subsystem
source "subsys/logging/Kconfig.template.log_config"

config SHELL_BACKEND_DUMMY_BUF_SIZE
	int "SHELL_BACKEND_DUMMY_BUF_SIZE"
	default 8192

endif # CTR_CLOUD
```

## subsys/ctr_config/Kconfig
```kconfig
#
# Copyright (c) 2023 HARDWARIO a.s.
#
# SPDX-License-Identifier: LicenseRef-HARDWARIO-5-Clause
#

config CTR_CONFIG
	bool "CTR_CONFIG"
	depends on SHELL
	select FLASH
	select FLASH_MAP
	select NVS
	select REBOOT
	select SETTINGS
	select SETTINGS_RUNTIME

if CTR_CONFIG

module = CTR_CONFIG
module-str = CHESTER Configuration Subsystem
source "subsys/logging/Kconfig.template.log_config"

config CTR_CONFIG_INIT_PRIORITY
	int "Initialization priority"
	default 0

endif # CTR_CONFIG
```

## subsys/ctr_ds18b20/Kconfig
```kconfig
#
# Copyright (c) 2023 HARDWARIO a.s.
#
# SPDX-License-Identifier: LicenseRef-HARDWARIO-5-Clause
#

config CTR_DS18B20
	bool "CTR_DS18B20"
	select CBPRINTF_FP_SUPPORT if CTR_DS18B20_LOG_LEVEL_DBG || CTR_DS18B20_SHELL
	select CTR_W1
	select DS18B20
	select GPIO
	select I2C
	select SENSOR
	select W1_DS2484

if CTR_DS18B20

module = CTR_DS18B20
module-str = CHESTER DS18B20 Subsystem
source "subsys/logging/Kconfig.template.log_config"

config CTR_DS18B20_SHELL
	bool "CTR_DS18B20_SHELL"
	depends on SHELL
	default y

endif # CTR_DS18B20
```

## subsys/ctr_edge/Kconfig
```kconfig
#
# Copyright (c) 2023 HARDWARIO a.s.
#
# SPDX-License-Identifier: LicenseRef-HARDWARIO-5-Clause
#

config CTR_EDGE
	bool "CTR_EDGE"
	depends on GPIO

if CTR_EDGE

module = CTR_EDGE
module-str = CHESTER Edge Filtering Subsystem
source "subsys/logging/Kconfig.template.log_config"

endif # CTR_EDGE
```

## subsys/ctr_flash/Kconfig
```kconfig
#
# Copyright (c) 2023 HARDWARIO a.s.
#
# SPDX-License-Identifier: LicenseRef-HARDWARIO-5-Clause
#

config CTR_FLASH
	bool "CTR_FLASH"
	select FLASH_PAGE_LAYOUT
	select FLASH
	select PM_DEVICE
	select SPI

if CTR_FLASH

module = CTR_FLASH
module-str = CHESTER External Flash Subsystem
source "subsys/logging/Kconfig.template.log_config"

config CTR_FLASH_INIT_PRIORITY
	int "Initialization priority"
	default 0

endif # CTR_FLASH
```

## subsys/ctr_gnss/Kconfig
```kconfig
#
# Copyright (c) 2023 HARDWARIO a.s.
#
# SPDX-License-Identifier: LicenseRef-HARDWARIO-5-Clause
#

config CTR_GNSS
	bool "CTR_GNSS"
	select CBPRINTF_FP_SUPPORT if CTR_GNSS_LOG_LEVEL_DBG
	select GNSS if SHIELD_CTR_GNSS
	select GNSS_M8 if SHIELD_CTR_GNSS
	select I2C if SHIELD_CTR_GNSS
	select CTR_INFO
	depends on SHIELD_CTR_GNSS || CTR_LTE_V2_GNSS

if CTR_GNSS

config CTR_GNSS_M8
	bool "CTR_GNSS_M8"
	default y if SHIELD_CTR_GNSS

config CTR_GNSS_INIT_PRIORITY
	int "Initialization priority"
	default APPLICATION_INIT_PRIORITY

config CTR_GNSS_THREAD_PRIORITY
	int "CTR_GNSS_THREAD_PRIORITY"
	default 10

config CTR_GNSS_THREAD_STACK_SIZE
	int "CTR_GNSS_THREAD_STACK_SIZE"
	default 2048

config CTR_GNSS_SHELL
	bool "CTR_GNSS_SHELL"
	default y

module = CTR_GNSS
module-str = CHESTER GNSS Subsystem
source "subsys/logging/Kconfig.template.log_config"

endif # CTR_GNSS
```

## subsys/ctr_gpio/Kconfig
```kconfig
#
# Copyright (c) 2023 HARDWARIO a.s.
#
# SPDX-License-Identifier: LicenseRef-HARDWARIO-5-Clause
#

config CTR_GPIO
	bool "CTR_GPIO"
	depends on GPIO

if CTR_GPIO

module = CTR_GPIO
module-str = CHESTER GPIO Subsystem
source "subsys/logging/Kconfig.template.log_config"

endif # CTR_GPIO
```

## subsys/ctr_hygro/Kconfig
```kconfig
#
# Copyright (c) 2023 HARDWARIO a.s.
#
# SPDX-License-Identifier: LicenseRef-HARDWARIO-5-Clause
#

config CTR_HYGRO
	bool "CTR_HYGRO"
	select CBPRINTF_FP_SUPPORT if CTR_HYGRO_LOG_LEVEL_DBG || CTR_HYGRO_SHELL
	select I2C
	select SENSOR
	select SHT3XD

if CTR_HYGRO

module = CTR_HYGRO
module-str = CHESTER Hygrometer Subsystem
source "subsys/logging/Kconfig.template.log_config"

choice SHT3XD_MEASUREMENT_MODE
 	default SHT3XD_SINGLE_SHOT_MODE
endchoice

config CTR_HYGRO_SHELL
	bool "CTR_HYGRO_SHELL"
	depends on SHELL
	default y

endif # CTR_HYGRO
```

## subsys/ctr_info/Kconfig
```kconfig
#
# Copyright (c) 2023 HARDWARIO a.s.
#
# SPDX-License-Identifier: LicenseRef-HARDWARIO-5-Clause
#

config CTR_INFO
	bool "CTR_INFO"
	select CRC

if CTR_INFO

config CTR_INFO_BLE
	depends on BT
	bool "CTR_INFO_BLE"
	default y

config CTR_INFO_SHELL
	depends on SHELL
	bool "CTR_INFO_SHELL"
	default y

config CTR_INFO_INIT_PRIORITY
	int "Initialization priority"
	default 0

module = CTR_INFO
module-str = CHESTER Firmware Information Subsystem
source "subsys/logging/Kconfig.template.log_config"

endif # CTR_INFO
```

## subsys/ctr_led/Kconfig
```kconfig
#
# Copyright (c) 2023 HARDWARIO a.s.
#
# SPDX-License-Identifier: LicenseRef-HARDWARIO-5-Clause
#

config CTR_LED
	bool "CTR_LED"
	select LED

if CTR_LED

module = CTR_LED
module-str = CHESTER LED Subsystem
source "subsys/logging/Kconfig.template.log_config"

config CTR_LED_SHELL
	bool "CTR_LED_SHELL"
	depends on SHELL
	default y

config CTR_LED_INIT_PRIORITY
	int "Initialization priority"
	default APPLICATION_INIT_PRIORITY

endif # CTR_LED
```

## subsys/ctr_lrw/Kconfig
```kconfig
#
# Copyright (c) 2023 HARDWARIO a.s.
#
# SPDX-License-Identifier: LicenseRef-HARDWARIO-5-Clause
#

config CTR_LRW
	bool "CTR_LRW"
	default y
	depends on DT_HAS_HARDWARIO_CTR_LRW_IF_ENABLED
	select CTR_CONFIG
	select CTR_RFMUX
	select CTR_SHELL
	select CTR_UTIL
	select PM_DEVICE
	select REQUIRES_FULL_LIBC
	select RING_BUFFER

if CTR_LRW

config CTR_LRW_THREAD_STACK_SIZE
	int "CTR_LRW_THREAD_STACK_SIZE"
	default 4096

config CTR_LRW_THREAD_PRIORITY
	int "CTR_LRW_THREAD_PRIORITY"
	default 10

module = CTR_LRW
module-str = CHESTER LoRaWAN Subsystem
source "subsys/logging/Kconfig.template.log_config"

endif # CTR_LRW
```

## subsys/ctr_lrw_v2/Kconfig
```kconfig
#
# Copyright (c) 2023 HARDWARIO a.s.
#
# SPDX-License-Identifier: LicenseRef-HARDWARIO-5-Clause
#

config CTR_LRW_V2
	bool "CTR_LRW_V2"
	select CTR_CONFIG
	select CTR_LRW_LINK
	select CTR_RFMUX
	select CTR_SHELL
	select CTR_UTIL
	select EVENTS
	select PM_DEVICE
	select REQUIRES_FULL_LIBC
	select RING_BUFFER

if CTR_LRW_V2

config CTR_LRW_V2_INIT_PRIORITY
	int "CTR_LRW_V2_INIT_PRIORITY"
	default 99

config CTR_LRW_V2_CONFIG_INIT_PRIORITY
	int "CTR_LRW_V2_CONFIG_INIT_PRIORITY"
	default 98

config CTR_LRW_V2_THREAD_STACK_SIZE
	int "CTR_LRW_THREAD_STACK_SIZE"
	default 4096

config CTR_LRW_V2_THREAD_PRIORITY
	int "CTR_LRW_THREAD_PRIORITY"
	default 10

module = CTR_LRW_V2
module-str = CHESTER LoRaWAN Subsystem
source "subsys/logging/Kconfig.template.log_config"

endif # CTR_LRW_V2
```

## subsys/ctr_lte/Kconfig
```kconfig
#
# Copyright (c) 2023 HARDWARIO a.s.
#
# SPDX-License-Identifier: LicenseRef-HARDWARIO-5-Clause
#

config CTR_LTE
	bool "CTR_LTE"
	default y
	depends on DT_HAS_HARDWARIO_CTR_LTE_IF_ENABLED
	select CTR_CONFIG
	select CTR_RFMUX
	select CTR_SHELL
	select CTR_UTIL
	select PM_DEVICE
	select REQUIRES_FULL_LIBC
	select RING_BUFFER

if CTR_LTE

config CTR_LTE_CLKSYNC
	bool "CTR_LTE_CLKSYNC"

config CTR_LTE_THREAD_STACK_SIZE
	int "CTR_LTE_THREAD_STACK_SIZE"
	default 4096

config CTR_LTE_THREAD_PRIORITY
	int "CTR_LTE_THREAD_PRIORITY"
	default 10

module = CTR_LTE
module-str = CHESTER LTE Subsystem
source "subsys/logging/Kconfig.template.log_config"

endif # CTR_LTE
```
