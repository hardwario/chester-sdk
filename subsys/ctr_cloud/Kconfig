## subsys/ctr_cloud/Kconfig
```kconfig
#
# Copyright (c) 2023 HARDWARIO a.s.
#
# SPDX-License-Identifier: LicenseRef-HARDWARIO-5-Clause
#

config CTR_CLOUD
	bool "CTR_CLOUD"
	depends on SHIELD_CTR_LTE_V2
	select CTR_BUF
	select CTR_INFO
	select CTR_RTC
	select EVENTS
	select PSA_CRYPTO
	select PSA_WANT_ALG_SHA_256
	select ZCBOR
	select ZCBOR_STOP_ON_ERROR
	select SHELL
	select SHELL_BACKEND_DUMMY
	select BASE64

if CTR_CLOUD

module = CTR_CLOUD
module-str = CHESTER CLOUD Subsystem
source "subsys/logging/Kconfig.template.log_config"

config SHELL_BACKEND_DUMMY_BUF_SIZE
	int "SHELL_BACKEND_DUMMY_BUF_SIZE"
	default 8192

config CTR_CLOUD_TRANSFER_BUF_SIZE
	int "Cloud transfer buffer size in bytes"
	default 16384

config CTR_CLOUD_ENCODE_ZCBOR_STATES
	int "Number of zcbor backup states for message encoding"
	default 2
	range 0 32
	help
	  Number of zcbor backup states available to the encoding callback
	  of a data message. Backup states are consumed only by canonical
	  encoding of maps and lists (CONFIG_ZCBOR_CANONICAL), where each
	  level of nesting needs one, and by zcbor_bstr_start_encode().
	  Encoding with indefinite-length maps and lists, as done today,
	  needs none, so the default 2 is just a small reserve.

	  The states are allocated on the stack of the thread calling the
	  send function, not in static RAM: (N + 2) * sizeof(zcbor_state_t),
	  that is 36 bytes per state on 32-bit targets, 144 bytes at the
	  default of 2. Increase the value when sending fails with -ENOMEM
	  (zcbor ran out of backup states: messages nested deeper with
	  canonical encoding or bstr wrapping), decrease it to save stack.

config CTR_CLOUD_CONFIG
	bool

config CTR_CLOUD_SPOOL
	bool "Enable CLOUD message spool"
	select CTR_CLOUD_CONFIG

if CTR_CLOUD_SPOOL

choice
	prompt "CLOUD spool storage backend"
	default CTR_CLOUD_SPOOL_BACKEND_LITTLEFS

config CTR_CLOUD_SPOOL_BACKEND_LITTLEFS
	bool "LittleFS backend"
	select FILE_SYSTEM
	select FILE_SYSTEM_LITTLEFS

endchoice

endif # CTR_CLOUD_SPOOL

endif # CTR_CLOUD
```

## subsys/ctr_lte_v2/Kconfig
```kconfig
#
# Copyright (c) 2023 HARDWARIO a.s.
#
# SPDX-License-Identifier: LicenseRef-HARDWARIO-5-Clause
#

config CTR_LTE_V2
	bool "CTR_LTE_V2"
	select CTR_LTE_LINK if !ZTEST
	select CTR_RFMUX if !ZTEST
	select CTR_INFO if !ZTEST
	select CTR_CONFIG
	select CTR_UTIL
	select PM_DEVICE
	select RING_BUFFER

if CTR_LTE_V2

choice
	prompt "CTR_LTE_V2_CONFIG_ANTENNA"
	default CTR_LTE_V2_CONFIG_ANTENNA_INT

config CTR_LTE_V2_CONFIG_ANTENNA_INT
	bool "CTR_LTE_V2_CONFIG_ANTENNA_INT"

config CTR_LTE_V2_CONFIG_ANTENNA_EXT
	bool "CTR_LTE_V2_CONFIG_ANTENNA_EXT"
endchoice

config CTR_LTE_V2_CONFIG_ANTENNA
	int "CTR_LTE_V2_CONFIG_ANTENNA"
	default 0 if CTR_LTE_V2_CONFIG_ANTENNA_INT
	default 1 if CTR_LTE_V2_CONFIG_ANTENNA_EXT

config CTR_LTE_V2_DEFAULT_MODE
	string "CTR_LTE_V2_DEFAULT_MODE"
	default "lte-m,nb-iot"

config CTR_LTE_V2_DEFAULT_BANDS
	string "CTR_LTE_V2_DEFAULT_BANDS"
	default ""
	help
		original value: "2,4,5,8,12,13,17,18,19,20,25,26,28,66"

config CTR_LTE_V2_DEFAULT_NETWORK
	string "CTR_LTE_V2_DEFAULT_NETWORK"
	default ""

config CTR_LTE_V2_DEFAULT_APN
	string "CTR_LTE_V2_DEFAULT_APN"
	default ""
	help
		original value: "hardwario"

config CTR_LTE_V2_DEFAULT_ADDR
	string "CTR_LTE_V2_DEFAULT_ADDR"
	default "192.168.192.4"

config CTR_LTE_V2_PORT
	int "CTR_LTE_V2_PORT"
	default 5003

config CTR_LTE_V2_INIT_PRIORITY
	int "CTR_LTE_V2_INIT_PRIORITY"
	default 99

config CTR_LTE_V2_THREAD_STACK_SIZE
	int "CTR_LTE_V2_THREAD_STACK_SIZE"
	default 4096

config CTR_LTE_V2_THREAD_PRIORITY
	int "CTR_LTE_V2_THREAD_PRIORITY"
	default 10

config CTR_LTE_V2_GNSS
	bool "CTR_LTE_V2_GNSS"
	default y

config CTR_LTE_V2_CAUSE_STR
	bool "CTR_LTE_V2_CAUSE_STR"
	default y
	help
		Texts of the EMM and ESM causes (3GPP TS 24.301) in the log and the
		shell, with a hint for the common ones (a few kB of flash, no RAM).
		Without them only the numbers are shown.

config CTR_LTE_V2_CEREG_HISTORY
	int "CTR_LTE_V2_CEREG_HISTORY"
	default 5
	range 0 20
	help
		Registration status changes (CEREG) kept for 'lte history', e.g. to
		see a device hopping between cells or getting rejected (16 B of
		RAM each). 0 keeps only the last reject.

config CTR_LTE_V2_SCAN
	bool "CTR_LTE_V2_SCAN"
	default n
	help
		Neighbour cell measurement ('lte ncellmeas') and network scan ('lte scan')
		for diagnostics (about 1.5 kB of RAM). The scan takes the device offline
		for minutes and ends with a modem reset and a new attach.

config HEAP_MEM_POOL_SIZE
	int "HEAP_MEM_POOL_SIZE"
	default 8192

module = CTR_LTE_V2
module-str = CHESTER LTE Subsystem
source "subsys/logging/Kconfig.template.log_config"

endif # CTR_LTE_V2
```

## tests/subsys/ctr_cloud_transfer/testcase.yaml
```yaml
tests:
  subsys.ctr_cloud_transfer:
    tags: chester
    platform_allow:
      - native_sim
    integration_platforms:
      - native_sim
```

## tests/subsys/ctr_lte_v2/testcase.yaml
```yaml
common:
  tags:
      - chester
  platform_allow: native_sim
  integration_platforms:
    - native_sim

tests:
  subsys.ctr_lte_v2.parser:
    extra_args:
      - CONFIG_TEST_FEATURE_PARSING=y
      - CONFIG_CTR_LTE_V2_SCAN=y
      - CONFIG_CTR_LTE_V2_CEREG_HISTORY=3

  subsys.ctr_lte_v2.parser_no_cause_str:
    extra_args:
      - CONFIG_TEST_FEATURE_PARSING=y
      - CONFIG_CTR_LTE_V2_CAUSE_STR=n
      - CONFIG_CTR_LTE_V2_CEREG_HISTORY=3

  subsys.ctr_lte_v2.parser_no_cereg_history:
    extra_args:
      - CONFIG_TEST_FEATURE_PARSING=y
      - CONFIG_CTR_LTE_V2_CEREG_HISTORY=0

  subsys.ctr_lte_v2.stack_overrides_config:
    extra_args: CONFIG_TEST_FEATURE_STACK_OVERRIDES_CONFIG=y

  subsys.ctr_lte_v2.stack_default:
    extra_args: CONFIG_TEST_FEATURE_STACK=y

  subsys.ctr_lte_v2.stack_fplmn_erase_fails:
    extra_args: CONFIG_TEST_FEATURE_STACK_FPLMN_ERASE_FAILS=y

  subsys.ctr_lte_v2.txn_give_up_in_recv:
    extra_args: CONFIG_TEST_FEATURE_TXN_GIVE_UP_IN_RECV=y

  subsys.ctr_lte_v2.txn_give_up_in_attach:
    extra_args: CONFIG_TEST_FEATURE_TXN_GIVE_UP_IN_ATTACH=y

  subsys.ctr_lte_v2.txn_give_up_in_error:
    extra_args: CONFIG_TEST_FEATURE_TXN_GIVE_UP_IN_ERROR=y

  subsys.ctr_lte_v2.txn_give_up_in_send:
    extra_args: CONFIG_TEST_FEATURE_TXN_GIVE_UP_IN_SEND=y

  subsys.ctr_lte_v2.txn_give_up_in_xsend:
    extra_args: CONFIG_TEST_FEATURE_TXN_GIVE_UP_IN_XSEND=y

  subsys.ctr_lte_v2.txn_lock_busy:
    extra_args: CONFIG_TEST_FEATURE_TXN_LOCK_BUSY=y

  subsys.ctr_lte_v2.txn_cscon_again_in_recv:
    extra_args: CONFIG_TEST_FEATURE_TXN_CSCON_AGAIN_IN_RECV=y

  subsys.ctr_lte_v2.txn_cscon_1_0_in_send:
    extra_args: CONFIG_TEST_FEATURE_TXN_CSCON_1_0_IN_SEND=y

  subsys.ctr_lte_v2.txn_reconnect_in_recv:
    extra_args: CONFIG_TEST_FEATURE_TXN_RECONNECT_IN_RECV=y

  subsys.ctr_lte_v2.txn_reconnect_in_error:
    extra_args: CONFIG_TEST_FEATURE_TXN_RECONNECT_IN_ERROR=y

  subsys.ctr_lte_v2.txn_recv_no_data:
    extra_args: CONFIG_TEST_FEATURE_TXN_RECV_NO_DATA=y

  subsys.ctr_lte_v2.txn_recv_fail:
    extra_args: CONFIG_TEST_FEATURE_TXN_RECV_FAIL=y

  subsys.ctr_lte_v2.txn_error_no_socket:
    extra_args: CONFIG_TEST_FEATURE_TXN_ERROR_NO_SOCKET=y

  subsys.ctr_lte_v2.txn_disabled:
    extra_args: CONFIG_TEST_FEATURE_TXN_DISABLED=y

  subsys.ctr_lte_v2.txn_no_cscon:
    extra_args: CONFIG_TEST_FEATURE_TXN_NO_CSCON=y

  subsys.ctr_lte_v2.txn_cscon_timer:
    extra_args: CONFIG_TEST_FEATURE_TXN_CSCON_TIMER=y

  subsys.ctr_lte_v2.txn_cscon_0_in_send:
    extra_args: CONFIG_TEST_FEATURE_TXN_CSCON_0_IN_SEND=y

  subsys.ctr_lte_v2.txn_error_in_send:
    extra_args: CONFIG_TEST_FEATURE_TXN_ERROR_IN_SEND=y

  subsys.ctr_lte_v2.txn_reattach_in_send:
    extra_args: CONFIG_TEST_FEATURE_TXN_REATTACH_IN_SEND=y

  subsys.ctr_lte_v2.txn_deregistered_in_ready:
    extra_args: CONFIG_TEST_FEATURE_TXN_DEREGISTERED_IN_READY=y

  subsys.ctr_lte_v2.txn_callbacks:
    extra_args: CONFIG_TEST_FEATURE_TXN_CALLBACKS=y

  subsys.ctr_lte_v2.txn_no_psm_cfun4:
    extra_args: CONFIG_TEST_FEATURE_TXN_NO_PSM_CFUN4=y

  subsys.ctr_lte_v2.ncellmeas:
    extra_args: CONFIG_TEST_FEATURE_SCAN_NCELLMEAS=y

  subsys.ctr_lte_v2.ncellmeas_fail:
    extra_args: CONFIG_TEST_FEATURE_SCAN_NCELLMEAS_FAIL=y

  subsys.ctr_lte_v2.ncellmeas_no_psm:
    extra_args: CONFIG_TEST_FEATURE_SCAN_NCELLMEAS_NO_PSM=y

  subsys.ctr_lte_v2.ncellmeas_from_sleep:
    extra_args: CONFIG_TEST_FEATURE_SCAN_NCELLMEAS_FROM_SLEEP=y

  subsys.ctr_lte_v2.ncellmeas_cancel:
    extra_args: CONFIG_TEST_FEATURE_SCAN_NCELLMEAS_CANCEL=y

  subsys.ctr_lte_v2.scan_both:
    extra_args: CONFIG_TEST_FEATURE_SCAN_SCAN_BOTH=y

  subsys.ctr_lte_v2.scan_one_rat:
    extra_args: CONFIG_TEST_FEATURE_SCAN_SCAN_ONE_RAT=y

  subsys.ctr_lte_v2.scan_timeouts:
    extra_args: CONFIG_TEST_FEATURE_SCAN_SCAN_TIMEOUTS=y

  subsys.ctr_lte_v2.scan_cops_timeout:
    extra_args: CONFIG_TEST_FEATURE_SCAN_SCAN_COPS_TIMEOUT=y

  subsys.ctr_lte_v2.scan_cops_cme:
    extra_args: CONFIG_TEST_FEATURE_SCAN_SCAN_COPS_CME=y

  subsys.ctr_lte_v2.scan_step_fail:
    extra_args: CONFIG_TEST_FEATURE_SCAN_SCAN_STEP_FAIL=y

  subsys.ctr_lte_v2.scan_send:
    extra_args: CONFIG_TEST_FEATURE_SCAN_SCAN_SEND=y

  subsys.ctr_lte_v2.scan_send_cfun4:
    extra_args: CONFIG_TEST_FEATURE_SCAN_SCAN_SEND_CFUN4=y

  subsys.ctr_lte_v2.scan_send_after:
    extra_args: CONFIG_TEST_FEATURE_SCAN_SCAN_SEND_AFTER=y

  subsys.ctr_lte_v2.scan_reconnect:
    extra_args: CONFIG_TEST_FEATURE_SCAN_SCAN_RECONNECT=y

  subsys.ctr_lte_v2.scan_in_attach:
    extra_args: CONFIG_TEST_FEATURE_SCAN_SCAN_IN_ATTACH=y

  subsys.ctr_lte_v2.scan_in_retry_delay:
    extra_args: CONFIG_TEST_FEATURE_SCAN_SCAN_IN_RETRY_DELAY=y

  subsys.ctr_lte_v2.scan_in_gnss:
    extra_args: CONFIG_TEST_FEATURE_SCAN_SCAN_IN_GNSS=y

  subsys.ctr_lte_v2.scan_in_gnss_no_psm:
    extra_args: CONFIG_TEST_FEATURE_SCAN_SCAN_IN_GNSS_NO_PSM=y

  subsys.ctr_lte_v2.scan_reset_loop:
    extra_args: CONFIG_TEST_FEATURE_SCAN_SCAN_RESET_LOOP=y

  subsys.ctr_lte_v2.scan_modes:
    extra_args: CONFIG_TEST_FEATURE_SCAN_SCAN_MODES=y
```
