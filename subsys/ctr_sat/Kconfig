## subsys/ctr_sat/Kconfig
```kconfig
config CTR_SAT
	bool "CTR_SAT"
	select REQUIRES_FULL_LIBC
	select DS28E17
	select CTR_W1
	select GPIO
	select I2C
	depends on SHELL

if CTR_SAT

config CTR_SAT_USE_WIFI_DEVKIT
	bool "Enable support for using Wi-Fi Devkit. Increase SRAM memory usage."
	default y

config CTR_SAT_THREAD_STACK_SIZE
	int "CHESTER SAT thread stack size"
	default 1024

config CTR_SAT_THREAD_PRIORITY
	int "CHESTER SAT thread priority"
	default 10

config CTR_SAT_INT_POLL_PERIOD_MSEC
	int "Polling delay (in msec) used for polling interrupt singnal for handling frequent interrupts and interrupts over W1"
	default 10000

config CTR_SAT_RESET_ON_INIT
	bool "Enable for eforcing module reset on init"
	default y

config CTR_SAT_CRC_ERRORS_ALLOWED_RETRIES
	int "Number of retries allowed when detecting CRC error. Set to 0 for disabling retries on CRC error"
	default 2


module = CTR_SAT
module-str = CHESTER Satelite Module Subsystem
source "subsys/logging/Kconfig.template.log_config"

endif # CTR_SAT
```

## subsys/ctr_sat_v1/Kconfig
```kconfig
config CTR_SAT_V1
	bool "Enable support for CHESTER-V1 Satelite Module"
	select REQUIRES_FULL_LIBC

if CTR_SAT_V1

config CTR_SAT_V1_USE_WIFI_DEVKIT
	bool "Enable support for using Wi-Fi Devkit. Increases SRAM memory usage."
	default y

config CTR_SAT_V1_USE_SYSCON
	bool "Enable support for using CHESTER-V1 over CHESTER system connector."
	default y
	select GPIO
	select I2C
	select POLL

config CTR_SAT_V1_USE_W1
	bool "Enable support for using CHESTER-V1 over W1 bus."
	default n
	select DS28E17
	select CTR_W1

config CTR_SAT_V1_THREAD_STACK_SIZE
	int "CHESTER SAT thread stack size"
	default 1024

config CTR_SAT_V1_THREAD_PRIORITY
	int "CHESTER SAT thread priority"
	default 10

config CTR_SAT_V1_INT_POLL_PERIOD_MSEC
	int "Polling delay (in msec) used for polling interrupt singnal for handling frequent interrupts and interrupts over W1."
	default 10000

config CTR_SAT_V1_RESET_ON_INIT
	bool "Enable for eforcing module reset on init."
	default y

config CTR_SAT_V1_CRC_ERRORS_ALLOWED_RETRIES
	int "Number of retries allowed when detecting CRC error. Set to 0 for disabling retries on CRC error."
	default 2

module = CTR_SAT_V1
module-str = CHESTER Satelite Module Subsystem
source "subsys/logging/Kconfig.template.log_config"

endif # CTR_SAT_V1
```

## subsys/ctr_signal/Kconfig
```kconfig
#
# Copyright (c) 2023 HARDWARIO a.s.
#
# SPDX-License-Identifier: LicenseRef-HARDWARIO-5-Clause
#

config CTR_SIGNAL
	bool "CTR_SIGNAL"
	select CBPRINTF_FP_SUPPORT if CTR_SIGNAL_LOG_LEVEL_DBG
	select NRFX_PPI
	select NRFX_SAADC
	select NRFX_TIMER
	select NRFX_TIMER4

if CTR_SIGNAL

module = CTR_SIGNAL
module-str = CHESTER Signal Measurement Subsystem
source "subsys/logging/Kconfig.template.log_config"

endif # CTR_SIGNAL
```

## subsys/ctr_soil_sensor/Kconfig
```kconfig
#
# Copyright (c) 2023 HARDWARIO a.s.
#
# SPDX-License-Identifier: LicenseRef-HARDWARIO-5-Clause
#

config CTR_SOIL_SENSOR
	bool "CTR_SOIL_SENSOR"
	select CBPRINTF_FP_SUPPORT if CTR_SOIL_SENSOR_DBG
	select CTR_W1
	select DS28E17
	select GPIO
	select I2C
	select REQUIRES_FULL_LIBC
	select W1_DS2484

if CTR_SOIL_SENSOR

module = CTR_SOIL_SENSOR
module-str = CHESTER Soil Sensor Subsystem
source "subsys/logging/Kconfig.template.log_config"

endif # CTR_SOIL_SENSOR
```

## subsys/ctr_sps30/Kconfig
```kconfig
#
# Copyright (c) 2024 HARDWARIO a.s.
#
# SPDX-License-Identifier: LicenseRef-HARDWARIO-5-Clause
#

config CTR_SPS30
	bool "CTR_SPS30"
	select CBPRINTF_FP_SUPPORT if CTR_SPS30_LOG_LEVEL_DBG || CTR_SPS30_SHELL
	select I2C
	select SENSOR
	select SPS30

if CTR_SPS30

module = CTR_SPS30
module-str = CHESTER SPS30 Particulate Matter Sensor Sensor Subsystem
source "subsys/logging/Kconfig.template.log_config"

config CTR_SPS30_SHELL
	bool "CTR_SPS30_SHELL"
	depends on SHELL
	default y

endif # CTR_SPS30
```

## subsys/ctr_tc/Kconfig
```kconfig
#
# Copyright (c) 2023 HARDWARIO a.s.
#
# SPDX-License-Identifier: LicenseRef-HARDWARIO-5-Clause
#

config CTR_TC
	bool "CTR_TC"
	depends on CTR_X3
	depends on CTR_THERM
	select CBPRINTF_FP_SUPPORT if CTR_TC_LOG_LEVEL_DBG || CTR_TC_SHELL
	select REQUIRES_FULL_LIBC

if CTR_TC

module = CTR_TC
module-str = CHESTER Thermocouple Temperature Detectors Subsystem
source "subsys/logging/Kconfig.template.log_config"

config CTR_TC_SHELL
	bool "CTR_TC_SHELL"
	depends on SHELL
	depends on CTR_TC
	default y

endif # CTR_TC
```

## subsys/ctr_test/Kconfig
```kconfig
#
# Copyright (c) 2023 HARDWARIO a.s.
#
# SPDX-License-Identifier: LicenseRef-HARDWARIO-5-Clause
#

config CTR_TEST
	bool "CTR_TEST"
	depends on SHELL
	select POLL

if CTR_TEST

module = CTR_TEST
module-str = CHESTER Test Subsystem
source "subsys/logging/Kconfig.template.log_config"

config CTR_TEST_INIT_PRIORITY
	int "Initialization priority"
	default 99

endif # CTR_TEST
```

## subsys/ctr_therm/Kconfig
```kconfig
#
# Copyright (c) 2023 HARDWARIO a.s.
#
# SPDX-License-Identifier: LicenseRef-HARDWARIO-5-Clause
#

config CTR_THERM
	bool "CTR_THERM"
	select CBPRINTF_FP_SUPPORT if CTR_THERM_LOG_LEVEL_DBG || CTR_THERM_SHELL
	select I2C
	select SENSOR
	select TMP112

if CTR_THERM

module = CTR_THERM
module-str = CHESTER Thermometer Subsystem
source "subsys/logging/Kconfig.template.log_config"

config CTR_THERM_SHELL
	bool "CTR_THERM_SHELL"
	depends on SHELL
	default y

endif # CTR_THERM
```

## subsys/ctr_w1/Kconfig
```kconfig
#
# Copyright (c) 2023 HARDWARIO a.s.
#
# SPDX-License-Identifier: LicenseRef-HARDWARIO-5-Clause
#

config CTR_W1
	bool "CTR_W1"
	select PM_DEVICE
	select W1

if CTR_W1

module = CTR_W1
module-str = CHESTER 1-Wire Subsystem
source "subsys/logging/Kconfig.template.log_config"

endif # CTR_W1
```

## subsys/ctr_wdog/Kconfig
```kconfig
#
# Copyright (c) 2023 HARDWARIO a.s.
#
# SPDX-License-Identifier: LicenseRef-HARDWARIO-5-Clause
#

config CTR_WDOG
	bool "CTR_WDOG"
	select WATCHDOG

if CTR_WDOG

module = CTR_WDOG
module-str = CHESTER Watchdog Subsystem
source "subsys/logging/Kconfig.template.log_config"

endif # CTR_WDOG
```

## subsys/ctr_weight_probe/Kconfig
```kconfig
#
# Copyright (c) 2023 HARDWARIO a.s.
#
# SPDX-License-Identifier: LicenseRef-HARDWARIO-5-Clause
#

config CTR_WEIGHT_PROBE
	bool "CTR_WEIGHT_PROBE"
	select CTR_W1
	select DS28E17
	select W1_DS2484

if CTR_WEIGHT_PROBE

module = CTR_WEIGHT_PROBE
module-str = CHESTER Weight Probe Subsystem
source "subsys/logging/Kconfig.template.log_config"

endif # CTR_WEIGHT_PROBE
```

## tests/subsys/ctr_cloud/testcase.yaml
```yaml
tests:
  subsys.ctr_cloud:
    tags: chester
    platform_allow:
      - native_sim
      - nrf52840dk/nrf52840
      - nrf9160dk/nrf9160
      - qemu_cortex_m3
    integration_platforms:
      - native_sim
      - nrf52840dk/nrf52840
      - nrf9160dk/nrf9160
      - qemu_cortex_m3
```

## tests/subsys/ctr_lte_v2/testcase.yaml
```yaml
common:
  tags:
      - chester
  platform_allow: native_posix
  integration_platforms:
    - native_posix

tests:
  subsys.ctr_lte_v2.parser:
    extra_args: CONFIG_TEST_FEATURE_PARSING=y

  subsys.ctr_lte_v2.stack_overrides_config:
    extra_args: CONFIG_TEST_FEATURE_STACK_OVERRIDES_CONFIG=y

  subsys.ctr_lte_v2.stack_default:
    extra_args: CONFIG_TEST_FEATURE_STACK=y
```
