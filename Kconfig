## Kconfig
```kconfig
#
# Copyright (c) 2023 HARDWARIO a.s.
#
# SPDX-License-Identifier: LicenseRef-HARDWARIO-5-Clause
#

rsource "Kconfig.defaults"
rsource "Kconfig.log"
rsource "Kconfig.shell"

rsource "drivers/Kconfig"
rsource "lib/Kconfig"
rsource "subsys/Kconfig"
```

## Kconfig.accel
```kconfig
config CTR_ACCEL
	bool "CTR_ACCEL"
	select SENSOR
	select LIS2DH

# TODO Uncomment this when named choices get to mainline
# https://github.com/zephyrproject-rtos/zephyr/pull/39303
# choice LIS2DH_ACCEL_RANGE
# 	default LIS2DH_ACCEL_RANGE_4G
# 	depends on CTR_ACCEL
# endchoice
#
# choice LIS2DH_ODR
# 	default LIS2DH_ODR_2
# 	depends on CTR_ACCEL
# endchoice
#
# choice LIS2DH_TRIGGER_MODE
# 	default LIS2DH_TRIGGER_GLOBAL_THREAD
# 	depends on CTR_ACCEL
# endchoice
```

## Kconfig.ble
```kconfig
config CTR_BLE
	bool "CTR_BLE"
	select CTR_SDK
	select BT
	select BT_NUS
	select BT_PERIPHERAL
	select MCUMGR_CMD_IMG_MGMT
	select MCUMGR_CMD_OS_MGMT
	select MCUMGR_SMP_BT

config CTR_BLE_INIT_PRIORITY
	int "CTR_BLE_INIT_PRIORITY"
	depends on CTR_BLE
	default 1

config BT_RX_STACK_SIZE
	default 4096 if CTR_BLE

config BT_CTLR_RX_PRIO_STACK_SIZE
	default 2048 if CTR_BLE

config BT_L2CAP_TX_MTU
	default 252 if CTR_BLE

config BT_BUF_ACL_RX_SIZE
	default 256 if CTR_BLE

config MCUMGR_SMP_BT_AUTHEN
	default n if CTR_BLE

config BT_DEVICE_NAME
	default "CHESTER 3" if CTR_BLE

config SHELL_BT_NUS
	default y if CTR_BLE

config SHELL_BT_NUS_RX_RING_BUFFER_SIZE
	default 256 if CTR_BLE

config SHELL_BT_NUS_TX_RING_BUFFER_SIZE
	default 256 if CTR_BLE
```

## Kconfig.bsp
```kconfig
config CTR_BSP
	bool "CTR_BSP"
	select CTR_SDK
	select SPI
	select FLASH
	select SPI_FLASH_AT45

config CTR_BSP_INIT_PRIORITY
	int "CTR_BSP_INIT_PRIORITY"
	default 2
	depends on CTR_BSP
```

## Kconfig.config
```kconfig
config CTR_CONFIG
	bool "CTR_CONFIG"
	select CTR_SDK
	select FLASH_MAP
	select NVS
	select SETTINGS
	select SETTINGS_RUNTIME

config CTR_CONFIG_INIT_PRIORITY
	int "CTR_CONFIG_INIT_PRIORITY"
	default 0
	depends on CTR_CONFIG
```

## Kconfig.hygro
```kconfig
config CTR_HYGRO
	bool "CTR_HYGRO"
	select SENSOR
	select SHT3XD

# TODO Uncomment this when named choices get to mainline:
# https://github.com/zephyrproject-rtos/zephyr/pull/39305
# choice SHT3XD_MEASUREMENT_MODE
# 	default SHT3XD_SINGLE_SHOT_MODE
# 	depends on CTR_HYGRO
# endchoice
```

## Kconfig.log
```kconfig
#
# Copyright (c) 2023 HARDWARIO a.s.
#
# SPDX-License-Identifier: LicenseRef-HARDWARIO-5-Clause
#

config CTR_LOG
	bool "CTR_LOG"
	select LOG
	select LOG_BACKEND_RTT
	select USE_SEGGER_RTT

choice LOG_BACKEND_RTT_MODE
	default LOG_BACKEND_RTT_MODE_DROP
	depends on CTR_LOG
endchoice

config LOG_PROCESS_THREAD_STACK_SIZE
	default 2048
	depends on CTR_LOG

config LOG_BUFFER_SIZE
	default 4096
	depends on CTR_LOG

config LOG_PROCESS_TRIGGER_THRESHOLD
	default 1
	depends on CTR_LOG

config LOG_PROCESS_THREAD_SLEEP_MS
	default 100
	depends on CTR_LOG

config LOG_FUNC_NAME_PREFIX_ERR
	default y
	depends on CTR_LOG

config LOG_FUNC_NAME_PREFIX_WRN
	default y
	depends on CTR_LOG

config LOG_FUNC_NAME_PREFIX_INF
	default y
	depends on CTR_LOG

config LOG_FUNC_NAME_PREFIX_DBG
	default y
	depends on CTR_LOG

config LOG_BACKEND_SHOW_COLOR
	default n
	depends on CTR_LOG

config LOG_BACKEND_RTT_BUFFER
	default 1
	depends on CTR_LOG

config LOG_BACKEND_RTT_BUFFER_SIZE
	default 4096
	depends on CTR_LOG

config LOG_BACKEND_RTT_MESSAGE_SIZE
	default 256
	depends on CTR_LOG
```

## Kconfig.lrw
```kconfig
config CTR_LRW
	bool "CTR_LRW"
	depends on CTR_CONFIG
	select CTR_SDK
	select CTR_BSP

config CTR_LRW_THREAD_STACK_SIZE
	int "CTR_LRW_THREAD_STACK_SIZE"
	default 4096
	depends on CTR_LRW

config CTR_LRW_THREAD_PRIORITY
	int "CTR_LRW_THREAD_PRIORITY"
	default 10
	depends on CTR_LRW
```

## Kconfig.lte
```kconfig
config CTR_LTE
	bool "CTR_LTE"
	depends on CTR_CONFIG
	select CTR_SDK
	select CTR_BSP

config CTR_LTE_THREAD_STACK_SIZE
	int "CTR_LTE_THREAD_STACK_SIZE"
	default 4096
	depends on CTR_LTE

config CTR_LTE_THREAD_PRIORITY
	int "CTR_LTE_THREAD_PRIORITY"
	default 10
	depends on CTR_LTE
```

## Kconfig.rtc
```kconfig
config CTR_RTC
	bool "CTR_RTC"
	select CTR_SDK
	select NRFX_RTC2

config CTR_RTC_INIT_PRIORITY
	int "CTR_RTC_INIT_PRIORITY"
	default 3
	depends on CTR_RTC
```

## Kconfig.shell
```kconfig
#
# Copyright (c) 2023 HARDWARIO a.s.
#
# SPDX-License-Identifier: LicenseRef-HARDWARIO-5-Clause
#

config CTR_SHELL
	bool "CTR_SHELL"
	select REBOOT
	select SHELL
	select SHELL_BACKEND_RTT
	select SHELL_BT_NUS if CTR_BLE
	select SHELL_HELP
	select SHELL_HELP_ON_WRONG_ARGUMENT_COUNT
	select SHELL_MINIMAL
	select SHELL_STATS
	select USE_SEGGER_RTT

config CLOCK_CONTROL_NRF_SHELL
	default n if CTR_SHELL

config KERNEL_SHELL
	default y if CTR_SHELL

config SHELL_BACKEND_DUMMY_BUF_SIZE
	default 4096 if CTR_SHELL

config SHELL_CMD_BUFF_SIZE
	default 256 if CTR_SHELL

config SHELL_ECHO_STATUS
	default n if CTR_SHELL

config SHELL_LOG_BACKEND
	default n if CTR_SHELL

config SHELL_PROMPT_RTT
	default "" if CTR_SHELL

config SHELL_RTT_RX_POLL_PERIOD
	default 200 if CTR_SHELL

config SHELL_STACK_SIZE
	default 4096 if CTR_SHELL

config SHELL_VT100_COMMANDS
	default n if CTR_SHELL
```

## Kconfig.test
```kconfig
config CTR_TEST
	bool "CTR_TEST"
	select CTR_SDK

config CTR_TEST_INIT_PRIORITY
	int "CTR_TEST_INIT_PRIORITY"
	default 99
	depends on CTR_TEST
```

## Kconfig.therm
```kconfig
config CTR_THERM
	bool "CTR_THERM"
	select CTR_BSP
	select I2C
	select SENSOR
	select TMP112
```

## boards/arm/chester_nrf52840/Kconfig.board
```kconfig
#
# Copyright (c) 2023 HARDWARIO a.s.
#
# SPDX-License-Identifier: LicenseRef-HARDWARIO-5-Clause
#

config BOARD_CHESTER_NRF52840
	bool "HARDWARIO CHESTER nRF52840"
	depends on SOC_NRF52840_QIAA
```

## boards/arm/chester_nrf52840/Kconfig.defconfig
```kconfig
#
# Copyright (c) 2023 HARDWARIO a.s.
#
# SPDX-License-Identifier: LicenseRef-HARDWARIO-5-Clause
#

if BOARD_CHESTER_NRF52840

config BOARD
	default "chester_nrf52840"

config BT_CTLR
	default BT

config SHELL_BACKEND_SERIAL
	default n

endif # BOARD_CHESTER_NRF52840
```

## boards/arm/chester_nrf52840/chester_nrf52840_defconfig
```kconfig
#
# Copyright (c) 2023 HARDWARIO a.s.
#
# SPDX-License-Identifier: LicenseRef-HARDWARIO-5-Clause
#

CONFIG_ARM_MPU=y
CONFIG_BOARD_CHESTER_NRF52840=y
CONFIG_GPIO=y
CONFIG_HW_STACK_PROTECTION=y
CONFIG_PINCTRL=y
CONFIG_SOC_NRF52840_QIAA=y
CONFIG_SOC_SERIES_NRF52X=y
CONFIG_USE_SEGGER_RTT=y
```

## boards/arm/chester_nrf52840/dts/bindings/hardwario,ctr-gpio.yaml
```yaml
#
# Copyright (c) 2023 HARDWARIO a.s.
#
# SPDX-License-Identifier: LicenseRef-HARDWARIO-5-Clause
#

description: GPIO pins exposed to the two expansion slots on CHESTER-M

compatible: "hardwario,ctr-gpio"

include: base.yaml

properties:
  a0-gpios:
    type: phandle-array
    required: true
    description: Channel A0

  a1-gpios:
    type: phandle-array
    required: true
    description: Channel A1

  a2-gpios:
    type: phandle-array
    required: true
    description: Channel A2

  a3-gpios:
    type: phandle-array
    required: true
    description: Channel A3

  b0-gpios:
    type: phandle-array
    required: true
    description: Channel B0

  b1-gpios:
    type: phandle-array
    required: true
    description: Channel B1

  b2-gpios:
    type: phandle-array
    required: true
    description: Channel B2

  b3-gpios:
    type: phandle-array
    required: true
    description: Channel B3
```

## boards/hardwario/chester/Kconfig.chester
```kconfig
# Copyright (c) 2024 HARDWARIO a.s.
# SPDX-License-Identifier: Apache-2.0

config BOARD_CHESTER
	select SOC_NRF52840_QIAA if BOARD_CHESTER_NRF52840
```

## boards/hardwario/chester/Kconfig.sysbuild
```kconfig
#
# Copyright (c) 2026 HARDWARIO a.s.
#
# SPDX-License-Identifier: LicenseRef-HARDWARIO-5-Clause
#

if BOARD_CHESTER_NRF52840

config PARTITION_MANAGER
	default n

endif # BOARD_CHESTER_NRF52840
```

## boards/hardwario/chester/board.yml
```yaml
board:
  name: chester
  full_name: HARDWARIO CHESTER nRF52840
  vendor: hardwario
  socs:
  - name: nrf52840
```

## boards/hardwario/chester/chester_nrf52840_defconfig
```kconfig
#
# Copyright (c) 2024 HARDWARIO a.s.
#
# SPDX-License-Identifier: LicenseRef-HARDWARIO-5-Clause
#

# Enable MPU
CONFIG_ARM_MPU=y

# Enable hardware stack protection
CONFIG_HW_STACK_PROTECTION=y

# Enable RTT
CONFIG_USE_SEGGER_RTT=y

# Enable GPIO
CONFIG_GPIO=y
```
