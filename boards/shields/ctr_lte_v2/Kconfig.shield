## boards/shields/ctr_machine_probe/Kconfig.defconfig
```kconfig
#
# Copyright (c) 2023 HARDWARIO a.s.
#
# SPDX-License-Identifier: LicenseRef-HARDWARIO-5-Clause
#

if SHIELD_CTR_MACHINE_PROBE

config CTR_MACHINE_PROBE
	default y

endif # SHIELD_CTR_MACHINE_PROBE
```

## boards/shields/ctr_machine_probe/Kconfig.shield
```kconfig
config SHIELD_CTR_MACHINE_PROBE
	def_bool $(shields_list_contains,ctr_machine_probe)
```

## boards/shields/ctr_mb7066_a/Kconfig.defconfig
```kconfig
#
# Copyright (c) 2023 HARDWARIO a.s.
#
# SPDX-License-Identifier: LicenseRef-HARDWARIO-5-Clause
#

if SHIELD_CTR_MB7066_A

config CTR_X0
	default y

config MB7066
	default y

endif # SHIELD_MB7066
```

## boards/shields/ctr_mb7066_a/Kconfig.shield
```kconfig
config SHIELD_CTR_MB7066_A
	def_bool $(shields_list_contains,ctr_mb7066_a)
	def_bool $(shields_list_contains,ctr_x0_a)
```

## boards/shields/ctr_mb7066_b/Kconfig.defconfig
```kconfig
#
# Copyright (c) 2023 HARDWARIO a.s.
#
# SPDX-License-Identifier: LicenseRef-HARDWARIO-5-Clause
#

if SHIELD_CTR_MB7066_B

config CTR_X0
	default y

config MB7066
	default y

endif # SHIELD_MB7066_B
```

## boards/shields/ctr_mb7066_b/Kconfig.shield
```kconfig
#
# Copyright (c) 2023 HARDWARIO a.s.
#
# SPDX-License-Identifier: LicenseRef-HARDWARIO-5-Clause
#

config SHIELD_CTR_MB7066_B
	def_bool $(shields_list_contains,ctr_mb7066_b)
	def_bool $(shields_list_contains,ctr_x0_b)
```

## boards/shields/ctr_meteo_a/Kconfig.defconfig
```kconfig
if SHIELD_CTR_METEO_A

config CTR_METEO
	default y

config CTR_X0
	default y

endif # SHIELD_CTR_METEO_A
```

## boards/shields/ctr_meteo_a/Kconfig.shield
```kconfig
#
# Copyright (c) 2023 HARDWARIO a.s.
#
# SPDX-License-Identifier: LicenseRef-HARDWARIO-5-Clause
#

config SHIELD_CTR_METEO_A
	def_bool $(shields_list_contains,ctr_meteo_a)
```

## boards/shields/ctr_meteo_b/Kconfig.defconfig
```kconfig
#
# Copyright (c) 2023 HARDWARIO a.s.
#
# SPDX-License-Identifier: LicenseRef-HARDWARIO-5-Clause
#

if SHIELD_CTR_METEO_B

config CTR_METEO
	default y

config CTR_X0
	default y

endif # SHIELD_CTR_METEO_B
```

## boards/shields/ctr_meteo_b/Kconfig.shield
```kconfig
#
# Copyright (c) 2023 HARDWARIO a.s.
#
# SPDX-License-Identifier: LicenseRef-HARDWARIO-5-Clause
#

config SHIELD_CTR_METEO_B
	def_bool $(shields_list_contains,ctr_meteo_b)
```

## boards/shields/ctr_pm3006s/Kconfig.defconfig
```kconfig
if SHIELD_CTR_PM3006S

config I2C
    default y

config CTR_PM3006S
	default y

endif # SHIELD_CTR_PM3006S
```

## boards/shields/ctr_rtd_a/Kconfig.defconfig
```kconfig
#
# Copyright (c) 2023 HARDWARIO a.s.
#
# SPDX-License-Identifier: LicenseRef-HARDWARIO-5-Clause
#

if SHIELD_CTR_RTD_A

config CTR_X3
	default y

config CTR_RTD
	default y

endif # SHIELD_CTR_RTD_A
```

## boards/shields/ctr_rtd_a/Kconfig.shield
```kconfig
#
# Copyright (c) 2023 HARDWARIO a.s.
#
# SPDX-License-Identifier: LicenseRef-HARDWARIO-5-Clause
#

config SHIELD_CTR_RTD_A
	def_bool $(shields_list_contains,ctr_rtd_a)
```

## boards/shields/ctr_rtd_b/Kconfig.shield
```kconfig
#
# Copyright (c) 2023 HARDWARIO a.s.
#
# SPDX-License-Identifier: LicenseRef-HARDWARIO-5-Clause
#

config SHIELD_CTR_RTD_B
	def_bool $(shields_list_contains,ctr_rtd_b)
```

## boards/shields/ctr_s1/Kconfig.defconfig
```kconfig
#
# Copyright (c) 2023 HARDWARIO a.s.
#
# SPDX-License-Identifier: LicenseRef-HARDWARIO-5-Clause
#

if SHIELD_CTR_S1

config CTR_S1
	default y

config I2C
	default y

endif # SHIELD_CTR_S1
```

## boards/shields/ctr_s1/Kconfig.shield
```kconfig
#
# Copyright (c) 2023 HARDWARIO a.s.
#
# SPDX-License-Identifier: LicenseRef-HARDWARIO-5-Clause
#

config SHIELD_CTR_S1
	def_bool $(shields_list_contains,ctr_s1)
```

## boards/shields/ctr_s2/Kconfig.defconfig
```kconfig
#
# Copyright (c) 2023 HARDWARIO a.s.
#
# SPDX-License-Identifier: LicenseRef-HARDWARIO-5-Clause
#

if SHIELD_CTR_S2

config CTR_HYGRO
	default y

endif # SHIELD_CTR_S2
```

## boards/shields/ctr_s3/Kconfig.defconfig
```kconfig
#
# Copyright (c) 2023 HARDWARIO a.s.
#
# SPDX-License-Identifier: LicenseRef-HARDWARIO-5-Clause
#

if SHIELD_CTR_S3

config CTR_S3
	default y

endif # SHIELD_CTR_S3
```

## boards/shields/ctr_s3/Kconfig.shield
```kconfig
#
# Copyright (c) 2023 HARDWARIO a.s.
#
# SPDX-License-Identifier: LicenseRef-HARDWARIO-5-Clause
#

config SHIELD_CTR_S3
	def_bool $(shields_list_contains,ctr_s3)
```

## boards/shields/ctr_soil_sensor/Kconfig.defconfig
```kconfig
#
# Copyright (c) 2023 HARDWARIO a.s.
#
# SPDX-License-Identifier: LicenseRef-HARDWARIO-5-Clause
#

if SHIELD_CTR_SOIL_SENSOR

config CTR_SOIL_SENSOR
	default y

endif # SHIELD_CTR_SOIL_SENSOR
```

## boards/shields/ctr_soil_sensor/Kconfig.shield
```kconfig
config SHIELD_CTR_SOIL_SENSOR
	def_bool $(shields_list_contains,ctr_soil_sensor)
```

## boards/shields/ctr_sps30/Kconfig.defconfig
```kconfig
#
# Copyright (c) 2024 HARDWARIO a.s.
#
# SPDX-License-Identifier: LicenseRef-HARDWARIO-5-Clause
#

if SHIELD_CTR_SPS30

config CTR_SPS30
	default y

config CTR_X0
	default y

endif # SHIELD_CTR_SPS30
```
