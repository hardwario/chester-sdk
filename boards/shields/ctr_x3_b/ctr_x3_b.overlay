/*
 * Copyright (c) 2023 HARDWARIO a.s.
 *
 * SPDX-License-Identifier: LicenseRef-HARDWARIO-5-Clause
 */

&ctr_x3_b {
	status = "okay";
};

&ctr_x3_ads122c04_b1 {
	status = "okay";
};

&ctr_x3_ads122c04_b2 {
	status = "okay";
};
