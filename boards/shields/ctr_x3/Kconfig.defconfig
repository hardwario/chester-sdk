## boards/shields/ctr_x3/Kconfig.defconfig
```kconfig
if SHIELD_CTR_X3_A || SHIELD_CTR_X3_B

config CTR_X3
	default y

endif # SHIELD_CTR_X3_A || SHIELD_CTR_X3_B
```

## boards/shields/ctr_x3/Kconfig.shield
```kconfig
config SHIELD_CTR_X3_A
	def_bool $(shields_list_contains,ctr_x3_a)

config SHIELD_CTR_X3_B
	def_bool $(shields_list_contains,ctr_x3_b)
```

## boards/shields/ctr_x3_a/Kconfig.shield
```kconfig
#
# Copyright (c) 2023 HARDWARIO a.s.
#
# SPDX-License-Identifier: LicenseRef-HARDWARIO-5-Clause
#

config SHIELD_CTR_X3_A
	def_bool $(shields_list_contains,ctr_x3_a)
```

## boards/shields/ctr_x3_b/Kconfig.defconfig
```kconfig
#
# Copyright (c) 2023 HARDWARIO a.s.
#
# SPDX-License-Identifier: LicenseRef-HARDWARIO-5-Clause
#

if SHIELD_CTR_X3_B

config CTR_X3
	default y

endif # SHIELD_CTR_X3_B
```

## boards/shields/ctr_x3_b/Kconfig.shield
```kconfig
#
# Copyright (c) 2023 HARDWARIO a.s.
#
# SPDX-License-Identifier: LicenseRef-HARDWARIO-5-Clause
#

config SHIELD_CTR_X3_B
	def_bool $(shields_list_contains,ctr_x3_b)
```

## boards/shields/ctr_x4_b/Kconfig.defconfig
```kconfig
#
# Copyright (c) 2023 HARDWARIO a.s.
#
# SPDX-License-Identifier: LicenseRef-HARDWARIO-5-Clause
#

if SHIELD_CTR_X4_B

config CTR_X4
	default y

endif # SHIELD_CTR_X4_B
```

## boards/shields/ctr_x7_a/Kconfig.shield
```kconfig
#
# Copyright (c) 2023 HARDWARIO a.s.
#
# SPDX-License-Identifier: LicenseRef-HARDWARIO-5-Clause
#

config SHIELD_CTR_X7_A
	def_bool $(shields_list_contains,ctr_x7_a)
```

## boards/shields/ctr_x7_b/Kconfig.shield
```kconfig
#
# Copyright (c) 2023 HARDWARIO a.s.
#
# SPDX-License-Identifier: LicenseRef-HARDWARIO-5-Clause
#

config SHIELD_CTR_X7_B
	def_bool $(shields_list_contains,ctr_x7_b)
```

## boards/shields/ctr_x9_a/Kconfig.defconfig
```kconfig
#
# Copyright (c) 2023 HARDWARIO a.s.
#
# SPDX-License-Identifier: LicenseRef-HARDWARIO-5-Clause
#

if SHIELD_CTR_X9_A

config CTR_X9
	default y

endif # SHIELD_CTR_X9_A
```

## boards/shields/ctr_x9_a/Kconfig.shield
```kconfig
#
# Copyright (c) 2023 HARDWARIO a.s.
#
# SPDX-License-Identifier: LicenseRef-HARDWARIO-5-Clause
#

config SHIELD_CTR_X9_A
	def_bool $(shields_list_contains,ctr_x9_a)
```

## boards/shields/ctr_x9_b/Kconfig.defconfig
```kconfig
#
# Copyright (c) 2023 HARDWARIO a.s.
#
# SPDX-License-Identifier: LicenseRef-HARDWARIO-5-Clause
#

if SHIELD_CTR_X9_B

config CTR_X9
	default y

endif # SHIELD_CTR_X9_B
```

## boards/shields/ctr_z/Kconfig.defconfig
```kconfig
#
# Copyright (c) 2023 HARDWARIO a.s.
#
# SPDX-License-Identifier: LicenseRef-HARDWARIO-5-Clause
#

if SHIELD_CTR_Z

config CTR_Z
	default y

config I2C
	default y

endif # SHIELD_CTR_Z
```

## boards/shields/people_counter/Kconfig.defconfig
```kconfig
#
# Copyright (c) 2023 HARDWARIO a.s.
#
# SPDX-License-Identifier: LicenseRef-HARDWARIO-5-Clause
#

if SHIELD_PEOPLE_COUNTER

config I2C
	default y

config PEOPLE_COUNTER
	default y

endif # SHIELD_PEOPLE_COUNTER
```

## boards/shields/people_counter/Kconfig.shield
```kconfig
#
# Copyright (c) 2023 HARDWARIO a.s.
#
# SPDX-License-Identifier: LicenseRef-HARDWARIO-5-Clause
#

config SHIELD_PEOPLE_COUNTER
	def_bool $(shields_list_contains,people_counter)
```

## drivers/Kconfig
```kconfig
#
# Copyright (c) 2023 HARDWARIO a.s.
#
# SPDX-License-Identifier: LicenseRef-HARDWARIO-5-Clause
#

menu "Drivers"

rsource "adc/Kconfig"
rsource "ctr_a1/Kconfig"
rsource "ctr_b1/Kconfig"
rsource "ctr_batt/Kconfig"
rsource "ctr_k1/Kconfig"
rsource "ctr_lrw_if/Kconfig"
rsource "ctr_lte_if/Kconfig"
rsource "ctr_lte_if_v2/Kconfig"
rsource "ctr_meteo/Kconfig"
rsource "ctr_rfmux/Kconfig"
rsource "ctr_s1/Kconfig"
rsource "ctr_x0/Kconfig"
rsource "ctr_x3/Kconfig"
rsource "ctr_x4/Kconfig"
rsource "ctr_x7/Kconfig"
rsource "ctr_x9/Kconfig"
rsource "ctr_x10/Kconfig"
rsource "ctr_z/Kconfig"
rsource "gnss/Kconfig"
rsource "mb7066/Kconfig"
rsource "people_counter/Kconfig"
rsource "sensor/Kconfig"
rsource "serial/Kconfig"
rsource "w1/Kconfig"

endmenu
```

## drivers/adc/Kconfig
```kconfig
#
# Copyright (c) 2023 HARDWARIO a.s.
#
# SPDX-License-Identifier: LicenseRef-HARDWARIO-5-Clause
#

rsource "Kconfig.adc_ads122c04"
rsource "Kconfig.adc_tla2024"
```

## drivers/adc/Kconfig.adc_ads122c04
```kconfig
#
# Copyright (c) 2023 HARDWARIO a.s.
#
# SPDX-License-Identifier: LicenseRef-HARDWARIO-5-Clause
#

config ADC_ADS122C04
	bool "TI ADS122C04 24-Bit 4-Channel 2-kSPS Delta-Sigma ADC"
	depends on I2C
```

## drivers/adc/Kconfig.adc_tla2021
```kconfig
#
# Copyright (c) 2023 HARDWARIO a.s.
#
# SPDX-License-Identifier: LicenseRef-HARDWARIO-5-Clause
#

config ADC_TLA2021
	bool "TI TLA2021 Low-Power ADC"
	depends on I2C
```
