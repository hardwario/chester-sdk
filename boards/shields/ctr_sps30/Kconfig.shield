## boards/shields/ctr_sps30/Kconfig.shield
```kconfig
#
# Copyright (c) 2023 HARDWARIO a.s.
#
# SPDX-License-Identifier: LicenseRef-HARDWARIO-5-Clause
#

config SHIELD_CTR_SPS30
	def_bool $(shields_list_contains,ctr_sps30)
```

## boards/shields/ctr_weight_probe/Kconfig.defconfig
```kconfig
#
# Copyright (c) 2023 HARDWARIO a.s.
#
# SPDX-License-Identifier: LicenseRef-HARDWARIO-5-Clause
#

if SHIELD_CTR_WEIGHT_PROBE

config CTR_WEIGHT_PROBE
	default y

endif # SHIELD_CTR_WEIGHT_PROBE
```

## boards/shields/ctr_x0_a/Kconfig.defconfig
```kconfig
#
# Copyright (c) 2023 HARDWARIO a.s.
#
# SPDX-License-Identifier: LicenseRef-HARDWARIO-5-Clause
#

if SHIELD_CTR_X0_A

config CTR_X0
	default y

endif # SHIELD_CTR_X0_A
```

## boards/shields/ctr_x0_a/Kconfig.shield
```kconfig
#
# Copyright (c) 2023 HARDWARIO a.s.
#
# SPDX-License-Identifier: LicenseRef-HARDWARIO-5-Clause
#

config SHIELD_CTR_X0_A
	def_bool $(shields_list_contains,ctr_x0_a)
```

## boards/shields/ctr_x10/Kconfig.defconfig
```kconfig
#
# Copyright (c) 2023 HARDWARIO a.s.
#
# SPDX-License-Identifier: LicenseRef-HARDWARIO-5-Clause
#

if SHIELD_CTR_X10

config CTR_X10
	default y

endif # SHIELD_CTR_X10
```

## boards/shields/ctr_x12_a/Kconfig.defconfig
```kconfig
#
# Copyright (c) 2023 HARDWARIO a.s.
#
# SPDX-License-Identifier: LicenseRef-HARDWARIO-5-Clause
#

if SHIELD_CTR_X12_A

config GPIO
	default y

config I2C
	default y

config PM_DEVICE
	default y

config SERIAL
	default y

config UART_SC16IS7XX
	default y

endif # SHIELD_CTR_X12_A
```

## boards/shields/ctr_x12_a/Kconfig.shield
```kconfig
#
# Copyright (c) 2023 HARDWARIO a.s.
#
# SPDX-License-Identifier: LicenseRef-HARDWARIO-5-Clause
#

config SHIELD_CTR_X12_A
	def_bool $(shields_list_contains,ctr_x12_a)
```

## boards/shields/ctr_x12_b/Kconfig.shield
```kconfig
#
# Copyright (c) 2023 HARDWARIO a.s.
#
# SPDX-License-Identifier: LicenseRef-HARDWARIO-5-Clause
#

config SHIELD_CTR_X12_B
	def_bool $(shields_list_contains,ctr_x12_b)
```

## boards/shields/ctr_x13_a/Kconfig.defconfig
```kconfig
#
# Copyright (c) 2023 HARDWARIO a.s.
#
# SPDX-License-Identifier: LicenseRef-HARDWARIO-5-Clause
#

if SHIELD_CTR_X13_A

config CAN
	default y
	
config CAN_SHELL
	default y if SHELL

endif # SHIELD_CTR_X2_A
```

## boards/shields/ctr_x13_a/Kconfig.shield
```kconfig
#
# Copyright (c) 2023 HARDWARIO a.s.
#
# SPDX-License-Identifier: LicenseRef-HARDWARIO-5-Clause
#

config SHIELD_CTR_X13_A
	def_bool $(shields_list_contains,ctr_x13_a)
```

## boards/shields/ctr_x13_b/Kconfig.shield
```kconfig
#
# Copyright (c) 2023 HARDWARIO a.s.
#
# SPDX-License-Identifier: LicenseRef-HARDWARIO-5-Clause
#

config SHIELD_CTR_X13_B
	def_bool $(shields_list_contains,ctr_x13_b)
```

## boards/shields/ctr_x14_a/Kconfig.defconfig
```kconfig
#
# Copyright (c) 2024 HARDWARIO a.s.
#
# SPDX-License-Identifier: LicenseRef-HARDWARIO-5-Clause
#

if SHIELD_CTR_X14_A

config NET_L2_ETHERNET
	default y

config NETWORKING
	default y

endif # SHIELD_CTR_X14_A
```

## boards/shields/ctr_x14_b/Kconfig.shield
```kconfig
#
# Copyright (c) 2024 HARDWARIO a.s.
#
# SPDX-License-Identifier: LicenseRef-HARDWARIO-5-Clause
#

config SHIELD_CTR_X14_B
	def_bool $(shields_list_contains,ctr_x14_b)
```

## boards/shields/ctr_x1_a/Kconfig.defconfig
```kconfig
if SHIELD_CTR_X1_A

config GPIO
	default y

config I2C
	default y

config PM
	default y

config PM_DEVICE
	default y

config W1
	default y

config W1_DS2484
	default y

endif # SHIELD_CTR_X1_A
```

## boards/shields/ctr_x2/Kconfig.defconfig
```kconfig
if SHIELD_CTR_X2

config GPIO
	default y

config I2C
	default y

config SERIAL
	default y

config UART_SC16IS7XX
	default y

endif # SHIELD_CTR_X2
```

## boards/shields/ctr_x2_a/Kconfig.shield
```kconfig
#
# Copyright (c) 2023 HARDWARIO a.s.
#
# SPDX-License-Identifier: LicenseRef-HARDWARIO-5-Clause
#

config SHIELD_CTR_X2_A
	def_bool $(shields_list_contains,ctr_x2_a)
```

## boards/shields/ctr_x2_b/Kconfig.shield
```kconfig
#
# Copyright (c) 2023 HARDWARIO a.s.
#
# SPDX-License-Identifier: LicenseRef-HARDWARIO-5-Clause
#

config SHIELD_CTR_X2_B
	def_bool $(shields_list_contains,ctr_x2_b)
```

## boards/shields/ctr_x2_modbus_b/Kconfig.defconfig
```kconfig
#
# Copyright (c) 2023 HARDWARIO a.s.
#
# SPDX-License-Identifier: LicenseRef-HARDWARIO-5-Clause
#

if SHIELD_CTR_X2_MODBUS_B

config GPIO
	default y

config I2C
	default y

config MODBUS
	default y

config MODBUS_BUFFER_SIZE
	default 64

config PM_DEVICE
	default y

config SERIAL
	default y

config UART_0_INTERRUPT_DRIVEN
	default n

config UART_ASYNC_API
	default y

config UART_INTERRUPT_DRIVEN
	default y

config UART_LINE_CTRL
	default n

config UART_SC16IS7XX
	default y

endif # SHIELD_CTR_X2_MODBUS_B
```

## boards/shields/ctr_x2_modbus_b/Kconfig.shield
```kconfig
#
# Copyright (c) 2023 HARDWARIO a.s.
#
# SPDX-License-Identifier: LicenseRef-HARDWARIO-5-Clause
#

config SHIELD_CTR_X2_MODBUS_B
	def_bool $(shields_list_contains,ctr_x2_modbus_b)
	def_bool $(shields_list_contains,ctr_x2_b)
```
