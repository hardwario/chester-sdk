/*
 * Copyright (c) 2023 HARDWARIO a.s.
 *
 * SPDX-License-Identifier: LicenseRef-HARDWARIO-5-Clause
 */

/ {
	ctr_x9_b: ctr_x9_b {
		compatible = "hardwario,ctr-x9";
		status = "okay";
		output1-gpios = <&gpio0 28 0>;
		output2-gpios = <&gpio0 30 0>;
		output3-gpios = <&gpio0 4 0>;
		output4-gpios = <&gpio0 5 0>;
	};
};
