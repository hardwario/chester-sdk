/*
 * Copyright (c) 2023 HARDWARIO a.s.
 *
 * SPDX-License-Identifier: LicenseRef-HARDWARIO-5-Clause
 */

&ctr_x3_a {
	status = "okay";
};

&ctr_x3_ads122c04_a1 {
	status = "okay";
};

&ctr_x3_ads122c04_a2 {
	status = "okay";
};
