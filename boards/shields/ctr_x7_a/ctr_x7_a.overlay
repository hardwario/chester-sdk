/*
 * Copyright (c) 2023 HARDWARIO a.s.
 *
 * SPDX-License-Identifier: LicenseRef-HARDWARIO-5-Clause
 */

/ {
	ctr_x7_a: ctr_x7_a {
		compatible = "hardwario,ctr-x7";
		status = "okay";
		en-gpios = <&gpio0 31 GPIO_ACTIVE_HIGH>;
	};
};
