/*
 * Copyright (c) 2023 HARDWARIO a.s.
 *
 * SPDX-License-Identifier: LicenseRef-HARDWARIO-5-Clause
 */

/ {
	ctr_x7_b: ctr_x7_b {
		compatible = "hardwario,ctr-x7";
		status = "okay";
		en-gpios = <&gpio0 5 GPIO_ACTIVE_HIGH>;
	};
};
