/*
 * Copyright (c) 2023 HARDWARIO a.s.
 *
 * SPDX-License-Identifier: LicenseRef-HARDWARIO-5-Clause
 */

&i2c0 {
	people_counter: people_counter@7f {
		compatible = "adastra,people-counter";
		status = "okay";
		reg = <0x7f>;
	};

};
