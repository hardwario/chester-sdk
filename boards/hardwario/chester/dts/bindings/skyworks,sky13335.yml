## boards/hardwario/chester/dts/bindings/skyworks,sky13335.yml
```yaml
#
# Copyright (c) 2023 HARDWARIO a.s.
#
# SPDX-License-Identifier: LicenseRef-HARDWARIO-5-Clause
#

description: Output selectors for Skyworks SKY13335 GaAs SPDT Switch

compatible: "skyworks,sky13335"

include: [base.yaml]

properties:
  vctl1-gpios:
    type: phandle-array
    description: DC control voltage input. Active high.

  vctl2-gpios:
    type: phandle-array
    description: DC control voltage input. Active high.
```

## boards/shields/ctr_a1/Kconfig.defconfig
```kconfig
#
# Copyright (c) 2023 HARDWARIO a.s.
#
# SPDX-License-Identifier: LicenseRef-HARDWARIO-5-Clause
#

if SHIELD_CTR_A1

config CTR_A1
	default y

config GPIO
	default y

config GPIO_PCA953X
	default y

config I2C
	default y

endif # SHIELD_CTR_A1
```

## boards/shields/ctr_a1/Kconfig.shield
```kconfig
#
# Copyright (c) 2023 HARDWARIO a.s.
#
# SPDX-License-Identifier: LicenseRef-HARDWARIO-5-Clause
#

config SHIELD_CTR_A1
	def_bool $(shields_list_contains,ctr_a1)
```

## boards/shields/ctr_b1/Kconfig.defconfig
```kconfig
#
# Copyright (c) 2023 HARDWARIO a.s.
#
# SPDX-License-Identifier: LicenseRef-HARDWARIO-5-Clause
#

if SHIELD_CTR_B1

config CTR_B1
	default y

config GPIO
	default y

config GPIO_PCA953X
	default y

config I2C
	default y

endif # SHIELD_CTR_B1
```

## boards/shields/ctr_barometer_tag/Kconfig.defconfig
```kconfig
#
# Copyright (c) 2023 HARDWARIO a.s.
#
# SPDX-License-Identifier: LicenseRef-HARDWARIO-5-Clause
#

if SHIELD_CTR_BAROMETER_TAG

config I2C
	default y

config SENSOR
	default y

config MPL3115A2
	default y

endif # SHIELD_CTR_BAROMETER_TAG
```

## boards/shields/ctr_barometer_tag/Kconfig.shield
```kconfig
#
# Copyright (c) 2023 HARDWARIO a.s.
#
# SPDX-License-Identifier: LicenseRef-HARDWARIO-5-Clause
#

config SHIELD_CTR_BAROMETER_TAG
	def_bool $(shields_list_contains,ctr_barometer_tag)
```

## boards/shields/ctr_c1/Kconfig.defconfig
```kconfig
if SHIELD_CTR_C1

config GPIO
	default y

config GPIO_PCA953X
	default y

config I2C
	default y

endif # SHIELD_CTR_C1
```

## boards/shields/ctr_c2/Kconfig.shield
```kconfig
#
# Copyright (c) 2023 HARDWARIO a.s.
#
# SPDX-License-Identifier: LicenseRef-HARDWARIO-5-Clause
#

config SHIELD_CTR_C2
	def_bool $(shields_list_contains,ctr_c2)
```

## boards/shields/ctr_ds18b20/Kconfig.defconfig
```kconfig
#
# Copyright (c) 2023 HARDWARIO a.s.
#
# SPDX-License-Identifier: LicenseRef-HARDWARIO-5-Clause
#

if SHIELD_CTR_DS18B20

config CTR_DS18B20
	default y

endif # SHIELD_CTR_DS18B20
```

## boards/shields/ctr_ds18b20/Kconfig.shield
```kconfig
#
# Copyright (c) 2023 HARDWARIO a.s.
#
# SPDX-License-Identifier: LicenseRef-HARDWARIO-5-Clause
#

config SHIELD_CTR_DS18B20
	def_bool $(shields_list_contains,ctr_ds18b20)
```

## boards/shields/ctr_gnss/Kconfig.defconfig
```kconfig
#
# Copyright (c) 2023 HARDWARIO a.s.
#
# SPDX-License-Identifier: LicenseRef-HARDWARIO-5-Clause
#

if SHIELD_CTR_GNSS

config CTR_GNSS
	default y
	
# Disables mainline UART-based driver
config GNSS_U_BLOX_M8
	default n

endif # SHIELD_CTR_GNSS
```

## boards/shields/ctr_gnss/Kconfig.shield
```kconfig
#
# Copyright (c) 2023 HARDWARIO a.s.
#
# SPDX-License-Identifier: LicenseRef-HARDWARIO-5-Clause
#

config SHIELD_CTR_GNSS
	def_bool $(shields_list_contains,ctr_gnss)
```

## boards/shields/ctr_k1/Kconfig.defconfig
```kconfig
#
# Copyright (c) 2023 HARDWARIO a.s.
#
# SPDX-License-Identifier: LicenseRef-HARDWARIO-5-Clause
#

if SHIELD_CTR_K1

config CTR_K1
	default y

endif # SHIELD_CTR_K1
```

## boards/shields/ctr_k1/Kconfig.shield
```kconfig
#
# Copyright (c) 2023 HARDWARIO a.s.
#
# SPDX-License-Identifier: LicenseRef-HARDWARIO-5-Clause
#

config SHIELD_CTR_K1
	def_bool $(shields_list_contains,ctr_k1)
```

## boards/shields/ctr_lrw/Kconfig.defconfig
```kconfig
#
# Copyright (c) 2023 HARDWARIO a.s.
#
# SPDX-License-Identifier: LicenseRef-HARDWARIO-5-Clause
#

if SHIELD_CTR_LRW

config CTR_LRW
	default y

endif # SHIELD_CTR_LRW
```

## boards/shields/ctr_lrw/Kconfig.shield
```kconfig
#
# Copyright (c) 2023 HARDWARIO a.s.
#
# SPDX-License-Identifier: LicenseRef-HARDWARIO-5-Clause
#

config SHIELD_CTR_LRW
	def_bool $(shields_list_contains,ctr_lrw)
```

## boards/shields/ctr_lte/Kconfig.defconfig
```kconfig
#
# Copyright (c) 2023 HARDWARIO a.s.
#
# SPDX-License-Identifier: LicenseRef-HARDWARIO-5-Clause
#

if SHIELD_CTR_LTE

config CTR_LTE
	default y

endif # SHIELD_CTR_LTE
```

## boards/shields/ctr_lte/Kconfig.shield
```kconfig
#
# Copyright (c) 2023 HARDWARIO a.s.
#
# SPDX-License-Identifier: LicenseRef-HARDWARIO-5-Clause
#

config SHIELD_CTR_LTE
	def_bool $(shields_list_contains,ctr_lte)
```
