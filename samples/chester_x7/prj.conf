## CMakeLists.txt
```
#
# Copyright (c) 2023 HARDWARIO a.s.
#
# SPDX-License-Identifier: LicenseRef-HARDWARIO-5-Clause
#

cmake_minimum_required(VERSION 3.20.0)

set(SHIELD ctr_x7_a)
find_package(Zephyr REQUIRED HINTS $ENV{ZEPHYR_BASE})
project(chester_x7)

target_sources(app PRIVATE src/main.c)
```

## prj.conf
```kconfig
#
# Copyright (c) 2023 HARDWARIO a.s.
#
# SPDX-License-Identifier: LicenseRef-HARDWARIO-5-Clause
#

CONFIG_ADC_NRFX_SAADC=n
CONFIG_ADC_SHELL=n
CONFIG_CBPRINTF_FP_SUPPORT=y
CONFIG_CTR_DEFAULTS=y
CONFIG_CTR_LOG=y
CONFIG_CTR_SHELL=y
CONFIG_CTR_X7_LOG_LEVEL_DBG=y
```

## src/main.c
```c
/*
 * Copyright (c) 2023 HARDWARIO a.s.
 *
 * SPDX-License-Identifier: LicenseRef-HARDWARIO-5-Clause
 */

/* CHESTER includes */
#include <chester/drivers/ctr_x7.h>

/* Zephyr includes */
#include <zephyr/device.h>
#include <zephyr/devicetree.h>
#include <zephyr/kernel.h>
#include <zephyr/logging/log.h>

/* Standard includes */
#include <math.h>
#include <stdbool.h>

LOG_MODULE_REGISTER(main, LOG_LEVEL_DBG);

int main(void)
{
	int ret;

	LOG_INF("Build time: " __DATE__ " " __TIME__);

	static const struct device *dev = DEVICE_DT_GET(DT_NODELABEL(ctr_x7_a));

	if (!device_is_ready(dev)) {
		LOG_ERR("Device not ready");
		k_oops();
	}

	static const struct ctr_x7_calibration calibrations[] = {
		{.x0 = NAN, .y0 = NAN, .x1 = NAN, .y1 = NAN},
		{.x0 = NAN, .y0 = NAN, .x1 = NAN, .y1 = NAN},
		{.x0 = NAN, .y0 = NAN, .x1 = NAN, .y1 = NAN},
		{.x0 = NAN, .y0 = NAN, .x1 = NAN, .y1 = NAN},
	};

#if 0
	ret = ctr_x7_set_power(dev, true);
	if (ret) {
		LOG_ERR("Call `ctr_x7_set_power` failed: %d", ret);
		k_oops();
	}

	k_sleep(K_MSEC(100));
#endif

	for (;;) {
		LOG_INF("Alive");

#if 1
		ret = ctr_x7_set_power(dev, true);
		if (ret) {
			LOG_ERR("Call `ctr_x7_set_power` failed: %d", ret);
			k_oops();
		}

		k_sleep(K_MSEC(100));
#endif

		struct ctr_x7_result results[2] = {0};
		ret = ctr_x7_measure(dev, calibrations, results);
		if (ret) {
			LOG_ERR("Call `ctr_x7_measure` failed: %d", ret);
			k_oops();
		}

#if 1
		ret = ctr_x7_set_power(dev, false);
		if (ret) {
			LOG_ERR("Call `ctr_x7_set_power` failed: %d", ret);
			k_oops();
		}
#endif

		k_sleep(K_SECONDS(1));
	}

	return 0;
}
```
