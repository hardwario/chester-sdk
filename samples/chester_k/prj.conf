## CMakeLists.txt
```
#
# Copyright (c) 2023 HARDWARIO a.s.
#
# SPDX-License-Identifier: LicenseRef-HARDWARIO-5-Clause
#

cmake_minimum_required(VERSION 3.20.0)

set(SHIELD ctr_k1)
find_package(Zephyr REQUIRED HINTS $ENV{ZEPHYR_BASE})
project(chester_k)

target_sources(app PRIVATE src/main.c)
```

## prj.conf
```kconfig
#
# Copyright (c) 2023 HARDWARIO a.s.
#
# SPDX-License-Identifier: LicenseRef-HARDWARIO-5-Clause
#

CONFIG_ADC_NRFX_SAADC=n
CONFIG_ADC_SHELL=n
CONFIG_CBPRINTF_FP_SUPPORT=y
CONFIG_CTR_DEFAULTS=y
CONFIG_CTR_K1_LOG_LEVEL_DBG=y
CONFIG_CTR_LOG=y
CONFIG_CTR_SHELL=y
```

## src/main.c
```c
/*
 * Copyright (c) 2023 HARDWARIO a.s.
 *
 * SPDX-License-Identifier: LicenseRef-HARDWARIO-5-Clause
 */

/* CHESTER includes */
#include <chester/drivers/ctr_k1.h>

/* Zephyr includes */
#include <zephyr/device.h>
#include <zephyr/devicetree.h>
#include <zephyr/kernel.h>
#include <zephyr/logging/log.h>

/* Standard includes */
#include <math.h>
#include <stdbool.h>

LOG_MODULE_REGISTER(main, LOG_LEVEL_DBG);

int main(void)
{
	int ret;

	LOG_INF("Build time: " __DATE__ " " __TIME__);

	static const struct device *dev = DEVICE_DT_GET(DT_NODELABEL(ctr_k1));

	if (!device_is_ready(dev)) {
		LOG_ERR("Device not ready");
		k_oops();
	}

	static const enum ctr_k1_channel channels[] = {
		CTR_K1_CHANNEL_1_DIFFERENTIAL,
		CTR_K1_CHANNEL_2_DIFFERENTIAL,
		CTR_K1_CHANNEL_3_DIFFERENTIAL,
		CTR_K1_CHANNEL_4_DIFFERENTIAL,
	};

#if 0
	for (size_t i = 0; i < ARRAY_SIZE(channels); i++) {
		ret = ctr_k1_set_power(dev, channels[i], true);
		if (ret) {
			LOG_ERR("Call `ctr_k1_set_power` failed: %d", ret);
			k_oops();
		}
	}
#endif

	for (;;) {
		LOG_INF("Alive");

#if 1
		for (size_t i = 0; i < ARRAY_SIZE(channels); i++) {
			ret = ctr_k1_set_power(dev, channels[i], true);
			if (ret) {
				LOG_ERR("Call `ctr_k1_set_power` failed: %d", ret);
				k_oops();
			}
		}

		k_sleep(K_MSEC(100));
#endif

		struct ctr_k1_result results[ARRAY_SIZE(channels)] = {0};
		ret = ctr_k1_measure(dev, channels, ARRAY_SIZE(channels), results);
		if (ret) {
			LOG_ERR("Call `ctr_k1_measure` failed: %d", ret);
			k_oops();
		}

#if 1
		for (size_t i = 0; i < ARRAY_SIZE(channels); i++) {
			ret = ctr_k1_set_power(dev, channels[i], false);
			if (ret) {
				LOG_ERR("Call `ctr_k1_set_power` failed: %d", ret);
				k_oops();
			}
		}
#endif

		k_sleep(K_SECONDS(1));
	}

	return 0;
}
```
