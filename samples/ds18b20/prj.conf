## CMakeLists.txt
```
#
# Copyright (c) 2023 HARDWARIO a.s.
#
# SPDX-License-Identifier: LicenseRef-HARDWARIO-5-Clause
#

cmake_minimum_required(VERSION 3.20.0)

set(SHIELD ctr_ds18b20)
find_package(Zephyr REQUIRED HINTS $ENV{ZEPHYR_BASE})
project(ds18b20)

target_sources(app PRIVATE src/main.c)
```

## prj.conf
```kconfig
#
# Copyright (c) 2023 HARDWARIO a.s.
#
# SPDX-License-Identifier: LicenseRef-HARDWARIO-5-Clause
#

CONFIG_CBPRINTF_FP_SUPPORT=y
CONFIG_CTR_DEFAULTS=y
CONFIG_CTR_DS18B20_LOG_LEVEL_DBG=y
CONFIG_CTR_LED=y
CONFIG_CTR_LOG=y
CONFIG_CTR_SHELL=y
CONFIG_SENSOR_LOG_LEVEL_DBG=y
CONFIG_W1_LOG_LEVEL_DBG=y
```

## app.overlay
```dts
&ds2484 {
	active-pullup;

	ds18b20_0: ds18b20_0 {
		compatible = "maxim,ds18b20";
		resolution = <12>;
		family-code = <0x28>;
		label = "DS18B20_0";
	};

	ds18b20_1: ds18b20_1 {
		compatible = "maxim,ds18b20";
		resolution = <12>;
		family-code = <0x28>;
		label = "DS18B20_1";
	};
};
```

## src/main.c
```c
/*
 * Copyright (c) 2023 HARDWARIO a.s.
 *
 * SPDX-License-Identifier: LicenseRef-HARDWARIO-5-Clause
 */

/* CHESTER includes */
#include <chester/ctr_ds18b20.h>
#include <chester/ctr_led.h>

/* Zephyr includes */
#include <zephyr/kernel.h>
#include <zephyr/logging/log.h>

/* Standard includes */
#include <stdint.h>

LOG_MODULE_REGISTER(main, LOG_LEVEL_DBG);

int main(void)
{
	int ret;

	LOG_INF("Build time: " __DATE__ " " __TIME__);

	ret = ctr_ds18b20_scan();
	if (ret) {
		LOG_ERR("Call `ctr_ds18b20_scan` failed: %d", ret);
		k_oops();
	}

	for (;;) {
		LOG_INF("Alive");

		ctr_led_set(CTR_LED_CHANNEL_R, true);
		k_sleep(K_MSEC(10));
		ctr_led_set(CTR_LED_CHANNEL_R, false);

		int count = ctr_ds18b20_get_count();

		for (int i = 0; i < count; i++) {
			uint64_t serial_number;
			float temperature;
			ret = ctr_ds18b20_read(i, &serial_number, &temperature);
			if (ret) {
				LOG_ERR("Call `ctr_ds18b20_read` failed: %d", ret);
			} else {
				LOG_INF("Serial number: %llu / Temperature: %.2f C", serial_number,
					(double)temperature);
			}
		}

		k_sleep(K_SECONDS(10));
	}

	return 0;
}
```
