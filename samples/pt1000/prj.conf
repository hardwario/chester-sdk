## CMakeLists.txt
```
#
# Copyright (c) 2023 HARDWARIO a.s.
#
# SPDX-License-Identifier: LicenseRef-HARDWARIO-5-Clause
#

cmake_minimum_required(VERSION 3.20.0)

set(SHIELD ctr_rtd_a)
find_package(Zephyr REQUIRED HINTS $ENV{ZEPHYR_BASE})
project(pt1000)

target_sources(app PRIVATE src/main.c)
```

## prj.conf
```kconfig
#
# Copyright (c) 2023 HARDWARIO a.s.
#
# SPDX-License-Identifier: LicenseRef-HARDWARIO-5-Clause
#

CONFIG_ADC_LOG_LEVEL_DBG=y
CONFIG_CTR_DEFAULTS=y
CONFIG_CTR_LOG=y
CONFIG_CTR_RTD=y
CONFIG_CTR_SHELL=y
```

## app.overlay
```dts
&ctr_x3_ads122c04_a1 {
	vref = <1>;
	idac = <6>;
	i1mux = <4>;
};
```

## src/main.c
```c
/*
 * Copyright (c) 2023 HARDWARIO a.s.
 *
 * SPDX-License-Identifier: LicenseRef-HARDWARIO-5-Clause
 */

/* CHESTER includes */
#include <chester/ctr_rtd.h>

/* Zephyr includes */
#include <zephyr/device.h>
#include <zephyr/devicetree.h>
#include <zephyr/kernel.h>
#include <zephyr/logging/log.h>

LOG_MODULE_REGISTER(main, LOG_LEVEL_DBG);

int main(void)
{
	int ret;

	LOG_INF("Build time: " __DATE__ " " __TIME__);

	for (;;) {
		float temperature;
		ret = ctr_rtd_read(CTR_RTD_CHANNEL_A1, CTR_RTD_TYPE_PT1000, &temperature);
		if (ret) {
			LOG_ERR("Call `ctr_rtd_read` failed: %d", ret);
			k_oops();
		}

		LOG_INF("Temperature: %.3f C", (double)temperature);

		k_sleep(K_SECONDS(1));
	}

	return 0;
}
```
