## CMakeLists.txt
```
cmake_minimum_required(VERSION 3.20.0)

find_package(Zephyr REQUIRED HINTS $ENV{ZEPHYR_BASE})
project(blinky)

target_sources(app PRIVATE src/main.c)
```

## prj.conf
```kconfig
CONFIG_CTR_BUTTON=y
CONFIG_CTR_DEFAULTS=y
CONFIG_CTR_LED=y
CONFIG_CTR_LOG=y
CONFIG_CTR_SHELL=y
CONFIG_LOG_BACKEND_RTT_MODE_DROP=y
```

## src/main.c
```c
/*
 * Copyright (c) 2023 HARDWARIO a.s.
 *
 * SPDX-License-Identifier: LicenseRef-HARDWARIO-5-Clause
 */

/* CHESTER includes */
#include <chester/ctr_led.h>

/* Zephyr includes */
#include <zephyr/kernel.h>
#include <zephyr/logging/log.h>

LOG_MODULE_REGISTER(main, LOG_LEVEL_DBG);

int main(void)
{
	LOG_INF("Build time: " __DATE__ " " __TIME__);

	for (;;) {
		LOG_INF("Alive");

		/* Control LED */
		ctr_led_set(CTR_LED_CHANNEL_R, true);
		k_sleep(K_MSEC(500));
		ctr_led_set(CTR_LED_CHANNEL_R, false);

		/* Wait 500 ms */
		k_sleep(K_MSEC(500));
	}

	return 0;
}
```
