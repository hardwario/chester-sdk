## CMakeLists.txt
```
#
# Copyright (c) 2023 HARDWARIO a.s.
#
# SPDX-License-Identifier: LicenseRef-HARDWARIO-5-Clause
#

cmake_minimum_required(VERSION 3.20.0)

set(SHIELD ctr_x4_a)
find_package(Zephyr REQUIRED HINTS $ENV{ZEPHYR_BASE})
project(chester_x4)

target_sources(app PRIVATE src/main.c)
```

## prj.conf
```kconfig
#
# Copyright (c) 2023 HARDWARIO a.s.
#
# SPDX-License-Identifier: LicenseRef-HARDWARIO-5-Clause
#

CONFIG_CTR_DEFAULTS=y
CONFIG_CTR_LOG=y
CONFIG_CTR_SHELL=y
```

## app.overlay
```dts
/*
 * Copyright (c) 2023 HARDWARIO a.s.
 *
 * SPDX-License-Identifier: LicenseRef-HARDWARIO-5-Clause
 */

&ctr_x4_a {
	line-measurement-interval = <1000>;
	line-threshold-min = <6000>;
	line-threshold-max = <9000>;
};
```

## src/main.c
```c
/*
 * Copyright (c) 2023 HARDWARIO a.s.
 *
 * SPDX-License-Identifier: LicenseRef-HARDWARIO-5-Clause
 */

/* CHESTER includes */
#include <chester/drivers/ctr_x4.h>

/* Zephyr includes */
#include <zephyr/device.h>
#include <zephyr/devicetree.h>
#include <zephyr/kernel.h>
#include <zephyr/logging/log.h>

/* Standard includes */
#include <stdbool.h>

LOG_MODULE_REGISTER(main, LOG_LEVEL_DBG);

static void ctr_x4_handler(const struct device *dev, enum ctr_x4_event event, void *user_data)
{
	switch (event) {
	case CTR_X4_EVENT_LINE_CONNECTED:
		LOG_INF("Line connected");
		break;
	case CTR_X4_EVENT_LINE_DISCONNECTED:
		LOG_INF("Line disconnected");
		break;
	default:
		LOG_ERR("Unknown event: %d", event);
		k_oops();
	}
}

int main(void)
{
	int ret;

	LOG_INF("Build time: " __DATE__ " " __TIME__);

	static const struct device *dev = DEVICE_DT_GET(DT_NODELABEL(ctr_x4_a));

	if (!device_is_ready(dev)) {
		LOG_ERR("Device not ready");
		k_oops();
	}

	ret = ctr_x4_set_handler(dev, ctr_x4_handler, NULL);
	if (ret) {
		LOG_ERR("Call `ctr_x4_set_handler` failed: %d", ret);
		k_oops();
	}

	for (;;) {
		LOG_INF("Alive");

		int line_voltage_mv;
		ret = ctr_x4_get_line_voltage(dev, &line_voltage_mv);
		if (ret) {
			LOG_ERR("Call `ctr_x4_get_line_voltage` failed: %d", ret);
			k_oops();
		}

		LOG_INF("Line voltage: %d mV", line_voltage_mv);

		enum ctr_x4_line_state line_state;
		ret = ctr_x4_get_line_state(dev, &line_state);
		if (ret) {
			LOG_ERR("Call `ctr_x4_get_line_state` failed: %d", ret);
			k_oops();
		}

		switch (line_state) {
		case CTR_X4_LINE_STATE_UNKNOWN:
			LOG_INF("Line state: unknown");
			break;
		case CTR_X4_LINE_STATE_CONNECTED:
			LOG_INF("Line state: connected");
			break;
		case CTR_X4_LINE_STATE_DISCONNECTED:
			LOG_INF("Line state: disconnected");
			break;
		}

		ret = ctr_x4_set_output(dev, CTR_X4_OUTPUT_1, true);
		if (ret) {
			LOG_ERR("Call `ctr_x4_set_output` failed: %d", ret);
			k_oops();
		}

		k_sleep(K_SECONDS(5));

		ret = ctr_x4_set_output(dev, CTR_X4_OUTPUT_1, false);
		if (ret) {
			LOG_ERR("Call `ctr_x4_set_output` failed: %d", ret);
			k_oops();
		}

		k_sleep(K_SECONDS(5));

		ret = ctr_x4_set_output(dev, CTR_X4_OUTPUT_2, true);
		if (ret) {
			LOG_ERR("Call `ctr_x4_set_output` failed: %d", ret);
			k_oops();
		}

		k_sleep(K_SECONDS(5));

		ret = ctr_x4_set_output(dev, CTR_X4_OUTPUT_2, false);
		if (ret) {
			LOG_ERR("Call `ctr_x4_set_output` failed: %d", ret);
			k_oops();
		}

		k_sleep(K_SECONDS(5));

		ret = ctr_x4_set_output(dev, CTR_X4_OUTPUT_3, true);
		if (ret) {
			LOG_ERR("Call `ctr_x4_set_output` failed: %d", ret);
			k_oops();
		}

		k_sleep(K_SECONDS(5));

		ret = ctr_x4_set_output(dev, CTR_X4_OUTPUT_3, false);
		if (ret) {
			LOG_ERR("Call `ctr_x4_set_output` failed: %d", ret);
			k_oops();
		}

		k_sleep(K_SECONDS(5));

		ret = ctr_x4_set_output(dev, CTR_X4_OUTPUT_4, true);
		if (ret) {
			LOG_ERR("Call `ctr_x4_set_output` failed: %d", ret);
			k_oops();
		}

		k_sleep(K_SECONDS(5));

		ret = ctr_x4_set_output(dev, CTR_X4_OUTPUT_4, false);
		if (ret) {
			LOG_ERR("Call `ctr_x4_set_output` failed: %d", ret);
			k_oops();
		}

		k_sleep(K_SECONDS(5));
	}

	return 0;
}
```
