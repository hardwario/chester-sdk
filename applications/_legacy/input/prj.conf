## CMakeLists.txt
```
#
# Copyright (c) 2023 HARDWARIO a.s.
#
# SPDX-License-Identifier: LicenseRef-HARDWARIO-5-Clause
#

cmake_minimum_required(VERSION 3.20.0)

# Supported shields: ctr_lrw ctr_x0_a ctr_x0_b ctr_s2 ctr_z
set(SHIELD ctr_lrw ctr_x0_a ctr_x0_b ctr_z)

find_package(Zephyr REQUIRED HINTS $ENV{ZEPHYR_BASE})
project(input)

target_sources(app PRIVATE src/app_config.c)
target_sources(app PRIVATE src/app_shell.c)

target_sources(app PRIVATE src/main.c)
```

## prj.conf
```kconfig
#
# Copyright (c) 2023 HARDWARIO a.s.
#
# SPDX-License-Identifier: LicenseRef-HARDWARIO-5-Clause
#

CONFIG_ADC_NRFX_SAADC=n
CONFIG_ADC_SHELL=n
CONFIG_CBPRINTF_FP_SUPPORT=y
CONFIG_CTR_ACCEL=y
CONFIG_CTR_BATT=y
CONFIG_CTR_BLE=y
CONFIG_CTR_BUF=y
CONFIG_CTR_BUTTON=y
CONFIG_CTR_CONFIG=y
CONFIG_CTR_DEFAULTS=y
CONFIG_CTR_EDGE=y
CONFIG_CTR_INFO=y
CONFIG_CTR_LED=y
CONFIG_CTR_LOG=y
CONFIG_CTR_RTC=y
CONFIG_CTR_SHELL=y
CONFIG_CTR_TEST=y
CONFIG_CTR_THERM=y
CONFIG_ENTROPY_GENERATOR=y

CONFIG_ADC_TLA2021_INIT_PRIORITY=60
```

## src/app_config.c
```c
/*
 * Copyright (c) 2023 HARDWARIO a.s.
 *
 * SPDX-License-Identifier: LicenseRef-HARDWARIO-5-Clause
 */

#include "app_config.h"

#include <chester/ctr_config.h>

/* Zephyr includes */
#include <zephyr/init.h>
#include <zephyr/kernel.h>
#include <zephyr/logging/log.h>
#include <zephyr/settings/settings.h>
#include <zephyr/shell/shell.h>

/* Standard includes */
#include <ctype.h>
#include <stdlib.h>

LOG_MODULE_REGISTER(app_config, LOG_LEVEL_DBG);

#define SETTINGS_PFX "app"

struct app_config g_app_config;
static struct app_config m_app_config_interim = {
	.active_filter = 50,
	.inactive_filter = 50,
	.report_interval = 300,
};

static void print_active_filter(const struct shell *shell)
{
	shell_print(shell, SETTINGS_PFX " config active-filter %d",
		    m_app_config_interim.active_filter);
}

static void print_inactive_filter(const struct shell *shell)
{
	shell_print(shell, SETTINGS_PFX " config inactive-filter %d",
		    m_app_config_interim.inactive_filter);
}

static void print_report_interval(const struct shell *shell)
{
	shell_print(shell, SETTINGS_PFX " config report-interval %d",
		    m_app_config_interim.report_interval);
}

int app_config_cmd_config_show(const struct shell *shell, size_t argc, char **argv)
{
	print_active_filter(shell);
	print_inactive_filter(shell);
	print_report_interval(shell);

	return 0;
}

int app_config_cmd_config_active_filter(const struct shell *shell, size_t argc, char **argv)
{
	if (argc == 1) {
		print_active_filter(shell);
		return 0;
	}

	if (argc == 2) {
		size_t len = strlen(argv[1]);

		for (size_t i = 0; i < len; i++) {
			if (!isdigit((int)argv[1][i])) {
				shell_error(shell, "invalid format");
				return -EINVAL;
			}
		}

		int active_filter = atoi(argv[1]);

		if (active_filter < 10 || active_filter > 3600000) {
			shell_error(shell, "invalid range");
			return -EINVAL;
		}

		m_app_config_interim.active_filter = active_filter;

		return 0;
	}

	shell_help(shell);
	return -EINVAL;
}

int app_config_cmd_config_inactive_filter(const struct shell *shell, size_t argc, char **argv)
{
	if (argc == 1) {
		print_inactive_filter(shell);
		return 0;
	}

	if (argc == 2) {
		size_t len = strlen(argv[1]);

		for (size_t i = 0; i < len; i++) {
			if (!isdigit((int)argv[1][i])) {
				shell_error(shell, "invalid format");
				return -EINVAL;
			}
		}

		int inactive_filter = atoi(argv[1]);

		if (inactive_filter < 10 || inactive_filter > 3600000) {
			shell_error(shell, "invalid range");
			return -EINVAL;
		}

		m_app_config_interim.inactive_filter = inactive_filter;

		return 0;
	}

	shell_help(shell);
	return -EINVAL;
}

int app_config_cmd_config_report_interval(const struct shell *shell, size_t argc, char **argv)
{
	if (argc == 1) {
		print_report_interval(shell);
		return 0;
	}

	if (argc == 2) {
		size_t len = strlen(argv[1]);

		for (size_t i = 0; i < len; i++) {
			if (!isdigit((int)argv[1][i])) {
				shell_error(shell, "invalid format");
				return -EINVAL;
			}
		}

		int report_interval = atoi(argv[1]);

		if (report_interval < 30 || report_interval > 86400) {
			shell_error(shell, "invalid range");
			return -EINVAL;
		}

		m_app_config_interim.report_interval = report_interval;

		return 0;
	}

	shell_help(shell);
	return -EINVAL;
}

static int h_set(const char *key, size_t len, settings_read_cb read_cb, void *cb_arg)
{
	int ret;
	const char *next;

#define SETTINGS_SET(_key, _var, _size)                                                            \
	do {                                                                                       \
		if (settings_name_steq(key, _key, &next) && !next) {                               \
			if (len != _size) {                                                        \
				return -EINVAL;                                                    \
			}                                                                          \
                                                                                                   \
			ret = read_cb(cb_arg, _var, len);                                          \
                                                                                                   \
			if (ret < 0) {                                                             \
				LOG_ERR("Call `read_cb` failed: %d", ret);                         \
				return ret;                                                        \
			}                                                                          \
                                                                                                   \
			return 0;                                                                  \
		}                                                                                  \
	} while (0)

	SETTINGS_SET("active-filter", &m_app_config_interim.active_filter,
		     sizeof(m_app_config_interim.active_filter));
	SETTINGS_SET("inactive-filter", &m_app_config_interim.inactive_filter,
		     sizeof(m_app_config_interim.inactive_filter));
	SETTINGS_SET("report-interval", &m_app_config_interim.report_interval,
		     sizeof(m_app_config_interim.report_interval));

#undef SETTINGS_SET

	return -ENOENT;
}

static int h_commit(void)
{
	LOG_DBG("Loaded settings in full");
	memcpy(&g_app_config, &m_app_config_interim, sizeof(g_app_config));
	return 0;
}

static int h_export(int (*export_func)(const char *name, const void *val, size_t val_len))
{
#define EXPORT_FUNC(_key, _var, _size)                                                             \
	do {                                                                                       \
		int ret = export_func(SETTINGS_PFX "/" _key, _var, _size);                         \
		if (ret != 0) {                                                                    \
			LOG_ERR("Call `export_func` failed: %d", ret);                             \
			return ret;                                                                \
		}                                                                                  \
	} while (0)

	EXPORT_FUNC("active-filter", &m_app_config_interim.active_filter,
		    sizeof(m_app_config_interim.active_filter));
	EXPORT_FUNC("inactive-filter", &m_app_config_interim.inactive_filter,
		    sizeof(m_app_config_interim.inactive_filter));
	EXPORT_FUNC("report-interval", &m_app_config_interim.report_interval,
		    sizeof(m_app_config_interim.report_interval));

#undef EXPORT_FUNC

	return 0;
}

static int init(void)
{
	int ret;

	LOG_INF("System initialization");

	static struct settings_handler sh = {
		.name = SETTINGS_PFX,
		.h_set = h_set,
		.h_commit = h_commit,
		.h_export = h_export,
	};

	ret = settings_register(&sh);

	if (ret < 0) {
		LOG_ERR("Call `settings_register` failed: %d", ret);
		return ret;
	}

	ret = settings_load_subtree(SETTINGS_PFX);

	if (ret < 0) {
		LOG_ERR("Call `settings_load_subtree` failed: %d", ret);
		return ret;
	}

	ctr_config_append_show(SETTINGS_PFX, app_config_cmd_config_show);

	return 0;
}

SYS_INIT(init, APPLICATION, CONFIG_APPLICATION_INIT_PRIORITY);
```

## src/app_config.h
```c
/*
 * Copyright (c) 2023 HARDWARIO a.s.
 *
 * SPDX-License-Identifier: LicenseRef-HARDWARIO-5-Clause
 */

#ifndef APP_CONFIG_H_
#define APP_CONFIG_H_

/* Zephyr includes */
#include <zephyr/shell/shell.h>

/* Standard includes */
#include <stddef.h>

#ifdef __cplusplus
extern "C" {
#endif

struct app_config {
	int active_filter;
	int inactive_filter;
	int report_interval;
};

extern struct app_config g_app_config;

int app_config_cmd_config_show(const struct shell *shell, size_t argc, char **argv);
int app_config_cmd_config_active_filter(const struct shell *shell, size_t argc, char **argv);
int app_config_cmd_config_inactive_filter(const struct shell *shell, size_t argc, char **argv);
int app_config_cmd_config_report_interval(const struct shell *shell, size_t argc, char **argv);

#ifdef __cplusplus
}
#endif

#endif /* APP_CONFIG_H_ */
```

## src/app_shell.c
```c
/*
 * Copyright (c) 2023 HARDWARIO a.s.
 *
 * SPDX-License-Identifier: LicenseRef-HARDWARIO-5-Clause
 */

#include "app_config.h"

/* Zephyr includes */
#include <zephyr/kernel.h>
#include <zephyr/logging/log.h>
#include <zephyr/shell/shell.h>

LOG_MODULE_REGISTER(app_shell, LOG_LEVEL_INF);

static int print_help(const struct shell *shell, size_t argc, char **argv)
{
	if (argc > 1) {
		shell_error(shell, "command not found: %s", argv[1]);
		shell_help(shell);
		return -EINVAL;
	}

	shell_help(shell);

	return 0;
}

/* clang-format off */

SHELL_STATIC_SUBCMD_SET_CREATE(
	sub_app_config,

	SHELL_CMD_ARG(show, NULL,
	              "List current configuration.",
	              app_config_cmd_config_show, 1, 0),

	SHELL_CMD_ARG(active-filter, NULL,
	              "Get/Set active filter in milliseconds (format: <10-3600000>).",
	              app_config_cmd_config_active_filter, 1, 1),

	SHELL_CMD_ARG(inactive-filter, NULL,
	              "Get/Set inactive filter in milliseconds (format: <10-3600000>).",
	              app_config_cmd_config_inactive_filter, 1, 1),

	SHELL_CMD_ARG(report-interval, NULL,
	              "Get/Set report interval in seconds (format: <30-86400>).",
	              app_config_cmd_config_report_interval, 1, 1),

	SHELL_SUBCMD_SET_END
);

SHELL_STATIC_SUBCMD_SET_CREATE(
	sub_app,

	SHELL_CMD_ARG(config, &sub_app_config, "Configuration commands.",
	              print_help, 1, 0),

	SHELL_SUBCMD_SET_END
);

SHELL_CMD_REGISTER(app, &sub_app, "Application commands.", print_help);

/* clang-format on */
```
