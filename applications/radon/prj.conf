## CMakeLists.txt
```
#
# Copyright (c) 2024 HARDWARIO a.s.
#
# SPDX-License-Identifier: LicenseRef-HARDWARIO-5-Clause
#

cmake_minimum_required(VERSION 3.20.0)

set(ENV{FW_BUNDLE} "None")
set(ENV{FW_VERSION} "v2.1.0")
set(ENV{FW_NAME} "CHESTER Radon")

find_package(Zephyr REQUIRED HINTS $ENV{ZEPHYR_BASE})

project(chester-radon)

add_custom_command(
    COMMAND west gen-codec -d ../codec/cbor-decoder.yaml -e ../codec/cbor-encoder.yaml -o ../src/app_codec.h
    OUTPUT ../src/app_codec.h
    DEPENDS ../codec/cbor-decoder.yaml
)

target_sources(app PRIVATE src/app_backup.c)
target_sources(app PRIVATE src/app_cbor.c)
target_sources(app PRIVATE src/app_codec.h)
target_sources(app PRIVATE src/app_config.c)
target_sources(app PRIVATE src/app_data.c)
target_sources(app PRIVATE src/app_handler.c)
target_sources(app PRIVATE src/app_init.c)
target_sources(app PRIVATE src/app_power.c)
target_sources(app PRIVATE src/app_radon.c)
target_sources(app PRIVATE src/app_send.c)
target_sources(app PRIVATE src/app_sensor.c)
target_sources(app PRIVATE src/app_shell.c)
target_sources(app PRIVATE src/app_tamper.c)
target_sources(app PRIVATE src/app_work.c)
target_sources(app PRIVATE src/main.c)

target_precompile_headers(app PRIVATE src/feature.h)

# ### Preserved code "cmake" (begin)
# ^^^ Preserved code "cmake" (end)
```

## Kconfig
```
#
# Copyright (c) 2024 HARDWARIO a.s.
#
# SPDX-License-Identifier: LicenseRef-HARDWARIO-5-Clause
#

menu "Application"

# HARDWARE-CHESTER-X2-MODBUS-A
config SHIELD_CTR_X2_MODBUS_A
	bool "Enable SHIELD_X2_MODBUS_A"
	default y

config GPIO
	default y

config I2C
	default y

config MODBUS
	default y

config MODBUS_BUFFER_SIZE
	default 64

config PM_DEVICE
	default y

config SERIAL
	default y

config UART_0_INTERRUPT_DRIVEN
	default n

config UART_ASYNC_API
	default y

config UART_INTERRUPT_DRIVEN
	default y

config UART_LINE_CTRL
	default n

config UART_SC16IS7XX
	default y

config I2C
	default y
# HARDWARE-CHESTER-Z
config SHIELD_CTR_Z
	bool "Enable SHIELD_CTR_Z"
	default y

config CTR_Z
	default y

config I2C
	default y
# SUBSYSTEM-LTE-V2
config SHIELD_CTR_LTE_V2
	bool "Enable SHIELD_CTR_LTE_V2"
	default y

config CTR_LTE_V2
	default y

# ### Preserved code "k_config" (begin)
# ^^^ Preserved code "k_config" (end)

rsource "Kconfig.variant"

endmenu

menu "Zephyr Kernel"
source "Kconfig.zephyr"
endmenu
```

## Kconfig.variant
```
#
# Copyright (c) 2024 HARDWARIO a.s.
#
# SPDX-License-Identifier: LicenseRef-HARDWARIO-5-Clause
#

config VARIANT_RADON
    bool "Enable VARIANT_RADON"
    default y
```

## prj.conf
```kconfig
#
# Copyright (c) 2024 HARDWARIO a.s.
#
# SPDX-License-Identifier: LicenseRef-HARDWARIO-5-Clause
#

# Configurations
# SUBSYSTEM-ACCEL
CONFIG_CTR_ACCEL=y
# SUBSYSTEM-BATT
CONFIG_CTR_BATT=y
# SUBSYSTEM-BLE-TAG
CONFIG_CTR_BLE_TAG=y
# SUBSYSTEM-BLUETOOTH
CONFIG_CTR_BLE=y
# SUBSYSTEM-BUF
CONFIG_CTR_BUF=y
# SUBSYSTEM-BUTTON
CONFIG_CTR_BUTTON=y
# SUBSYSTEM-CLOUD
CONFIG_CTR_CLOUD=y
CONFIG_SETTINGS_SHELL=y
CONFIG_IMG_MANAGER=y
CONFIG_BOOTLOADER_MCUBOOT=y
CONFIG_PM_OVERRIDE_EXTERNAL_DRIVER_CHECK=y
CONFIG_SPI=y
CONFIG_DFU_TARGET=y
CONFIG_DFU_TARGET_STREAM=y
CONFIG_DFU_TARGET_MCUBOOT=y
CONFIG_DFU_TARGET_LOG_LEVEL_DBG=y
CONFIG_STREAM_FLASH_ERASE=y
CONFIG_STREAM_FLASH=y
CONFIG_FILE_SYSTEM=y
CONFIG_FILE_SYSTEM_LITTLEFS=y
CONFIG_FILE_SYSTEM_MKFS=y
CONFIG_FILE_SYSTEM_SHELL=y
CONFIG_SETTINGS_FILE=y
CONFIG_SETTINGS_FILE_PATH="/lfs1/settings/run"
CONFIG_PM_PARTITION_REGION_LITTLEFS_EXTERNAL=y
# SUBSYSTEM-DEFAULTS
CONFIG_CTR_DEFAULTS=y
# SUBSYSTEM-INFO
CONFIG_CTR_INFO=y
# SUBSYSTEM-LED
CONFIG_CTR_LED=y
# SUBSYSTEM-LOG
CONFIG_CTR_LOG=y
# SUBSYSTEM-LTE-V2
CONFIG_CTR_LTE_V2=y
# SUBSYSTEM-RTC
CONFIG_CTR_RTC=y
# SUBSYSTEM-SHELL
CONFIG_CTR_SHELL=y
# SUBSYSTEM-THERM
CONFIG_CTR_THERM=y
# SUBSYSTEM-TINYCRYPT
CONFIG_TINYCRYPT=y
# SUBSYSTEM-TINYCRYPT-SHA256
CONFIG_TINYCRYPT_SHA256=y
# SUBSYSTEM-WDOG
CONFIG_CTR_WDOG=y
# SUBSYSTEM-ZCBOR
CONFIG_ZCBOR=y
CONFIG_ZCBOR_STOP_ON_ERROR=y
# Extra configurations
CONFIG_ADC_TLA2021_INIT_PRIORITY=60

# ### Preserved code "config" (begin)
CONFIG_BT_OBSERVER=y
CONFIG_BT_FILTER_ACCEPT_LIST=y
# ^^^ Preserved code "config" (end)
```

## src/main.c
```c
/*
 * Copyright (c) 2024 HARDWARIO a.s.
 *
 * SPDX-License-Identifier: LicenseRef-HARDWARIO-5-Clause
 */

#include "app_init.h"
#include "app_config.h"
#include "feature.h"

/* CHESTER includes */
#include <chester/ctr_led.h>
#include <chester/ctr_wdog.h>

/* Zephyr includes */
#include <zephyr/kernel.h>
#include <zephyr/logging/log.h>

/* Standard includes */
#include <stdbool.h>

LOG_MODULE_REGISTER(main, LOG_LEVEL_DBG);

extern struct ctr_wdog_channel g_app_wdog_channel;

int main(void)
{
	int ret;

	LOG_INF("Build time: " __DATE__ " " __TIME__);

	ret = app_init();
	if (ret) {
		LOG_ERR("Call `app_init` failed: %d", ret);
		k_oops();
	}

	for (;;) {
		LOG_INF("Alive");
#if defined(FEATURE_SUBSYSTEM_WDOG)
		ret = ctr_wdog_feed(&g_app_wdog_channel);
		if (ret) {
			LOG_ERR("Call `ctr_wdog_feed` failed: %d", ret);
			k_oops();
		}
#endif /* defined(FEATURE_SUBSYSTEM_WDOG) */

		if (g_app_config.mode == APP_CONFIG_MODE_NONE) {
			ctr_led_set(CTR_LED_CHANNEL_Y, true);
			k_sleep(K_MSEC(30));
			ctr_led_set(CTR_LED_CHANNEL_Y, false);
		} else {
			ctr_led_set(CTR_LED_CHANNEL_G, true);
			k_sleep(K_MSEC(30));
			ctr_led_set(CTR_LED_CHANNEL_G, false);
		}

		k_sleep(K_SECONDS(5));
	}

	return 0;
}
```

## src/app_backup.c
```c
#include "app_backup.h"
#include "app_data.h"
#include "feature.h"

/* CHESTER includes */
#include <chester/drivers/ctr_z.h>

/* Zephyr includes */
#include <zephyr/device.h>
#include <zephyr/devicetree.h>
#include <zephyr/kernel.h>
#include <zephyr/logging/log.h>

/* Standard includes */
#include <errno.h>
#include <math.h>
#include <stdbool.h>

LOG_MODULE_REGISTER(app_backup, LOG_LEVEL_DBG);

#if defined(FEATURE_HARDWARE_CHESTER_Z)

int app_backup_sample(void)
{
	int ret;

	static const struct device *dev = DEVICE_DT_GET(DT_NODELABEL(ctr_z));

	if (!device_is_ready(dev)) {
		LOG_ERR("Device not ready");
		ret = -ENODEV;
		goto error;
	}

	struct ctr_z_status status;
	ret = ctr_z_get_status(dev, &status);
	if (ret) {
		LOG_ERR("Call `ctr_z_get_status` failed: %d", ret);
		goto error;
	}

	LOG_INF("DC input connected: %d", status.dc_input_connected);

	uint16_t vdc;
	ret = ctr_z_get_vdc_mv(dev, &vdc);
	if (ret) {
		LOG_ERR("Call `ctr_z_get_vdc_mv` failed: %d", ret);
		goto error;
	}

	LOG_INF("Voltage DC input: %u mV", vdc);

	uint16_t vbat;
	ret = ctr_z_get_vbat_mv(dev, &vbat);
	if (ret) {
		LOG_ERR("Call `ctr_z_get_vbat_mv` failed: %d", ret);
		goto error;
	}

	LOG_INF("Voltage backup battery: %u mV", vbat);

	app_data_lock();
	g_app_data.backup.line_present = status.dc_input_connected;
	g_app_data.backup.line_voltage = vdc / 1000.f;
	g_app_data.backup.battery_voltage = vbat / 1000.f;
	app_data_unlock();

	return 0;

error:
	app_data_lock();
	g_app_data.backup.line_present = false;
	g_app_data.backup.line_voltage = NAN;
	g_app_data.backup.battery_voltage = NAN;
	app_data_unlock();

	return ret;
}

int app_backup_clear(void)
{
	app_data_lock();
	g_app_data.backup.event_count = 0;
	app_data_unlock();

	return 0;
}

#endif /* defined(FEATURE_HARDWARE_CHESTER_Z) */
```

## src/app_backup.h
```c
#ifndef APP_BACKUP_H_
#define APP_BACKUP_H_

#ifdef __cplusplus
extern "C" {
#endif

int app_backup_clear(void);
int app_backup_sample(void);

#ifdef __cplusplus
}
#endif

#endif /* APP_BACKUP_H_ */
```

## src/app_cbor.c
```c
/*
 * Copyright (c) 2023 HARDWARIO a.s.
 *
 * SPDX-License-Identifier: LicenseRef-HARDWARIO-5-Clause
 */

#include "app_cbor.h"
#include "app_data.h"
#include "app_config.h"
#include "app_codec.h"
#include "feature.h"

/* CHESTER includes */
#include <chester/ctr_cloud.h>
#include <chester/ctr_buf.h>
#include <chester/ctr_util.h>
#include <chester/ctr_info.h>
#include <chester/ctr_lte_v2.h>
#include <chester/ctr_rtc.h>

/* Zephyr includes */
#include <zephyr/kernel.h>
#include <zephyr/logging/log.h>

#include <zcbor_common.h>
#include <zcbor_encode.h>
#include <zcbor_decode.h>

/* Standard includes */
#include <errno.h>
#include <math.h>
#include <stddef.h>
#include <stdint.h>
#include <stdlib.h>

LOG_MODULE_REGISTER(app_cbor, LOG_LEVEL_DBG);

__unused static void put_sample(zcbor_state_t *zs, struct ctr_data_aggreg *sample)
{
	if (isnan(sample->min)) {
		zcbor_nil_put(zs, NULL);
	} else {
		zcbor_int32_put(zs, sample->min);
	}

	if (isnan(sample->max)) {
		zcbor_nil_put(zs, NULL);
	} else {
		zcbor_int32_put(zs, sample->max);
	}

	if (isnan(sample->avg)) {
		zcbor_nil_put(zs, NULL);
	} else {
		zcbor_int32_put(zs, sample->avg);
	}

	if (isnan(sample->mdn)) {
		zcbor_nil_put(zs, NULL);
	} else {
		zcbor_int32_put(zs, sample->mdn);
	}
}

__unused static void put_sample_mul(zcbor_state_t *zs, struct ctr_data_aggreg *sample, float mul)
{
	if (isnan(sample->min)) {
		zcbor_nil_put(zs, NULL);
	} else {
		zcbor_int32_put(zs, sample->min * mul);
	}

	if (isnan(sample->max)) {
		zcbor_nil_put(zs, NULL);
	} else {
		zcbor_int32_put(zs, sample->max * mul);
	}

	if (isnan(sample->avg)) {
		zcbor_nil_put(zs, NULL);
	} else {
		zcbor_int32_put(zs, sample->avg * mul);
	}

	if (isnan(sample->mdn)) {
		zcbor_nil_put(zs, NULL);
	} else {
		zcbor_int32_put(zs, sample->mdn * mul);
	}
}

int app_cbor_encode(zcbor_state_t *zs)
{
	int ret;

	zs->constant_state->stop_on_error = true;

	zcbor_map_start_encode(zs, ZCBOR_VALUE_IS_INDEFINITE_LENGTH);

	zcbor_uint32_put(zs, CODEC_KEY_E_MESSAGE);
	{
		zcbor_map_start_encode(zs, ZCBOR_VALUE_IS_INDEFINITE_LENGTH);

		zcbor_uint32_put(zs, CODEC_KEY_E_MESSAGE__VERSION);
		zcbor_uint32_put(zs, 1);

		static uint32_t sequence;
		zcbor_uint32_put(zs, CODEC_KEY_E_MESSAGE__SEQUENCE);
		zcbor_uint32_put(zs, sequence++);

		uint64_t timestamp;
		ret = ctr_rtc_get_ts(&timestamp);
		if (ret) {
			LOG_ERR("Call `ctr_rtc_get_ts` failed: %d", ret);
			return ret;
		}

		zcbor_uint32_put(zs, CODEC_KEY_E_MESSAGE__TIMESTAMP);
		zcbor_uint32_put(zs, timestamp);

		zcbor_map_end_encode(zs, ZCBOR_VALUE_IS_INDEFINITE_LENGTH);
	}

	zcbor_uint32_put(zs, CODEC_KEY_E_ATTRIBUTE);
	{
		zcbor_map_start_encode(zs, ZCBOR_VALUE_IS_INDEFINITE_LENGTH);

		char *vendor_name;
		ctr_info_get_vendor_name(&vendor_name);

		zcbor_uint32_put(zs, CODEC_KEY_E_ATTRIBUTE__VENDOR_NAME);
		zcbor_tstr_put_term(zs, vendor_name, CONFIG_ZCBOR_MAX_STR_LEN);

		char *product_name;
		ctr_info_get_product_name(&product_name);

		zcbor_uint32_put(zs, CODEC_KEY_E_ATTRIBUTE__PRODUCT_NAME);
		zcbor_tstr_put_term(zs, product_name, CONFIG_ZCBOR_MAX_STR_LEN);

		char *hw_variant;
		ctr_info_get_hw_variant(&hw_variant);

		zcbor_uint32_put(zs, CODEC_KEY_E_ATTRIBUTE__HW_VARIANT);
		zcbor_tstr_put_term(zs, hw_variant, CONFIG_ZCBOR_MAX_STR_LEN);

		char *hw_revision;
		ctr_info_get_hw_revision(&hw_revision);

		zcbor_uint32_put(zs, CODEC_KEY_E_ATTRIBUTE__HW_REVISION);
		zcbor_tstr_put_term(zs, hw_revision, CONFIG_ZCBOR_MAX_STR_LEN);

		char *fw_version;
		ctr_info_get_fw_version(&fw_version);

		zcbor_uint32_put(zs, CODEC_KEY_E_ATTRIBUTE__FW_VERSION);
		zcbor_tstr_put_term(zs, fw_version, CONFIG_ZCBOR_MAX_STR_LEN);

		char *serial_number;
		ctr_info_get_serial_number(&serial_number);

		zcbor_uint32_put(zs, CODEC_KEY_E_ATTRIBUTE__SERIAL_NUMBER);
		zcbor_tstr_put_term(zs, serial_number, CONFIG_ZCBOR_MAX_STR_LEN);

		zcbor_map_end_encode(zs, ZCBOR_VALUE_IS_INDEFINITE_LENGTH);
	}

	zcbor_uint32_put(zs, CODEC_KEY_E_SYSTEM);
	{
		zcbor_map_start_encode(zs, ZCBOR_VALUE_IS_INDEFINITE_LENGTH);

		zcbor_uint32_put(zs, CODEC_KEY_E_SYSTEM__UPTIME);
		zcbor_uint32_put(zs, k_uptime_get() / 1000);

		zcbor_uint32_put(zs, CODEC_KEY_E_SYSTEM__VOLTAGE_REST);
		if (isnan(g_app_data.batt_voltage_rest)) {
			zcbor_nil_put(zs, NULL);
		} else {
			zcbor_uint32_put(zs, g_app_data.batt_voltage_rest * 1000.f);
		}

		zcbor_uint32_put(zs, CODEC_KEY_E_SYSTEM__VOLTAGE_LOAD);
		if (isnan(g_app_data.batt_voltage_load)) {
			zcbor_nil_put(zs, NULL);
		} else {
			zcbor_uint32_put(zs, g_app_data.batt_voltage_load * 1000.f);
		}

		zcbor_uint32_put(zs, CODEC_KEY_E_SYSTEM__CURRENT_LOAD);
		if (isnan(g_app_data.batt_current_load)) {
			zcbor_nil_put(zs, NULL);
		} else {
			zcbor_uint32_put(zs, g_app_data.batt_current_load);
		}

		zcbor_map_end_encode(zs, ZCBOR_VALUE_IS_INDEFINITE_LENGTH);
	}

	zcbor_uint32_put(zs, CODEC_KEY_E_NETWORK);
	{
		zcbor_map_start_encode(zs, ZCBOR_VALUE_IS_INDEFINITE_LENGTH);

		uint64_t imei;
		ret = ctr_lte_v2_get_imei(&imei);
		if (ret) {
			LOG_ERR("Call `ctr_lte_get_imei` failed: %d", ret);
			return ret;
		}

		zcbor_uint32_put(zs, CODEC_KEY_E_NETWORK__IMEI);
		zcbor_uint64_put(zs, imei);

		uint64_t imsi;
		ret = ctr_lte_v2_get_imsi(&imsi);
		if (ret) {
			LOG_ERR("Call `ctr_lte_get_imsi` failed: %d", ret);
			return ret;
		}

		zcbor_uint32_put(zs, CODEC_KEY_E_NETWORK__IMSI);
		zcbor_uint64_put(zs, imsi);

		zcbor_map_end_encode(zs, ZCBOR_VALUE_IS_INDEFINITE_LENGTH);
	}

	zcbor_uint32_put(zs, CODEC_KEY_E_THERMOMETER);
	{
		zcbor_map_start_encode(zs, ZCBOR_VALUE_IS_INDEFINITE_LENGTH);

		zcbor_uint32_put(zs, CODEC_KEY_E_THERMOMETER__TEMPERATURE);
		if (isnan(g_app_data.therm_temperature)) {
			zcbor_nil_put(zs, NULL);
		} else {
			zcbor_int32_put(zs, g_app_data.therm_temperature * 100.f);
		}

		zcbor_map_end_encode(zs, ZCBOR_VALUE_IS_INDEFINITE_LENGTH);
	}

	zcbor_uint32_put(zs, CODEC_KEY_E_ACCELEROMETER);
	{
		zcbor_map_start_encode(zs, ZCBOR_VALUE_IS_INDEFINITE_LENGTH);

		zcbor_uint32_put(zs, CODEC_KEY_E_ACCELEROMETER__ACCEL_X);
		if (isnan(g_app_data.accel_x)) {
			zcbor_nil_put(zs, NULL);
		} else {
			zcbor_int32_put(zs, g_app_data.accel_x * 1000.f);
		}

		zcbor_uint32_put(zs, CODEC_KEY_E_ACCELEROMETER__ACCEL_Y);
		if (isnan(g_app_data.accel_y)) {
			zcbor_nil_put(zs, NULL);
		} else {
			zcbor_int32_put(zs, g_app_data.accel_y * 1000.f);
		}

		zcbor_uint32_put(zs, CODEC_KEY_E_ACCELEROMETER__ACCEL_Z);
		if (isnan(g_app_data.accel_z)) {
			zcbor_nil_put(zs, NULL);
		} else {
			zcbor_int32_put(zs, g_app_data.accel_z * 1000.f);
		}

		zcbor_uint32_put(zs, CODEC_KEY_E_ACCELEROMETER__ORIENTATION);
		if (g_app_data.accel_orientation == INT_MAX) {
			zcbor_nil_put(zs, NULL);
		} else {
			zcbor_uint32_put(zs, g_app_data.accel_orientation);
		}

		zcbor_map_end_encode(zs, ZCBOR_VALUE_IS_INDEFINITE_LENGTH);
	}

#if defined(FEATURE_SUBSYSTEM_TAMPER)
	zcbor_uint32_put(zs, CODEC_KEY_E_TAMPER);
	{
		zcbor_map_start_encode(zs, ZCBOR_VALUE_IS_INDEFINITE_LENGTH);

		zcbor_uint32_put(zs, CODEC_KEY_E_TAMPER__STATE);
		zcbor_uint32_put(zs, g_app_data.tamper.activated ? 1 : 0);

		if (g_app_data.tamper.event_count) {
			int64_t timestamp_abs = g_app_data.tamper.events[0].timestamp;

			zcbor_uint32_put(zs, CODEC_KEY_E_TAMPER__EVENTS);
			{
				zcbor_list_start_encode(zs, ZCBOR_VALUE_IS_INDEFINITE_LENGTH);

				/* TSO absolute timestamp */
				zcbor_int64_put(zs, timestamp_abs);

				for (int i = 0; i < g_app_data.tamper.event_count; i++) {
					/* TSO offset timestamp */
					zcbor_int64_put(zs, g_app_data.tamper.events[i].timestamp -
								    timestamp_abs);
					zcbor_uint32_put(
						zs, g_app_data.tamper.events[i].activated ? 1 : 0);
				}

				zcbor_list_end_encode(zs, ZCBOR_VALUE_IS_INDEFINITE_LENGTH);
			}
		} else {
			zcbor_uint32_put(zs, CODEC_KEY_E_TAMPER__EVENTS);
			{
				zcbor_list_start_encode(zs, ZCBOR_VALUE_IS_INDEFINITE_LENGTH);
				zcbor_list_end_encode(zs, ZCBOR_VALUE_IS_INDEFINITE_LENGTH);
			}
		}

		zcbor_map_end_encode(zs, ZCBOR_VALUE_IS_INDEFINITE_LENGTH);
	}
#endif /* defined(FEATURE_SUBSYSTEM_TAMPER) */

#if defined(FEATURE_HARDWARE_CHESTER_Z)
	zcbor_uint32_put(zs, CODEC_KEY_E_BACKUP);
	{
		zcbor_map_start_encode(zs, ZCBOR_VALUE_IS_INDEFINITE_LENGTH);

		zcbor_uint32_put(zs, CODEC_KEY_E_BACKUP__LINE_VOLTAGE);
		if (isnan(g_app_data.backup.line_voltage)) {
			zcbor_nil_put(zs, NULL);
		} else {
			zcbor_int32_put(zs, g_app_data.backup.line_voltage * 1000.f);
		}

		zcbor_uint32_put(zs, CODEC_KEY_E_BACKUP__BATT_VOLTAGE);
		if (isnan(g_app_data.backup.battery_voltage)) {
			zcbor_nil_put(zs, NULL);
		} else {
			zcbor_int32_put(zs, g_app_data.backup.battery_voltage * 1000.f);
		}

		zcbor_uint32_put(zs, CODEC_KEY_E_BACKUP__STATE);
		zcbor_uint32_put(zs, g_app_data.backup.line_present ? 1 : 0);

		if (g_app_data.backup.event_count) {
			int64_t timestamp_abs = g_app_data.backup.events[0].timestamp;

			zcbor_uint32_put(zs, CODEC_KEY_E_BACKUP__EVENTS);
			{
				zcbor_list_start_encode(zs, ZCBOR_VALUE_IS_INDEFINITE_LENGTH);

				/* TSO absolute timestamp */
				zcbor_int64_put(zs, timestamp_abs);

				for (int i = 0; i < g_app_data.backup.event_count; i++) {
					/* TSO offset timestamp */
					zcbor_int64_put(zs, g_app_data.backup.events[i].timestamp -
								    timestamp_abs);
					zcbor_uint32_put(
						zs, g_app_data.backup.events[i].connected ? 1 : 0);
				}

				zcbor_list_end_encode(zs, ZCBOR_VALUE_IS_INDEFINITE_LENGTH);
			}
		} else {
			zcbor_uint32_put(zs, CODEC_KEY_E_BACKUP__EVENTS);
			{
				zcbor_list_start_encode(zs, ZCBOR_VALUE_IS_INDEFINITE_LENGTH);
				zcbor_list_end_encode(zs, ZCBOR_VALUE_IS_INDEFINITE_LENGTH);
			}
		}

		zcbor_map_end_encode(zs, ZCBOR_VALUE_IS_INDEFINITE_LENGTH);
	}
#endif /* defined(FEATURE_HARDWARE_CHESTER_Z) */

	zcbor_uint32_put(zs, CODEC_KEY_E_RADON_PROBE);
	{
		zcbor_map_start_encode(zs, ZCBOR_VALUE_IS_INDEFINITE_LENGTH);

		zcbor_uint32_put(zs, CODEC_KEY_E_RADON_PROBE__CHAMBER_HUMIDITY);
		{
			zcbor_map_start_encode(zs, ZCBOR_VALUE_IS_INDEFINITE_LENGTH);

			zcbor_uint32_put(zs,
					 CODEC_KEY_E_RADON_PROBE__CHAMBER_HUMIDITY__MEASUREMENTS);
			{
				zcbor_list_start_encode(zs, ZCBOR_VALUE_IS_INDEFINITE_LENGTH);

				zcbor_uint64_put(zs, g_app_data.radon.timestamp);
				zcbor_uint64_put(zs, g_app_config.interval_aggreg);

				for (int i = 0; i < g_app_data.radon.measurement_count; i++) {
					put_sample(zs, &g_app_data.radon.hum_measurements[i]);
				}

				zcbor_list_end_encode(zs, ZCBOR_VALUE_IS_INDEFINITE_LENGTH);
			}

			zcbor_map_end_encode(zs, ZCBOR_VALUE_IS_INDEFINITE_LENGTH);
		}

		zcbor_uint32_put(zs, CODEC_KEY_E_RADON_PROBE__CHAMBER_TEMPERATURE);
		{
			zcbor_map_start_encode(zs, ZCBOR_VALUE_IS_INDEFINITE_LENGTH);

			zcbor_uint32_put(
				zs, CODEC_KEY_E_RADON_PROBE__CHAMBER_TEMPERATURE__MEASUREMENTS);
			{
				zcbor_list_start_encode(zs, ZCBOR_VALUE_IS_INDEFINITE_LENGTH);

				zcbor_uint64_put(zs, g_app_data.radon.timestamp);
				zcbor_uint64_put(zs, g_app_config.interval_aggreg);

				for (int i = 0; i < g_app_data.radon.measurement_count; i++) {
					put_sample(zs, &g_app_data.radon.temp_measurements[i]);
				}

				zcbor_list_end_encode(zs, ZCBOR_VALUE_IS_INDEFINITE_LENGTH);
			}

			zcbor_map_end_encode(zs, ZCBOR_VALUE_IS_INDEFINITE_LENGTH);
		}

		zcbor_uint32_put(zs, CODEC_KEY_E_RADON_PROBE__CONCENTRATION_HOURLY);
		{
			zcbor_map_start_encode(zs, ZCBOR_VALUE_IS_INDEFINITE_LENGTH);

			zcbor_uint32_put(
				zs, CODEC_KEY_E_RADON_PROBE__CONCENTRATION_HOURLY__MEASUREMENTS);
			{
				zcbor_list_start_encode(zs, ZCBOR_VALUE_IS_INDEFINITE_LENGTH);

				zcbor_uint64_put(zs, g_app_data.radon.timestamp);
				zcbor_uint64_put(zs, g_app_config.interval_aggreg);

				for (int i = 0; i < g_app_data.radon.measurement_count; i++) {
					zcbor_uint32_put(
						zs, g_app_data.radon.concentration_measurements[i]);
				}

				zcbor_list_end_encode(zs, ZCBOR_VALUE_IS_INDEFINITE_LENGTH);
			}

			zcbor_map_end_encode(zs, ZCBOR_VALUE_IS_INDEFINITE_LENGTH);
		}

		zcbor_uint32_put(zs, CODEC_KEY_E_RADON_PROBE__CONCENTRATION_DAILY);
		{
			zcbor_map_start_encode(zs, ZCBOR_VALUE_IS_INDEFINITE_LENGTH);

			zcbor_uint32_put(
				zs, CODEC_KEY_E_RADON_PROBE__CONCENTRATION_DAILY__MEASUREMENTS);
			{
				zcbor_list_start_encode(zs, ZCBOR_VALUE_IS_INDEFINITE_LENGTH);

				zcbor_uint64_put(zs, g_app_data.radon.timestamp);
				zcbor_uint64_put(zs, g_app_config.interval_aggreg);

				for (int i = 0; i < g_app_data.radon.measurement_count; i++) {
					zcbor_uint32_put(
						zs, g_app_data.radon
							    .daily_concentration_measurements[i]);
				}

				zcbor_list_end_encode(zs, ZCBOR_VALUE_IS_INDEFINITE_LENGTH);
			}

			zcbor_map_end_encode(zs, ZCBOR_VALUE_IS_INDEFINITE_LENGTH);
		}

		zcbor_map_end_encode(zs, ZCBOR_VALUE_IS_INDEFINITE_LENGTH);
	}

#if defined(FEATURE_SUBSYSTEM_BLE_TAG)

	zcbor_int32_put(zs, CODEC_KEY_E_BLE_TAGS);
	{
		zcbor_list_start_encode(zs, ZCBOR_VALUE_IS_INDEFINITE_LENGTH);
		for (int i = 0; i < CTR_BLE_TAG_COUNT; i++) {
			struct app_data_ble_tag_sensor *sensor = &g_app_data.ble_tag.sensor[i];

			if (ctr_ble_tag_is_addr_empty(sensor->addr)) {
				continue;
			}

			zcbor_map_start_encode(zs, ZCBOR_VALUE_IS_INDEFINITE_LENGTH);
			{

				zcbor_uint32_put(zs, CODEC_KEY_E_BLE_TAGS__ADDR);
				{
					char addr_str[BT_ADDR_SIZE * 2 + 1] = {0};
					ctr_buf2hex(sensor->addr, BT_ADDR_SIZE, addr_str,
						    BT_ADDR_SIZE * 2 + 1, false);
					zcbor_tstr_put_lit(zs, addr_str);
				}

				zcbor_uint32_put(zs, CODEC_KEY_E_BLE_TAGS__RSSI);
				if (sensor->rssi < 0) {
					zcbor_int32_put(zs, sensor->rssi);
				} else {
					zcbor_nil_put(zs, NULL);
				}

				zcbor_uint32_put(zs, CODEC_KEY_E_BLE_TAGS__VOLTAGE);
				if (!isnan(sensor->voltage)) {
					zcbor_uint32_put(zs, sensor->voltage * 100.f);
				} else {
					zcbor_nil_put(zs, NULL);
				}

				zcbor_uint32_put(zs, CODEC_KEY_E_BLE_TAGS__TEMPERATURE);
				{
					zcbor_map_start_encode(zs,
							       ZCBOR_VALUE_IS_INDEFINITE_LENGTH);
					zcbor_uint32_put(
						zs,
						CODEC_KEY_E_BLE_TAGS__TEMPERATURE__MEASUREMENTS);
					{
						zcbor_list_start_encode(
							zs, ZCBOR_VALUE_IS_INDEFINITE_LENGTH);

						zcbor_uint64_put(zs, g_app_data.ble_tag.timestamp);
						zcbor_uint32_put(zs, g_app_config.interval_aggreg);

						for (int j = 0; j < sensor->measurement_count;
						     j++) {
							put_sample_mul(zs,
								       &sensor->measurements[j]
										.temperature,
								       100.f);
						}
						zcbor_list_end_encode(
							zs, ZCBOR_VALUE_IS_INDEFINITE_LENGTH);
					}
					zcbor_map_end_encode(zs, ZCBOR_VALUE_IS_INDEFINITE_LENGTH);
				}

				zcbor_int32_put(zs, CODEC_KEY_E_BLE_TAGS__HUMIDITY);
				{
					zcbor_map_start_encode(zs,
							       ZCBOR_VALUE_IS_INDEFINITE_LENGTH);
					zcbor_uint32_put(
						zs, CODEC_KEY_E_BLE_TAGS__HUMIDITY__MEASUREMENTS);
					{
						zcbor_list_start_encode(
							zs, ZCBOR_VALUE_IS_INDEFINITE_LENGTH);

						zcbor_uint64_put(zs, g_app_data.ble_tag.timestamp);
						zcbor_uint32_put(zs, g_app_config.interval_aggreg);

						for (int j = 0; j < sensor->measurement_count;
						     j++) {
							put_sample_mul(
								zs,
								&sensor->measurements[j].humidity,
								100.f);
						}
						zcbor_list_end_encode(
							zs, ZCBOR_VALUE_IS_INDEFINITE_LENGTH);
					}
					zcbor_map_end_encode(zs, ZCBOR_VALUE_IS_INDEFINITE_LENGTH);
				}
			}

			zcbor_map_end_encode(zs, ZCBOR_VALUE_IS_INDEFINITE_LENGTH);
		}

		zcbor_list_end_encode(zs, ZCBOR_VALUE_IS_INDEFINITE_LENGTH);
	}

#endif /* defined(FEATURE_SUBSYSTEM_BLE_TAG) */

	zcbor_map_end_encode(zs, ZCBOR_VALUE_IS_INDEFINITE_LENGTH);

	if (!zcbor_check_error(zs)) {
		LOG_ERR("Encoding failed: %d", zcbor_pop_error(zs));
		return -EFAULT;
	}

	return 0;
}
```

## src/app_codec.h
```c
#ifndef CODEC_H_
#define CODEC_H_

/* This file has been generated using the script gen-codec.py */

#ifdef __cplusplus
extern "C" {
#endif

#define CODEC_CLOUD_DECODER_HASH ((uint64_t)0xa0c686b9ef91c03e)
#define CODEC_CLOUD_ENCODER_HASH ((uint64_t)0x0000000000000000)

enum codec_key_e {
	CODEC_KEY_E_MESSAGE = 0,
	CODEC_KEY_E_MESSAGE__VERSION = 1,
	CODEC_KEY_E_MESSAGE__SEQUENCE = 2,
	CODEC_KEY_E_MESSAGE__TIMESTAMP = 3,
	CODEC_KEY_E_ATTRIBUTE = 4,
	CODEC_KEY_E_ATTRIBUTE__VENDOR_NAME = 5,
	CODEC_KEY_E_ATTRIBUTE__PRODUCT_NAME = 6,
	CODEC_KEY_E_ATTRIBUTE__HW_VARIANT = 7,
	CODEC_KEY_E_ATTRIBUTE__HW_REVISION = 8,
	CODEC_KEY_E_ATTRIBUTE__FW_VERSION = 9,
	CODEC_KEY_E_ATTRIBUTE__SERIAL_NUMBER = 10,
	CODEC_KEY_E_SYSTEM = 11,
	CODEC_KEY_E_SYSTEM__UPTIME = 12,
	CODEC_KEY_E_SYSTEM__VOLTAGE_LOAD = 13,
	CODEC_KEY_E_SYSTEM__VOLTAGE_REST = 14,
	CODEC_KEY_E_SYSTEM__CURRENT_LOAD = 15,
	CODEC_KEY_E_NETWORK = 16,
	CODEC_KEY_E_NETWORK__IMEI = 17,
	CODEC_KEY_E_NETWORK__IMSI = 18,
	CODEC_KEY_E_THERMOMETER = 19,
	CODEC_KEY_E_THERMOMETER__TEMPERATURE = 20,
	CODEC_KEY_E_ACCELEROMETER = 21,
	CODEC_KEY_E_ACCELEROMETER__ACCEL_X = 22,
	CODEC_KEY_E_ACCELEROMETER__ACCEL_Y = 23,
	CODEC_KEY_E_ACCELEROMETER__ACCEL_Z = 24,
	CODEC_KEY_E_ACCELEROMETER__ORIENTATION = 25,
	CODEC_KEY_E_TAMPER = 26,
	CODEC_KEY_E_TAMPER__STATE = 27,
	CODEC_KEY_E_TAMPER__EVENTS = 28,
	CODEC_KEY_E_BACKUP = 29,
	CODEC_KEY_E_BACKUP__LINE_VOLTAGE = 30,
	CODEC_KEY_E_BACKUP__BATT_VOLTAGE = 31,
	CODEC_KEY_E_BACKUP__STATE = 32,
	CODEC_KEY_E_BACKUP__EVENTS = 33,
	CODEC_KEY_E_RADON_PROBE = 34,
	CODEC_KEY_E_RADON_PROBE__CONCENTRATION_HOURLY = 35,
	CODEC_KEY_E_RADON_PROBE__CONCENTRATION_HOURLY__MEASUREMENTS = 36,
	CODEC_KEY_E_RADON_PROBE__CONCENTRATION_DAILY = 37,
	CODEC_KEY_E_RADON_PROBE__CONCENTRATION_DAILY__MEASUREMENTS = 38,
	CODEC_KEY_E_RADON_PROBE__CHAMBER_TEMPERATURE = 39,
	CODEC_KEY_E_RADON_PROBE__CHAMBER_TEMPERATURE__MEASUREMENTS = 40,
	CODEC_KEY_E_RADON_PROBE__CHAMBER_HUMIDITY = 41,
	CODEC_KEY_E_RADON_PROBE__CHAMBER_HUMIDITY__MEASUREMENTS = 42,
	CODEC_KEY_E_BLE_TAGS = 43,
	CODEC_KEY_E_BLE_TAGS__ADDR = 44,
	CODEC_KEY_E_BLE_TAGS__RSSI = 45,
	CODEC_KEY_E_BLE_TAGS__VOLTAGE = 46,
	CODEC_KEY_E_BLE_TAGS__TEMPERATURE = 47,
	CODEC_KEY_E_BLE_TAGS__TEMPERATURE__MEASUREMENTS = 48,
	CODEC_KEY_E_BLE_TAGS__HUMIDITY = 49,
	CODEC_KEY_E_BLE_TAGS__HUMIDITY__MEASUREMENTS = 50,
};

#define CODEC_CLOUD_OPTIONS_STATIC(_name) \
	static const uint8_t _name##_cloud_decoder[] = CLOUD_DECODER_BUFFER; \
	static struct ctr_cloud_options _name = { \
		.decoder_hash = CODEC_CLOUD_DECODER_HASH, \
		.encoder_hash = CODEC_CLOUD_ENCODER_HASH, \
		.decoder_buf = _name##_cloud_decoder, \
		.decoder_len = 1272, \
		.encoder_buf = NULL, \
		.encoder_len = 0, \
}

#define CLOUD_DECODER_BUFFER { \
	0xa4, 0x67, 0x76, 0x65, 0x72, 0x73, 0x69, 0x6f, \
	0x6e, 0x02, 0x64, 0x74, 0x79, 0x70, 0x65, 0x67, \
	0x64, 0x65, 0x63, 0x6f, 0x64, 0x65, 0x72, 0x64, \
	0x6e, 0x61, 0x6d, 0x65, 0x78, 0x21, 0x63, 0x6f, \
	0x6d, 0x2e, 0x68, 0x61, 0x72, 0x64, 0x77, 0x61, \
	0x72, 0x69, 0x6f, 0x2e, 0x63, 0x68, 0x65, 0x73, \
	0x74, 0x65, 0x72, 0x2e, 0x61, 0x70, 0x70, 0x2e, \
	0x63, 0x6f, 0x75, 0x6e, 0x74, 0x65, 0x72, 0x66, \
	0x73, 0x63, 0x68, 0x65, 0x6d, 0x61, 0x8a, 0xa1, \
	0x67, 0x6d, 0x65, 0x73, 0x73, 0x61, 0x67, 0x65, \
	0x83, 0xa1, 0x67, 0x76, 0x65, 0x72, 0x73, 0x69, \
	0x6f, 0x6e, 0xf6, 0xa1, 0x68, 0x73, 0x65, 0x71, \
	0x75, 0x65, 0x6e, 0x63, 0x65, 0xf6, 0xa1, 0x69, \
	0x74, 0x69, 0x6d, 0x65, 0x73, 0x74, 0x61, 0x6d, \
	0x70, 0xf6, 0xa1, 0x69, 0x61, 0x74, 0x74, 0x72, \
	0x69, 0x62, 0x75, 0x74, 0x65, 0x86, 0xa1, 0x6b, \
	0x76, 0x65, 0x6e, 0x64, 0x6f, 0x72, 0x5f, 0x6e, \
	0x61, 0x6d, 0x65, 0xf6, 0xa1, 0x6c, 0x70, 0x72, \
	0x6f, 0x64, 0x75, 0x63, 0x74, 0x5f, 0x6e, 0x61, \
	0x6d, 0x65, 0xf6, 0xa1, 0x6a, 0x68, 0x77, 0x5f, \
	0x76, 0x61, 0x72, 0x69, 0x61, 0x6e, 0x74, 0xf6, \
	0xa1, 0x6b, 0x68, 0x77, 0x5f, 0x72, 0x65, 0x76, \
	0x69, 0x73, 0x69, 0x6f, 0x6e, 0xf6, 0xa1, 0x6a, \
	0x66, 0x77, 0x5f, 0x76, 0x65, 0x72, 0x73, 0x69, \
	0x6f, 0x6e, 0xf6, 0xa1, 0x6d, 0x73, 0x65, 0x72, \
	0x69, 0x61, 0x6c, 0x5f, 0x6e, 0x75, 0x6d, 0x62, \
	0x65, 0x72, 0xf6, 0xa1, 0x66, 0x73, 0x79, 0x73, \
	0x74, 0x65, 0x6d, 0x84, 0xa1, 0x66, 0x75, 0x70, \
	0x74, 0x69, 0x6d, 0x65, 0xf6, 0xa1, 0x6c, 0x76, \
	0x6f, 0x6c, 0x74, 0x61, 0x67, 0x65, 0x5f, 0x6c, \
	0x6f, 0x61, 0x64, 0x82, 0xa1, 0x64, 0x24, 0x64, \
	0x69, 0x76, 0x19, 0x03, 0xe8, 0xa1, 0x64, 0x24, \
	0x66, 0x70, 0x70, 0x02, 0xa1, 0x6c, 0x76, 0x6f, \
	0x6c, 0x74, 0x61, 0x67, 0x65, 0x5f, 0x72, 0x65, \
	0x73, 0x74, 0x82, 0xa1, 0x64, 0x24, 0x64, 0x69, \
	0x76, 0x19, 0x03, 0xe8, 0xa1, 0x64, 0x24, 0x66, \
	0x70, 0x70, 0x02, 0xa1, 0x6c, 0x63, 0x75, 0x72, \
	0x72, 0x65, 0x6e, 0x74, 0x5f, 0x6c, 0x6f, 0x61, \
	0x64, 0xf6, 0xa1, 0x67, 0x6e, 0x65, 0x74, 0x77, \
	0x6f, 0x72, 0x6b, 0x82, 0xa1, 0x64, 0x69, 0x6d, \
	0x65, 0x69, 0xf6, 0xa1, 0x64, 0x69, 0x6d, 0x73, \
	0x69, 0xf6, 0xa1, 0x6b, 0x74, 0x68, 0x65, 0x72, \
	0x6d, 0x6f, 0x6d, 0x65, 0x74, 0x65, 0x72, 0x81, \
	0xa1, 0x6b, 0x74, 0x65, 0x6d, 0x70, 0x65, 0x72, \
	0x61, 0x74, 0x75, 0x72, 0x65, 0x82, 0xa1, 0x64, \
	0x24, 0x64, 0x69, 0x76, 0x18, 0x64, 0xa1, 0x64, \
	0x24, 0x66, 0x70, 0x70, 0x02, 0xa1, 0x6d, 0x61, \
	0x63, 0x63, 0x65, 0x6c, 0x65, 0x72, 0x6f, 0x6d, \
	0x65, 0x74, 0x65, 0x72, 0x84, 0xa1, 0x67, 0x61, \
	0x63, 0x63, 0x65, 0x6c, 0x5f, 0x78, 0x82, 0xa1, \
	0x64, 0x24, 0x64, 0x69, 0x76, 0x19, 0x03, 0xe8, \
	0xa1, 0x64, 0x24, 0x66, 0x70, 0x70, 0x02, 0xa1, \
	0x67, 0x61, 0x63, 0x63, 0x65, 0x6c, 0x5f, 0x79, \
	0x82, 0xa1, 0x64, 0x24, 0x64, 0x69, 0x76, 0x19, \
	0x03, 0xe8, 0xa1, 0x64, 0x24, 0x66, 0x70, 0x70, \
	0x02, 0xa1, 0x67, 0x61, 0x63, 0x63, 0x65, 0x6c, \
	0x5f, 0x7a, 0x82, 0xa1, 0x64, 0x24, 0x64, 0x69, \
	0x76, 0x19, 0x03, 0xe8, 0xa1, 0x64, 0x24, 0x66, \
	0x70, 0x70, 0x02, 0xa1, 0x6b, 0x6f, 0x72, 0x69, \
	0x65, 0x6e, 0x74, 0x61, 0x74, 0x69, 0x6f, 0x6e, \
	0xf6, 0xa1, 0x66, 0x74, 0x61, 0x6d, 0x70, 0x65, \
	0x72, 0x82, 0xa1, 0x65, 0x73, 0x74, 0x61, 0x74, \
	0x65, 0x81, 0xa1, 0x65, 0x24, 0x65, 0x6e, 0x75, \
	0x6d, 0x82, 0x68, 0x69, 0x6e, 0x61, 0x63, 0x74, \
	0x69, 0x76, 0x65, 0x66, 0x61, 0x63, 0x74, 0x69, \
	0x76, 0x65, 0xa1, 0x66, 0x65, 0x76, 0x65, 0x6e, \
	0x74, 0x73, 0x82, 0xa1, 0x64, 0x24, 0x6b, 0x65, \
	0x79, 0x66, 0x65, 0x76, 0x65, 0x6e, 0x74, 0x73, \
	0xa1, 0x64, 0x24, 0x74, 0x73, 0x6f, 0x81, 0xa1, \
	0x64, 0x74, 0x79, 0x70, 0x65, 0x81, 0xa1, 0x65, \
	0x24, 0x65, 0x6e, 0x75, 0x6d, 0x82, 0x6b, 0x64, \
	0x65, 0x61, 0x63, 0x74, 0x69, 0x76, 0x61, 0x74, \
	0x65, 0x64, 0x69, 0x61, 0x63, 0x74, 0x69, 0x76, \
	0x61, 0x74, 0x65, 0x64, 0xa1, 0x66, 0x62, 0x61, \
	0x63, 0x6b, 0x75, 0x70, 0x84, 0xa1, 0x6c, 0x6c, \
	0x69, 0x6e, 0x65, 0x5f, 0x76, 0x6f, 0x6c, 0x74, \
	0x61, 0x67, 0x65, 0xf6, 0xa1, 0x6c, 0x62, 0x61, \
	0x74, 0x74, 0x5f, 0x76, 0x6f, 0x6c, 0x74, 0x61, \
	0x67, 0x65, 0xf6, 0xa1, 0x65, 0x73, 0x74, 0x61, \
	0x74, 0x65, 0x81, 0xa1, 0x65, 0x24, 0x65, 0x6e, \
	0x75, 0x6d, 0x82, 0x6c, 0x64, 0x69, 0x73, 0x63, \
	0x6f, 0x6e, 0x6e, 0x65, 0x63, 0x74, 0x65, 0x64, \
	0x69, 0x63, 0x6f, 0x6e, 0x6e, 0x65, 0x63, 0x74, \
	0x65, 0x64, 0xa1, 0x66, 0x65, 0x76, 0x65, 0x6e, \
	0x74, 0x73, 0x82, 0xa1, 0x64, 0x24, 0x6b, 0x65, \
	0x79, 0x66, 0x65, 0x76, 0x65, 0x6e, 0x74, 0x73, \
	0xa1, 0x64, 0x24, 0x74, 0x73, 0x6f, 0x81, 0xa1, \
	0x64, 0x74, 0x79, 0x70, 0x65, 0x81, 0xa1, 0x65, \
	0x24, 0x65, 0x6e, 0x75, 0x6d, 0x82, 0x6c, 0x64, \
	0x69, 0x73, 0x63, 0x6f, 0x6e, 0x6e, 0x65, 0x63, \
	0x74, 0x65, 0x64, 0x69, 0x63, 0x6f, 0x6e, 0x6e, \
	0x65, 0x63, 0x74, 0x65, 0x64, 0xa1, 0x6b, 0x72, \
	0x61, 0x64, 0x6f, 0x6e, 0x5f, 0x70, 0x72, 0x6f, \
	0x62, 0x65, 0x84, 0xa1, 0x74, 0x63, 0x6f, 0x6e, \
	0x63, 0x65, 0x6e, 0x74, 0x72, 0x61, 0x74, 0x69, \
	0x6f, 0x6e, 0x5f, 0x68, 0x6f, 0x75, 0x72, 0x6c, \
	0x79, 0x81, 0xa1, 0x6c, 0x6d, 0x65, 0x61, 0x73, \
	0x75, 0x72, 0x65, 0x6d, 0x65, 0x6e, 0x74, 0x73, \
	0x81, 0xa1, 0x64, 0x24, 0x74, 0x73, 0x70, 0x81, \
	0xa1, 0x65, 0x76, 0x61, 0x6c, 0x75, 0x65, 0xf6, \
	0xa1, 0x73, 0x63, 0x6f, 0x6e, 0x63, 0x65, 0x6e, \
	0x74, 0x72, 0x61, 0x74, 0x69, 0x6f, 0x6e, 0x5f, \
	0x64, 0x61, 0x69, 0x6c, 0x79, 0x81, 0xa1, 0x6c, \
	0x6d, 0x65, 0x61, 0x73, 0x75, 0x72, 0x65, 0x6d, \
	0x65, 0x6e, 0x74, 0x73, 0x81, 0xa1, 0x64, 0x24, \
	0x74, 0x73, 0x70, 0x81, 0xa1, 0x65, 0x76, 0x61, \
	0x6c, 0x75, 0x65, 0xf6, 0xa1, 0x73, 0x63, 0x68, \
	0x61, 0x6d, 0x62, 0x65, 0x72, 0x5f, 0x74, 0x65, \
	0x6d, 0x70, 0x65, 0x72, 0x61, 0x74, 0x75, 0x72, \
	0x65, 0x81, 0xa1, 0x6c, 0x6d, 0x65, 0x61, 0x73, \
	0x75, 0x72, 0x65, 0x6d, 0x65, 0x6e, 0x74, 0x73, \
	0x81, 0xa1, 0x64, 0x24, 0x74, 0x73, 0x70, 0x84, \
	0xa1, 0x63, 0x6d, 0x69, 0x6e, 0xf6, 0xa1, 0x63, \
	0x6d, 0x61, 0x78, 0xf6, 0xa1, 0x63, 0x61, 0x76, \
	0x67, 0xf6, 0xa1, 0x63, 0x6d, 0x64, 0x6e, 0xf6, \
	0xa1, 0x70, 0x63, 0x68, 0x61, 0x6d, 0x62, 0x65, \
	0x72, 0x5f, 0x68, 0x75, 0x6d, 0x69, 0x64, 0x69, \
	0x74, 0x79, 0x81, 0xa1, 0x6c, 0x6d, 0x65, 0x61, \
	0x73, 0x75, 0x72, 0x65, 0x6d, 0x65, 0x6e, 0x74, \
	0x73, 0x81, 0xa1, 0x64, 0x24, 0x74, 0x73, 0x70, \
	0x84, 0xa1, 0x63, 0x6d, 0x69, 0x6e, 0xf6, 0xa1, \
	0x63, 0x6d, 0x61, 0x78, 0xf6, 0xa1, 0x63, 0x61, \
	0x76, 0x67, 0xf6, 0xa1, 0x63, 0x6d, 0x64, 0x6e, \
	0xf6, 0xa1, 0x68, 0x62, 0x6c, 0x65, 0x5f, 0x74, \
	0x61, 0x67, 0x73, 0x85, 0xa1, 0x64, 0x61, 0x64, \
	0x64, 0x72, 0xf6, 0xa1, 0x64, 0x72, 0x73, 0x73, \
	0x69, 0xf6, 0xa1, 0x67, 0x76, 0x6f, 0x6c, 0x74, \
	0x61, 0x67, 0x65, 0x82, 0xa1, 0x64, 0x24, 0x64, \
	0x69, 0x76, 0x18, 0x64, 0xa1, 0x64, 0x24, 0x66, \
	0x70, 0x70, 0x02, 0xa1, 0x6b, 0x74, 0x65, 0x6d, \
	0x70, 0x65, 0x72, 0x61, 0x74, 0x75, 0x72, 0x65, \
	0x81, 0xa1, 0x6c, 0x6d, 0x65, 0x61, 0x73, 0x75, \
	0x72, 0x65, 0x6d, 0x65, 0x6e, 0x74, 0x73, 0x81, \
	0xa1, 0x64, 0x24, 0x74, 0x73, 0x70, 0x84, 0xa1, \
	0x63, 0x6d, 0x69, 0x6e, 0x82, 0xa1, 0x64, 0x24, \
	0x64, 0x69, 0x76, 0x18, 0x64, 0xa1, 0x64, 0x24, \
	0x66, 0x70, 0x70, 0x02, 0xa1, 0x63, 0x6d, 0x61, \
	0x78, 0x82, 0xa1, 0x64, 0x24, 0x64, 0x69, 0x76, \
	0x18, 0x64, 0xa1, 0x64, 0x24, 0x66, 0x70, 0x70, \
	0x02, 0xa1, 0x63, 0x61, 0x76, 0x67, 0x82, 0xa1, \
	0x64, 0x24, 0x64, 0x69, 0x76, 0x18, 0x64, 0xa1, \
	0x64, 0x24, 0x66, 0x70, 0x70, 0x02, 0xa1, 0x63, \
	0x6d, 0x64, 0x6e, 0x82, 0xa1, 0x64, 0x24, 0x64, \
	0x69, 0x76, 0x18, 0x64, 0xa1, 0x64, 0x24, 0x66, \
	0x70, 0x70, 0x02, 0xa1, 0x68, 0x68, 0x75, 0x6d, \
	0x69, 0x64, 0x69, 0x74, 0x79, 0x81, 0xa1, 0x6c, \
	0x6d, 0x65, 0x61, 0x73, 0x75, 0x72, 0x65, 0x6d, \
	0x65, 0x6e, 0x74, 0x73, 0x81, 0xa1, 0x64, 0x24, \
	0x74, 0x73, 0x70, 0x84, 0xa1, 0x63, 0x6d, 0x69, \
	0x6e, 0x82, 0xa1, 0x64, 0x24, 0x64, 0x69, 0x76, \
	0x18, 0x64, 0xa1, 0x64, 0x24, 0x66, 0x70, 0x70, \
	0x02, 0xa1, 0x63, 0x6d, 0x61, 0x78, 0x82, 0xa1, \
	0x64, 0x24, 0x64, 0x69, 0x76, 0x18, 0x64, 0xa1, \
	0x64, 0x24, 0x66, 0x70, 0x70, 0x02, 0xa1, 0x63, \
	0x61, 0x76, 0x67, 0x82, 0xa1, 0x64, 0x24, 0x64, \
	0x69, 0x76, 0x18, 0x64, 0xa1, 0x64, 0x24, 0x66, \
	0x70, 0x70, 0x02, 0xa1, 0x63, 0x6d, 0x64, 0x6e, \
	0x82, 0xa1, 0x64, 0x24, 0x64, 0x69, 0x76, 0x18, \
	0x64, 0xa1, 0x64, 0x24, 0x66, 0x70, 0x70, 0x02, \
}

#ifdef __cplusplus
}
#endif

#endif /* CODEC_H_ */
```

## src/app_config.c
```c
/*
 * Copyright (c) 2024 HARDWARIO a.s.
 *
 * SPDX-License-Identifier: LicenseRef-HARDWARIO-5-Clause
 */

#include "app_config.h"

/* CHESTER includes */
#include <chester/ctr_config.h>

/* Zephyr includes */
#include <zephyr/init.h>
#include <zephyr/kernel.h>
#include <zephyr/logging/log.h>
#include <zephyr/settings/settings.h>
#include <zephyr/shell/shell.h>

/* Standard includes */
#include <stdbool.h>
#include <stdio.h>
#include <stdlib.h>
#include <string.h>

/* ### Preserved code "includes" (begin) */
/* ^^^ Preserved code "includes" (end) */

LOG_MODULE_REGISTER(app_config, LOG_LEVEL_DBG);

#define SETTINGS_PFX "app-radon"

struct app_config g_app_config;

static struct app_config m_config_interim;

/* clang-format off */
const struct ctr_config_item items[] = {
	CTR_CONFIG_ITEM_INT("interval-sample", m_config_interim.interval_sample, 1, 86400, "Get/Set sample interval in seconds.", 60),
	CTR_CONFIG_ITEM_INT("interval-aggreg", m_config_interim.interval_aggreg, 1, 86400, "Get/Set sample interval in seconds.", 60),
	CTR_CONFIG_ITEM_INT("interval-report", m_config_interim.interval_report, 30, 86400, "Get/Set report interval in seconds.", 1800),
	CTR_CONFIG_ITEM_INT("interval-poll", m_config_interim.interval_poll, 0, 86400, "Get/Set poll interval in seconds (disabled if 0).", 0),
	CTR_CONFIG_ITEM_INT("modbus-baud", m_config_interim.modbus_baud, 1200, 19200, "Get/Set modbus baudrate.", 19200),
	CTR_CONFIG_ITEM_INT("modbus-addr", m_config_interim.modbus_addr, 1, 247, "Get/Set modbus slave address.", 1),

#if defined(FEATURE_HARDWARE_CHESTER_Z)
	CTR_CONFIG_ITEM_INT("event-report-delay", m_config_interim.event_report_delay, 1, 86400, "Get/Set event report delay in seconds.", 1),
	CTR_CONFIG_ITEM_INT("event-report-rate", m_config_interim.event_report_rate, 1, 3600, "Get/Set event report rate in reports per hour.", 30),
	CTR_CONFIG_ITEM_BOOL("backup-report-connected", m_config_interim.backup_report_connected, "Get/Set report when backup is active.", true),
	CTR_CONFIG_ITEM_BOOL("backup-report-disconnected", m_config_interim.backup_report_disconnected, "Get/Set report when backup is inactive.", true),
#endif /* defined(FEATURE_HARDWARE_CHESTER_Z) */

	CTR_CONFIG_ITEM_ENUM("mode", m_config_interim.mode, ((const char*[]){"none", "lte"}), "Set communication mode", APP_CONFIG_MODE_LTE),

	/* ### Preserved code "config" (begin) */
	CTR_CONFIG_ITEM_ENUM("modbus-parity", m_config_interim.modbus_parity, ((const char *[]){ "none", "odd", "even" }), "Set modbus parity", UART_CFG_PARITY_EVEN),
	CTR_CONFIG_ITEM_ENUM("modbus-stop-bits", m_config_interim.modbus_stop_bits, ((const char *[]){ "", "1", "", "2" }), "Set modbus stop bits", UART_CFG_STOP_BITS_1),
	/* ^^^ Preserved code "config" (end) */

};
/* clang-format on */

/* ### Preserved code "function" (begin) */
/* ^^^ Preserved code "function" (end) */

int app_config_cmd_config_show(const struct shell *shell, size_t argc, char **argv)
{
	for (int i = 0; i < ARRAY_SIZE(items); i++) {
		ctr_config_show_item(shell, &items[i]);
	}

	return 0;
}

int app_config_cmd_config(const struct shell *shell, size_t argc, char **argv)
{
	return ctr_config_cmd_config(items, ARRAY_SIZE(items), shell, argc, argv);
}

static int h_set(const char *key, size_t len, settings_read_cb read_cb, void *cb_arg)
{
	return ctr_config_h_set(items, ARRAY_SIZE(items), key, len, read_cb, cb_arg);
}

static int h_commit(void)
{
	LOG_DBG("Loaded settings in full");
	memcpy(&g_app_config, &m_config_interim, sizeof(g_app_config));
	return 0;
}

static int h_export(int (*export_func)(const char *name, const void *val, size_t val_len))
{
	return ctr_config_h_export(items, ARRAY_SIZE(items), export_func);
}

static int init(void)
{
	int ret;

	LOG_INF("System initialization");

	for (int i = 0; i < ARRAY_SIZE(items); i++) {
		ctr_config_init_item(&items[i]);
	}

	static struct settings_handler sh = {
		.name = SETTINGS_PFX,
		.h_set = h_set,
		.h_commit = h_commit,
		.h_export = h_export,
	};

	ret = settings_register(&sh);
	if (ret) {
		LOG_ERR("Call `settings_register` failed: %d", ret);
		return ret;
	}

	ret = settings_load_subtree(SETTINGS_PFX);
	if (ret) {
		LOG_ERR("Call `settings_load_subtree` failed: %d", ret);
		return ret;
	}

	/* ### Preserved code "init" (begin) */
	/* ^^^ Preserved code "init" (end) */

	ctr_config_append_show(SETTINGS_PFX, app_config_cmd_config_show);

	return 0;
}

SYS_INIT(init, APPLICATION, CONFIG_APPLICATION_INIT_PRIORITY);
```

## src/app_config.h
```c
/*
 * Copyright (c) 2024 HARDWARIO a.s.
 *
 * SPDX-License-Identifier: LicenseRef-HARDWARIO-5-Clause
 */

#ifndef APP_CONFIG_H_
#define APP_CONFIG_H_

/* Zephyr includes */
#include <zephyr/shell/shell.h>

/* Standard includes */
#include <stdbool.h>
#include <stddef.h>

/* ### Preserved code "includes" (begin) */
#include <zephyr/modbus/modbus.h>
/* ^^^ Preserved code "includes" (end) */

#ifdef __cplusplus
extern "C" {
#endif

enum app_config_mode {
	APP_CONFIG_MODE_NONE = 0,
	APP_CONFIG_MODE_LTE = 1,
};

struct app_config {
	int interval_sample;
	int interval_aggreg;
	int interval_report;
	int interval_poll;
	int modbus_baud;
	int modbus_addr;

#if defined(FEATURE_HARDWARE_CHESTER_Z)
	int event_report_delay;
	int event_report_rate;
	bool backup_report_connected;
	bool backup_report_disconnected;
#endif /* defined(FEATURE_HARDWARE_CHESTER_Z) */

	enum app_config_mode mode;

	/* ### Preserved code "struct variables" (begin) */
	enum uart_config_parity modbus_parity;
	enum uart_config_stop_bits modbus_stop_bits;
	/* ^^^ Preserved code "struct variables" (end) */
};

extern struct app_config g_app_config;

int app_config_cmd_config_show(const struct shell *shell, size_t argc, char **argv);
int app_config_cmd_config_mode(const struct shell *shell, size_t argc, char **argv);

int app_config_cmd_config(const struct shell *shell, size_t argc, char **argv);

/* ### Preserved code "functions" (begin) */
/* ^^^ Preserved code "functions" (end) */

#ifdef __cplusplus
}
#endif

#endif /* APP_CONFIG_H_ */
```

## src/app_data.c
```c
/*
 * Copyright (c) 2023 HARDWARIO a.s.
 *
 * SPDX-License-Identifier: LicenseRef-HARDWARIO-5-Clause
 */

#include "app_data.h"
#include "feature.h"

/* Zephyr includes */
#include <zephyr/kernel.h>

/* Standard includes */
#include <limits.h>
#include <math.h>

struct app_data g_app_data = {
	.batt_voltage_rest = NAN,
	.batt_voltage_load = NAN,
	.batt_current_load = NAN,
	.therm_temperature = NAN,
	.accel_x = NAN,
	.accel_y = NAN,
	.accel_z = NAN,
	.accel_orientation = INT_MAX,

#if defined(FEATURE_SUBSYSTEM_BLE_TAG)
	.ble_tag.sensor[0 ... CTR_BLE_TAG_COUNT - 1] =
		{
			.last_sample_temperature = NAN,
			.last_sample_humidity = NAN,
		},
#endif /* defined(FEATURE_SUBSYSTEM_BLE_TAG) */
};

K_MUTEX_DEFINE(g_app_data_lock);
```

## src/app_data.h
```c
/*
 * Copyright (c) 2023 HARDWARIO a.s.
 *
 * SPDX-License-Identifier: LicenseRef-HARDWARIO-5-Clause
 */

#ifndef APP_DATA_H_
#define APP_DATA_H_
#include "feature.h"

/* CHESTER includes */
#include <chester/ctr_lte.h>
#include <chester/ctr_ble_tag.h>

/* Zephyr includes */
#include <zephyr/kernel.h>

/* Standard includes */
#include <stdbool.h>
#include <stdint.h>

#ifdef __cplusplus
extern "C" {
#endif

#define APP_DATA_MAX_BACKUP_EVENTS 32
#define APP_DATA_MAX_TAMPER_EVENTS 32
#define APP_DATA_MAX_MEASUREMENTS  32
#define APP_DATA_MAX_SAMPLES       32

struct app_data_aggreg {
	float min;
	float max;
	float avg;
	float mdn;
};

#if defined(FEATURE_TAMPER)
struct app_data_tamper_event {
	int64_t timestamp;
	bool activated;
};

struct app_data_tamper {
	bool activated;
	int event_count;
	struct app_data_tamper_event events[APP_DATA_MAX_TAMPER_EVENTS];
};
#endif /* defined(FEATURE_TAMPER) */

#if defined(FEATURE_SUBSYSTEM_BLE_TAG)

#define APP_DATA_MAX_BLE_TAG_MEASUREMENTS 16
#define APP_DATA_MAX_BLE_TAG_SAMPLES      16

struct app_data_ble_tag_measurement {
	struct app_data_aggreg temperature;
	struct app_data_aggreg humidity;
};

struct app_data_ble_tag_sensor {
	uint8_t addr[BT_ADDR_SIZE];

	int8_t rssi;
	float voltage;

	float last_sample_temperature;
	float last_sample_humidity;

	int sample_count;
	float samples_temperature[APP_DATA_MAX_BLE_TAG_SAMPLES];
	float samples_humidity[APP_DATA_MAX_BLE_TAG_SAMPLES];

	int measurement_count;
	struct app_data_ble_tag_measurement measurements[APP_DATA_MAX_BLE_TAG_MEASUREMENTS];
};

struct app_data_ble_tag {
	struct app_data_ble_tag_sensor sensor[CTR_BLE_TAG_COUNT];

	int64_t timestamp;
	atomic_t sample;
	atomic_t aggreg;
};

#endif /* defined(FEATURE_SUBSYSTEM_BLE_TAG) */

#if defined(FEATURE_HARDWARE_CHESTER_Z)
struct app_data_backup_event {
	int64_t timestamp;
	bool connected;
};

struct app_data_backup {
	float line_voltage;
	float battery_voltage;
	bool line_present;
	int event_count;
	struct app_data_backup_event events[APP_DATA_MAX_BACKUP_EVENTS];
};
#endif /* defined(FEATURE_HARDWARE_CHESTER_Z) */

struct app_data_radon {
	int sample_count;
	float temp_samples[APP_DATA_MAX_SAMPLES];
	float hum_samples[APP_DATA_MAX_SAMPLES];

	int measurement_count;
	struct app_data_aggreg temp_measurements[APP_DATA_MAX_MEASUREMENTS];
	struct app_data_aggreg hum_measurements[APP_DATA_MAX_MEASUREMENTS];
	uint32_t concentration_measurements[APP_DATA_MAX_MEASUREMENTS];
	uint32_t daily_concentration_measurements[APP_DATA_MAX_MEASUREMENTS];

	int64_t timestamp;
};

struct app_data {
	float batt_voltage_rest;
	float batt_voltage_load;
	float batt_current_load;
	float therm_temperature;
	float accel_x;
	float accel_y;
	float accel_z;
	int accel_orientation;

	struct app_data_radon radon;

#if defined(FEATURE_TAMPER)
	struct app_data_tamper tamper;
#endif /* defined(FEATURE_TAMPER) */

#if defined(FEATURE_HARDWARE_CHESTER_Z)
	struct app_data_backup backup;
#endif /* defined(FEATURE_HARDWARE_CHESTER_Z) */

#if defined(FEATURE_SUBSYSTEM_BLE_TAG)
	struct app_data_ble_tag ble_tag;
#endif /* defined(FEATURE_SUBSYSTEM_BLE_TAG) */
};

extern struct app_data g_app_data;
extern struct k_mutex g_app_data_lock;

static inline void app_data_lock(void)
{
	k_mutex_lock(&g_app_data_lock, K_FOREVER);
}

static inline void app_data_unlock(void)
{
	k_mutex_unlock(&g_app_data_lock);
}

#ifdef __cplusplus
}
#endif

#endif /* APP_DATA_H_ */
```

## src/app_radon.c
```c
#include "app_radon.h"
#include "app_config.h"

#include <zephyr/device.h>
#include <zephyr/logging/log.h>
#include <zephyr/modbus/modbus.h>
#include <zephyr/pm/device.h>

LOG_MODULE_REGISTER(app_radon, LOG_LEVEL_DBG);

enum reg {
	REG_CONCENTRATION_TIME = 1,
	REG_CONCENTRATION_L = 2,
	REG_CONCENTRATION_H = 3,
	REG_TEMPERATURE = 4,
	REG_HUMIDITY = 5,
	REG_CONCENTRATION_DAY_L = 17,
	REG_CONCENTRATION_DAY_H = 18,
	REG_RECORD_TIME = 19,
	REG_RECORD_COUNT = 20,
	REG_SPECTRUM_TIME = 21,
	REG_SPECTRUM_COUNT = 22,
	REG_IMPULSES_TOTAL_L = 23,
	REG_IMPULSES_TOTAL_H = 24,
	REG_LIMIT = 33,
	REG_RECORD_INTERVAL = 36,
	REG_SPECTRUM_INTERVAL = 37,
	REG_ALGORITHM = 38,
	REG_REAL_TIME_L = 39,
	REG_REAL_TIME_H = 40,
	REG_CUSTOMER_TEXT = 41,
	REG_DEVICE = 60,
	REG_VERSION_SW = 65,
	REG_SERIAL_NUMBER = 70,
};

static int m_iface;
static const struct device *m_ctr_x2 = DEVICE_DT_GET(DT_NODELABEL(ctr_x2_sc16is740_a));

static int read_reg(int addr, enum reg reg, uint16_t *out, size_t quantity)
{
	int ret;

	ret = modbus_read_holding_regs(m_iface, addr, reg, out, quantity);
	if (ret) {
		LOG_ERR("Call `modbus_read_input_regs` failed: %d", ret);
		return ret;
	}

	return ret;
}

int app_radon_disable(void)
{
	int ret;

	ret = pm_device_action_run(m_ctr_x2, PM_DEVICE_ACTION_SUSPEND);
	if (ret && ret != -EALREADY) {
		LOG_ERR("Call `pm_device_action_run` failed: %d", ret);
		return ret;
	}

	return 0;
}

int app_radon_enable(void)
{
	int ret;

	ret = pm_device_action_run(m_ctr_x2, PM_DEVICE_ACTION_RESUME);
	if (ret && ret != -EALREADY) {
		LOG_ERR("Call `pm_device_action_run` failed: %d", ret);
		return ret;
	}

	return 0;
}

int app_radon_init(void)
{
	int ret;

	m_iface = modbus_iface_get_by_name(
		DEVICE_DT_NAME(DT_COMPAT_GET_ANY_STATUS_OKAY(zephyr_modbus_serial)));

	const struct modbus_iface_param param = {
		.mode = MODBUS_MODE_RTU,
		.rx_timeout = 500000,
		.serial =
			{
				.baud = g_app_config.modbus_baud,
				.parity = g_app_config.modbus_parity,
				.stop_bits_client = g_app_config.modbus_stop_bits,
			},
	};

	ret = modbus_init_client(m_iface, param);
	if (ret) {
		LOG_ERR("Call `modbus_init_client` failed: %d", ret);
		return ret;
	}

	ret = app_radon_disable();
	if (ret) {
		LOG_ERR("Call `app_radon_disable` failed: %d", ret);
		return ret;
	}

	return 0;
}

int app_radon_read_temperature(int16_t *out)
{
	int ret;

	ret = read_reg(g_app_config.modbus_addr, REG_TEMPERATURE, out, 1);
	if (ret) {
		LOG_ERR("Call `read_reg` failed: %d", ret);
		return ret;
	}

	if (*out > 127) {
		*out -= 256;
	}

	return 0;
}

int app_radon_read_humidity(uint16_t *out)
{
	int ret;

	ret = read_reg(g_app_config.modbus_addr, REG_HUMIDITY, out, 1);
	if (ret) {
		LOG_ERR("Call `read_reg` failed: %d", ret);
		return ret;
	}

	return 0;
}

int app_radon_read_concentration(uint32_t *out, bool daily)
{
	uint16_t data[2];

	int ret = read_reg(g_app_config.modbus_addr,
			   daily ? REG_CONCENTRATION_DAY_L : REG_CONCENTRATION_L, data, 2);
	if (ret) {
		LOG_ERR("Call `read_reg` failed: %d", ret);
		return ret;
	}

	*out = 0;
	*out |= data[0];
	*out |= data[1] << 16;

	return 0;
}
```

## src/app_radon.h
```c
#ifndef APP_RADON_H_
#define APP_RADON_H_

#include <stdint.h>
#include <stdbool.h>

int app_radon_disable(void);
int app_radon_enable(void);
int app_radon_init(void);
int app_radon_read_temperature(int16_t *out);
int app_radon_read_humidity(uint16_t *out);
int app_radon_read_concentration(uint32_t *out, bool daily);

#endif /* !APP_RADON_H_ */
```
