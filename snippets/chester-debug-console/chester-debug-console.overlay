/*
 * This snippet redirects serial console output to UART1 and uses
 * P0.12 (TAMPER_KEY) as TX and P0.26 (BTN_EXT) as RX.
 */

/ {
	chosen {
		zephyr,console = &uart1;
		zephyr,shell-uart = &uart1;
		zephyr,uart-mcumgr = &uart1;
	};
};

&uart1 {
	current-speed = <115200>;
	pinctrl-0 = <&uart_debug_default>;
	pinctrl-1 = <&uart_debug_sleep>;
	status = "okay";
};
