## Kconfig.defaults
```kconfig
#
# Copyright (c) 2023 HARDWARIO a.s.
#
# SPDX-License-Identifier: LicenseRef-HARDWARIO-5-Clause
#

config CTR_DEFAULTS
	bool "CTR_DEFAULTS"

config IDLE_STACK_SIZE
	default 512 if CTR_DEFAULTS

config ISR_STACK_SIZE
	default 4096 if CTR_DEFAULTS

config HEAP_MEM_POOL_SIZE
	default 8192 if CTR_DEFAULTS

config MAIN_STACK_SIZE
	default 2560 if CTR_DEFAULTS

config PRIVILEGED_STACK_SIZE
	default 4096 if CTR_DEFAULTS

config SEGGER_RTT_BUFFER_SIZE_DOWN
	default 256 if CTR_DEFAULTS && CTR_SHELL

config SEGGER_RTT_BUFFER_SIZE_UP
	default 2048 if CTR_DEFAULTS && CTR_SHELL

config SHELL_BYPASS_READ_BUF_SIZE
	default 64 if CTR_DEFAULTS && CTR_SHELL

config SYSTEM_WORKQUEUE_STACK_SIZE
	default 4096 if CTR_DEFAULTS

config IMG_BLOCK_BUF_SIZE
	default 256 if CTR_DEFAULTS
```

## subsys/ctr_ble_tag/Kconfig
```kconfig
#
# Copyright (c) 2023 HARDWARIO a.s.
#
# SPDX-License-Identifier: LicenseRef-HARDWARIO-5-Clause
#

config CTR_BLE_TAG
	bool "CTR_BLE_TAG"
	select BT
	select CRC
	select CTR_CONFIG
	select CTR_INFO
	select CTR_SHELL
	select CTR_UTIL
	# The shell prints sensor values, which needs float support in the cbprintf
	# engine. It was previously inherited from whichever other subsystem the
	# application happened to enable.
	select CBPRINTF_FP_SUPPORT

if CTR_BLE_TAG

module = CTR_BLE_TAG
module-str = CHESTER BLE Tag Subsystem
source "subsys/logging/Kconfig.template.log_config"

config CTR_BLE_TAG_32_SLOTS
	bool "CTR_BLE_TAG_32_SLOTS (deprecated)"
	depends on CTR_BLE_TAG
	default n
	help
	  Deprecated, use CTR_BLE_TAG_SLOTS instead. Kept so that out-of-tree
	  configurations selecting 32 slots keep working.

config CTR_BLE_TAG_SLOTS
	int "Number of BLE tag slots"
	depends on CTR_BLE_TAG
	range 1 32
	default 32 if CTR_BLE_TAG_32_SLOTS
	default 8
	help
	  Each slot costs a per-slot aggregation buffer in every application
	  that samples BLE tags, and grows the CBOR payload, so raise this
	  deliberately and re-check RAM and uplink size.

endif # CTR_BLE_TAG
```

## subsys/ctr_power/Kconfig
```kconfig
#
# Copyright (c) 2026 HARDWARIO a.s.
#
# SPDX-License-Identifier: LicenseRef-HARDWARIO-5-Clause
#

config CTR_POWER
	bool "CTR_POWER"
	default n
	depends on CTR_BATT
	depends on CTR_CONFIG
	depends on CTR_RTC
	depends on SETTINGS
	select CBPRINTF_FP_SUPPORT if CTR_POWER_SHELL || CTR_POWER_LOG_LEVEL_DBG

if CTR_POWER

module = CTR_POWER
module-str = CHESTER Power Subsystem
source "subsys/logging/Kconfig.template.log_config"

config CTR_POWER_MAX_EVENTS
	int "Event buffer depth"
	default 32

config CTR_POWER_INIT_PRIORITY
	int "Initialization priority"
	default APPLICATION_INIT_PRIORITY

config CTR_POWER_SHELL
	bool "CTR_POWER_SHELL"
	depends on SHELL
	default y

config CTR_POWER_CBOR
	bool "CTR_POWER_CBOR"
	depends on ZCBOR
	default y if CTR_CLOUD

config CTR_POWER_LRW
	bool "CTR_POWER_LRW"
	depends on CTR_BUF
	default y if CTR_LRW

endif # CTR_POWER
```

## subsys/ctr_trace/Kconfig
```kconfig
#
# Copyright (c) 2026 HARDWARIO a.s.
#
# SPDX-License-Identifier: LicenseRef-HARDWARIO-5-Clause
#

# Indirection so the comma in the chosen property name is not parsed as a
# Kconfig macro argument separator.
DT_CHOSEN_CTR_TRACE_MEM := ctr,trace_mem

config CTR_TRACE
	bool "CTR_TRACE"
	default y if $(dt_chosen_enabled,$(DT_CHOSEN_CTR_TRACE_MEM))
	depends on $(dt_chosen_enabled,$(DT_CHOSEN_CTR_TRACE_MEM))
	depends on RETAINED_MEM
	depends on HWINFO
	depends on LOG
	# Needs the full logging backend API (log_backend_enable, log_output_*),
	# which minimal logging (e.g. in the MCUboot image) does not provide.
	depends on !LOG_MODE_MINIMAL
	help
	  Post-mortem debug subsystem: keeps a log ring buffer, a pre-fault log
	  snapshot and a boot/reset record ring in retained RAM (the chosen
	  `ctr,trace_mem` device). Inspected over the `trace` shell command.

	  The fatal-error handler persists a fault marker from a context with
	  interrupts locked, so CONFIG_RETAINED_MEM_MUTEX_FORCE_DISABLE=y is
	  required (enforced by a build assertion).

if CTR_TRACE

module = CTR_TRACE
module-str = CHESTER Trace Subsystem
source "subsys/logging/Kconfig.template.log_config"

config CTR_TRACE_RESET_REASON_COUNT
	int "Number of boot/reset records retained"
	default 8
	range 1 256
	help
	  Number of boot/reset records kept in retained RAM. The rest of the
	  retained region is split evenly between the primary log ring buffer
	  and the pre-fault snapshot buffer. A build assertion fails if the
	  region cannot hold this many records plus two usable log buffers.

config CTR_TRACE_INIT_PRIORITY
	int "Initialization priority"
	default APPLICATION_INIT_PRIORITY

config CTR_TRACE_SHELL
	bool "CTR_TRACE_SHELL"
	depends on SHELL
	default y

endif # CTR_TRACE
```

## tests/applications/serial/driver_store/testcase.yaml
```yaml
common:
  tags:
    - chester
  platform_allow: native_sim
  integration_platforms:
    - native_sim

tests:
  applications.serial.driver_store: {}
```

## tests/applications/serial_microsens_180hs/testcase.yaml
```yaml
common:
  tags:
    - chester
    - serial
  platform_allow: native_sim
  integration_platforms:
    - native_sim

tests:
  applications.serial.microsens_180hs.proto: {}
```

## tests/applications/serial_piketronic_rppu/testcase.yaml
```yaml
common:
  tags:
    - chester
    - serial
  platform_allow: native_sim
  integration_platforms:
    - native_sim

tests:
  applications.serial.piketronic_rppu.proto: {}
```

## tests/subsys/ctr_cloud_spool/testcase.yaml
```yaml
tests:
  subsys.ctr_cloud_spool:
    tags: chester
    platform_allow:
      - native_sim
    integration_platforms:
      - native_sim
```

## tests/subsys/ctr_trace/testcase.yaml
```yaml
common:
  tags:
    - chester
  platform_allow: native_sim
  integration_platforms:
    - native_sim

tests:
  subsys.ctr_trace.layout:
    extra_args: CONFIG_TEST_FEATURE_LAYOUT=y

  subsys.ctr_trace.ring:
    extra_args: CONFIG_TEST_FEATURE_RING=y

  subsys.ctr_trace.reason:
    extra_args: CONFIG_TEST_FEATURE_REASON=y

  subsys.ctr_trace.shell:
    extra_args: CONFIG_TEST_FEATURE_SHELL=y
```

## west.yml
```yaml
manifest:
  version: "0.12"
  remotes:
    - name: nordic
      url-base: https://github.com/nrfconnect
  projects:
    - name: nrf
      remote: nordic
      repo-path: sdk-nrf
      revision: v3.4-branch
      import: true
  self:
    path: chester
    west-commands: scripts/west-commands.yml
```
