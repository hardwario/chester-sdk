## drivers/adc/Kconfig.adc_tla2024
```kconfig
#
# Copyright (c) 2023 HARDWARIO a.s.
#
# SPDX-License-Identifier: LicenseRef-HARDWARIO-5-Clause
#

config ADC_TLA2024
	bool "TI TLA2024 Low-Power ADC"
	depends on I2C

config ADC_TLA2024_INIT_PRIORITY
	int "Priority for the driver initialization"
	default 60
	help
	  Fine tune the priority for the driver initialization. Make sure it's
	  higher (-> lower priority) than I2C_INIT_PRIORITY.
```

## drivers/ctr_a1/Kconfig
```kconfig
#
# Copyright (c) 2023 HARDWARIO a.s.
#
# SPDX-License-Identifier: LicenseRef-HARDWARIO-5-Clause
#

config CTR_A1
	bool "HARDWARIO CHESTER-A1 (AC/DC Converter w/ Relay Outputs) Driver"
	select GPIO
	select I2C

if CTR_A1

module = CTR_A1
module-str = ctr_a1
source "subsys/logging/Kconfig.template.log_config"

config CTR_A1_INIT_PRIORITY
	int "Init priority"
	default 99
	help
	  Device driver initialization priority.

endif # CTR_A1
```

## drivers/ctr_b1/Kconfig
```kconfig
#
# Copyright (c) 2023 HARDWARIO a.s.
#
# SPDX-License-Identifier: LicenseRef-HARDWARIO-5-Clause
#

config CTR_B1
	bool "HARDWARIO CHESTER-B1 Driver"
	select GPIO

if CTR_B1

module = CTR_B1
module-str = ctr_b1
source "subsys/logging/Kconfig.template.log_config"

config CTR_B1_INIT_PRIORITY
	int "Init priority"
	default 99
	help
	  Device driver initialization priority.

endif # CTR_B1
```

## drivers/ctr_batt/Kconfig
```kconfig
#
# Copyright (c) 2023 HARDWARIO a.s.
#
# SPDX-License-Identifier: LicenseRef-HARDWARIO-5-Clause
#

config CTR_BATT
	bool "CHESTER Battery Measurement Circuit Driver"
	select GPIO
	select I2C
	select ADC
	select ADC_TLA2021

if CTR_BATT

config CTR_BATT_SHELL
	depends on SHELL
	bool "CTR_BATT_SHELL"
	default y

module = CTR_BATT
module-str = CHESTER Battery Measurement Subsystem
source "subsys/logging/Kconfig.template.log_config"

endif # CTR_BATT
```

## drivers/ctr_k/Kconfig
```kconfig
config CTR_K
	bool "HARDWARIO CHESTER-K (Differential Inputs) Driver"
	select CBPRINTF_FP_SUPPORT if CTR_SIGNAL_LOG_LEVEL_DBG
	select GPIO
	select GPIO_PCA953X
	select I2C
	select NRFX_PPI
	select NRFX_SAADC
	select NRFX_TIMER
	select NRFX_TIMER4
	select REQUIRES_FULL_LIBC

if CTR_K

module = CTR_K
module-str = ctr_k
source "subsys/logging/Kconfig.template.log_config"

config CTR_K_INIT_PRIORITY
	int "Init priority"
	default 99
	help
	  Device driver initialization priority.

endif # CTR_K
```

## drivers/ctr_k1/Kconfig
```kconfig
#
# Copyright (c) 2023 HARDWARIO a.s.
#
# SPDX-License-Identifier: LicenseRef-HARDWARIO-5-Clause
#

config CTR_K1
	bool "HARDWARIO CHESTER-K1 (Differential Inputs) Driver"
	depends on !ADC_NRFX_SAADC && !ADC_SHELL
	select CBPRINTF_FP_SUPPORT if CTR_SIGNAL_LOG_LEVEL_DBG
	select GPIO
	select GPIO_PCA953X
	select I2C
	select NRFX_PPI
	select NRFX_SAADC
	select NRFX_TIMER
	select NRFX_TIMER4
	select REQUIRES_FULL_LIBC

if CTR_K1

module = CTR_K1
module-str = ctr_k1
source "subsys/logging/Kconfig.template.log_config"

config CTR_K1_INIT_PRIORITY
	int "Init priority"
	default 99
	help
	  Device driver initialization priority.

endif # CTR_K1
```

## drivers/ctr_lrw_if/Kconfig
```kconfig
#
# Copyright (c) 2023 HARDWARIO a.s.
#
# SPDX-License-Identifier: LicenseRef-HARDWARIO-5-Clause
#

config CTR_LRW_IF
	bool "CHESTER LRW Interface Driver"
	default y
	depends on DT_HAS_HARDWARIO_CTR_LRW_IF_ENABLED
	select POLL
	select SERIAL
	select UART_ASYNC_API

if CTR_LRW_IF

module = CTR_LRW_IF
module-str = CHESTER LRW Interface Driver
source "subsys/logging/Kconfig.template.log_config"

endif # CTR_LRW_IF
```

## drivers/ctr_lrw_link/Kconfig
```kconfig
#
# Copyright (c) 2024 HARDWARIO a.s.
#
# SPDX-License-Identifier: LicenseRef-HARDWARIO-5-Clause
#

config CTR_LRW_LINK
	bool "CHESTER LRW Interface Driver"
	select PIPES
	select POLL
	select SERIAL
	select UART_ASYNC_API

if CTR_LRW_LINK

module = CTR_LRW_LINK
module-str = CHESTER LRW Interface Driver
source "subsys/logging/Kconfig.template.log_config"

endif # CTR_LRW_LINK
```

## drivers/ctr_lte_if/Kconfig
```kconfig
#
# Copyright (c) 2023 HARDWARIO a.s.
#
# SPDX-License-Identifier: LicenseRef-HARDWARIO-5-Clause
#

config CTR_LTE_IF
	bool "CHESTER LTE Interface Driver"
	default y
	depends on DT_HAS_HARDWARIO_CTR_LTE_IF_ENABLED
	select NRFX_TIMER1
	select POLL
	select SERIAL
	select UART_0_NRF_HW_ASYNC
	select UART_ASYNC_API

if CTR_LTE_IF

module = CTR_LTE_IF
module-str = CHESTER LTE Interface Driver
source "subsys/logging/Kconfig.template.log_config"

endif # CTR_LTE_IF

config UART_0_NRF_HW_ASYNC_TIMER
	default 1 if CTR_LTE_IF
```

## drivers/ctr_lte_if_v2/Kconfig
```kconfig
#
# Copyright (c) 2023 HARDWARIO a.s.
#
# SPDX-License-Identifier: LicenseRef-HARDWARIO-5-Clause
#

config CTR_LTE_IF_V2
	bool "CHESTER LTE Interface Driver"
	select NRFX_TIMER1
	select PIPES
	select POLL
	select SERIAL
	select UART_0_NRF_HW_ASYNC
	select UART_ASYNC_API

if CTR_LTE_IF_V2

module = CTR_LTE_IF_V2
module-str = CHESTER LTE Interface Driver
source "subsys/logging/Kconfig.template.log_config"

endif # CTR_LTE_IF_V2

config UART_0_NRF_HW_ASYNC_TIMER
	default 1 if CTR_LTE_IF_V2
```

## drivers/ctr_meteo/Kconfig
```kconfig
#
# Copyright (c) 2023 HARDWARIO a.s.
#
# SPDX-License-Identifier: LicenseRef-HARDWARIO-5-Clause
#

config CTR_METEO
	bool "HARDWARIO CHESTER Meteo Driver"
	select CTR_ADC
	select CTR_EDGE
	select GPIO
	select I2C
	select REQUIRES_FULL_LIBC

if CTR_METEO

module = CTR_METEO
module-str = ctr_meteo
source "subsys/logging/Kconfig.template.log_config"

config CTR_METEO_INIT_PRIORITY
	int "Init priority"
	default 99
	help
	  Device driver initialization priority.

config CTR_METEO_SHELL
	bool "CTR_METEO_SHELL"
	depends on SHELL
	default y

endif # CTR_METEO
```

## drivers/ctr_pm3006s/Kconfig
```kconfig
#
# Copyright (c) 2023 HARDWARIO a.s.
#
# SPDX-License-Identifier: LicenseRef-HARDWARIO-5-Clause
#

config CTR_PM3006S
	bool "Cubic PM3006S Outdoor Laser Particle Sensor Module"
	depends on I2C

if CTR_PM3006S

module = CTR_PM3006S
module-str = ctr_pm3006s
source "subsys/logging/Kconfig.template.log_config"

endif # CTR_PM3006S
```

## drivers/ctr_rfmux/Kconfig
```kconfig
#
# Copyright (c) 2023 HARDWARIO a.s.
#
# SPDX-License-Identifier: LicenseRef-HARDWARIO-5-Clause
#

config CTR_RFMUX
	bool "CHESTER RF Multiplexer Driver"
	depends on GPIO

if CTR_RFMUX

module = CTR_RFMUX
module-str = CHESTER RF Multiplexer Driver
source "subsys/logging/Kconfig.template.log_config"

endif # CTR_RFMUX
```

## drivers/ctr_s1/Kconfig
```kconfig
#
# Copyright (c) 2023 HARDWARIO a.s.
#
# SPDX-License-Identifier: LicenseRef-HARDWARIO-5-Clause
#

config CTR_S1
	bool "HARDWARIO CHESTER-S1 Cover Module"
	depends on GPIO
	depends on I2C
	select POLL
	select REQUIRES_FULL_LIBC

if CTR_S1

config CTR_S1_SHELL
	depends on SHELL
	bool "CTR_S1_SHELL"
	default y

module = CTR_S1
module-str = ctr_s1
source "subsys/logging/Kconfig.template.log_config"

endif # CTR_S1
```

## drivers/ctr_s3/Kconfig
```kconfig
#
# Copyright (c) 2023 HARDWARIO a.s.
#
# SPDX-License-Identifier: LicenseRef-HARDWARIO-5-Clause
#

config CTR_S3
	bool "HARDWARIO CHESTER-S3 (Dual PIR Detector) Driver"
	select GPIO
	select NRFX_PWM0
	select NRFX_PWM1

if CTR_S3

module = CTR_S3
module-str = ctr_s3
source "subsys/logging/Kconfig.template.log_config"

config CTR_S3_INIT_PRIORITY
	int "Init priority"
	default 99
	help
	  Device driver initialization priority.

endif # CTR_S3
```

## drivers/ctr_x0/Kconfig
```kconfig
#
# Copyright (c) 2023 HARDWARIO a.s.
#
# SPDX-License-Identifier: LicenseRef-HARDWARIO-5-Clause
#

config CTR_X0
	bool "HARDWARIO CHESTER-X0 (Configurable Inputs) Driver"
	select GPIO
	select GPIO_PCAL6416A
	select I2C

if CTR_X0

module = CTR_X0
module-str = ctr_x0
source "subsys/logging/Kconfig.template.log_config"

config CTR_X0_INIT_PRIORITY
	int "Init priority"
	default 90
	help
	  Device driver initialization priority.

endif # CTR_X0
```

## drivers/ctr_x10/Kconfig
```kconfig
#
# Copyright (c) 2023 HARDWARIO a.s.
#
# SPDX-License-Identifier: LicenseRef-HARDWARIO-5-Clause
#

config CTR_X10
	bool "HARDWARIO CHESTER-X10 Driver"
	select I2C
	select ADC
	select ADC_TLA2024

if CTR_X10

module = CTR_X10
module-str = ctr_x10
source "subsys/logging/Kconfig.template.log_config"

config CTR_X10_INIT_PRIORITY
	int "Init priority"
	default 99
	help
	  Device driver initialization priority.

endif # CTR_X4
```

## drivers/ctr_x3/Kconfig
```kconfig
#
# Copyright (c) 2023 HARDWARIO a.s.
#
# SPDX-License-Identifier: LicenseRef-HARDWARIO-5-Clause
#

config CTR_X3
	bool "HARDWARIO CHESTER-X3 (Precision Analog) Driver"
	select ADC
	select ADC_ADS122C04
	select GPIO
	select I2C

if CTR_X3

module = CTR_X3
module-str = ctr_x3
source "subsys/logging/Kconfig.template.log_config"

endif # CTR_X3
```

## drivers/ctr_x4/Kconfig
```kconfig
#
# Copyright (c) 2023 HARDWARIO a.s.
#
# SPDX-License-Identifier: LicenseRef-HARDWARIO-5-Clause
#

config CTR_X4
	bool "HARDWARIO CHESTER-X4 (DC/DC Converter w/ Power Rail Outputs) Driver"
	select GPIO
	select I2C
	select ADC
	select ADC_TLA2021

if CTR_X4

module = CTR_X4
module-str = ctr_x4
source "subsys/logging/Kconfig.template.log_config"

config CTR_X4_INIT_PRIORITY
	int "Init priority"
	default 99
	help
	  Device driver initialization priority.

endif # CTR_X4
```

## drivers/ctr_x7/Kconfig
```kconfig
#
# Copyright (c) 2023 HARDWARIO a.s.
#
# SPDX-License-Identifier: LicenseRef-HARDWARIO-5-Clause
#

config CTR_X7
	bool "HARDWARIO CHESTER-X7 (Differential Input) Driver"
	depends on !ADC_NRFX_SAADC && !ADC_SHELL
	select CBPRINTF_FP_SUPPORT if CTR_SIGNAL_LOG_LEVEL_DBG
	select GPIO
	select NRFX_PPI
	select NRFX_SAADC
	select NRFX_TIMER
	select NRFX_TIMER4
	select REQUIRES_FULL_LIBC

if CTR_X7

module = CTR_X7
module-str = ctr_x7
source "subsys/logging/Kconfig.template.log_config"

config CTR_X7_INIT_PRIORITY
	int "Init priority"
	default 99
	help
	  Device driver initialization priority.

endif # CTR_X7
```

## drivers/ctr_x9/Kconfig
```kconfig
#
# Copyright (c) 2023 HARDWARIO a.s.
#
# SPDX-License-Identifier: LicenseRef-HARDWARIO-5-Clause
#

config CTR_X9
	bool "HARDWARIO CHESTER-X9 (Low Side Outputs) Driver"
	select GPIO
	select I2C

if CTR_X9

module = CTR_X9
module-str = ctr_x9
source "subsys/logging/Kconfig.template.log_config"

config CTR_X9_INIT_PRIORITY
	int "Init priority"
	default 99
	help
	  Device driver initialization priority.

endif # CTR_X9
```

## drivers/ctr_z/Kconfig
```kconfig
#
# Copyright (c) 2023 HARDWARIO a.s.
#
# SPDX-License-Identifier: LicenseRef-HARDWARIO-5-Clause
#

config CTR_Z
	bool "HARDWARIO CHESTER-Z Cover Module"
	depends on GPIO
	depends on I2C

if CTR_Z

module = CTR_Z
module-str = ctr_z
source "subsys/logging/Kconfig.template.log_config"

endif # CTR_Z
```

## drivers/gnss/Kconfig
```kconfig
#
# Copyright (c) 2023 HARDWARIO a.s.
#
# SPDX-License-Identifier: LicenseRef-HARDWARIO-5-Clause
#

config GNSS
	bool "GNSS support"

rsource "Kconfig.gnss_m8"
```

## drivers/gnss/Kconfig.gnss_m8
```kconfig
#
# Copyright (c) 2023 HARDWARIO a.s.
#
# SPDX-License-Identifier: LicenseRef-HARDWARIO-5-Clause
#

config GNSS_M8
	bool "u-blox M8 GNSS Receiver Driver"
	depends on GNSS
	depends on GPIO
	depends on I2C

if GNSS_M8

config GNSS_M8_INIT_PRIORITY
	int "GNSS M8 init priority"
	default I2C_INIT_PRIORITY
	help
	  GNSS M8 device driver initialization priority.
	  Set higher than I2C bus and any GPIO expander init priority
	  if the GNSS enable pin is on a GPIO expander (e.g., 80).

module = GNSS_M8
module-str = gnss_m8
source "subsys/logging/Kconfig.template.log_config"

endif # GNSS_M8
```

## drivers/gpio/Kconfig
```kconfig
#
# Copyright (c) 2023 HARDWARIO a.s.
#
# SPDX-License-Identifier: LicenseRef-HARDWARIO-5-Clause
#

rsource "Kconfig.pcal6416a"
```
