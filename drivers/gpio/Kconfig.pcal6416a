## drivers/gpio/Kconfig.pcal6416a
```kconfig
# Workaround for not being able to have commas in macro arguments
DT_COMPAT_NXP_PCAL6416A := nxp,pcal6416a

menuconfig GPIO_PCAL6416A
	bool "PCAL6416A I2C GPIO chip"
	default $(dt_compat_enabled,$(DT_COMPAT_NXP_PCAL6416A))
	depends on I2C
	help
	  Enable driver for PCAL6416A I2C GPIO chip.

config GPIO_PCAL6416A_INIT_PRIORITY
	int "Init priority"
	default 70
	depends on GPIO_PCAL6416A
	help
	  Device driver initialization priority.
```

## drivers/mb7066/Kconfig
```kconfig
#
# Copyright (c) 2023 HARDWARIO a.s.
#
# SPDX-License-Identifier: LicenseRef-HARDWARIO-5-Clause
#

menuconfig MB7066
	bool "Maxbotix MB7066 ultrasonic distance sensor"
	default n
	select GPIO
	select NRFX_GPIOTE
	select NRFX_PPI
	help
		Enable the drivers for MB7066 sensor

menuconfig MB7066_SAMPLE_COUNT
	int "Amount of samples per one measurement"
	default 9

menuconfig MB7066_TIMER0
	bool "Timer instance 0"
	default n
	select NRFX_TIMER0

menuconfig MB7066_TIMER1
	bool "Timer instance 1"
	default n
	select NRFX_TIMER1

menuconfig MB7066_TIMER2
	bool "Timer instance 2"
	default n
	select NRFX_TIMER2

menuconfig MB7066_TIMER3
	bool "Timer instance 3"
	default n
	select NRFX_TIMER3

menuconfig MB7066_TIMER4
	bool "Timer instance 4"
	default n
	select NRFX_TIMER4

menuconfig MB7066_TIMER
	int "Timer instance used by the mb7066 driver."
	default 0 if MB7066_TIMER0
	default 1 if MB7066_TIMER1
	default 2 if MB7066_TIMER2
	default 3 if MB7066_TIMER3
	default 4 if MB7066_TIMER4
	default 0

if !(MB7066_TIMER0 || MB7066_TIMER1 || MB7066_TIMER2 || MB7066_TIMER3 || MB7066_TIMER4)
	config NRFX_TIMER0
		default y
endif

if MB7066

module = MB7066
module-str = mb7066
source "subsys/logging/Kconfig.template.log_config"

config MB7066_INIT_PRIORITY
	int "Init priority"
	default 99
	help
	  Device driver initialization priority.

endif # MB7066
```

## drivers/people_counter/Kconfig
```kconfig
#
# Copyright (c) 2023 HARDWARIO a.s.
#
# SPDX-License-Identifier: LicenseRef-HARDWARIO-5-Clause
#

config PEOPLE_COUNTER
	bool "Adastra People Counter Module"
	depends on I2C

if PEOPLE_COUNTER

module = PEOPLE_COUNTER
module-str = people_counter
source "subsys/logging/Kconfig.template.log_config"

endif # PEOPLE_COUNTER
```

## drivers/sensor/Kconfig
```kconfig
#
# Copyright (c) 2023 HARDWARIO a.s.
#
# SPDX-License-Identifier: LicenseRef-HARDWARIO-5-Clause
#

menuconfig SENSOR
	bool "Sensor Drivers"
	help
		Include sensor drivers in config

if SENSOR

rsource "mpl3115a2/Kconfig"
rsource "sps30/Kconfig"
rsource "tmp112/Kconfig"

endif # SENSOR
```

## drivers/sensor/adxl355/Kconfig
```kconfig
# ADXL355, 3-Axis, +/-16g Digital Accelerometer

menuconfig ADXL355
	bool "ADXL355 Three Axis I2C accelerometer"
	depends on I2C
	depends on SENSOR
	help
	  Enable driver for ADXL355 Three-Axis Digital Accelerometer.

if ADXL355

config ADXL355_TRIGGER
	bool "enable trigger"
	depends on GPIO

if ADXL355_TRIGGER

choice
	prompt "Trigger mode"
	default ADXL355_TRIGGER_NONE
		help 
			spedify the type of triggering used by the driver.
	
	config ADXL355_TRIGGER_NONE
		bool "No trigger"
	
	config ADXL355_TRIGGER_GLOBAL_THREAD
		bool  "Use global thread"
	
	
endchoice 

config ADXL355_FIFO
	bool "enable fifo"

if ADXL355_FIFO

	config ADXL355_FIFO_SAMPLES
		int "fifo samples <1-96>"
		default 96
		help
		number of samples stored in the fifo  that triggers a FIFO_FULL

endif # ADXL355_FIFO	

config ADXL355_INT1_DRDY
	bool "enable data ready interupt on the int1"
default n

config ADXL355_INT1_FIFO_FULL
	bool "enable fifo full interupt on the int1"

config ADXL355_INT1_FIFO_OVR
	bool "enable fifo overrun on interupt the int1"


config ADXL355_INT2_DRDY
	bool "enable data ready interupt on the int2"
default n

config ADXL355_INT2_FIFO_FULL
	bool "enable fifo full interupt on the int2"

config ADXL355_INT2_FIFO_OVR
	bool "enable fifo overrun on interupt the int2"

endif # ADXL355_TRIGGER	


module = ADXL355
module-str = adi_adxl355
source "subsys/logging/Kconfig.template.log_config"

endif # ADXL355
```

## drivers/sensor/ds18b20/Kconfig
```kconfig
# DS18B20 temperature and humidity sensor configuration options

# Copyright (c) 2021 Thomas Stranger
# SPDX-License-Identifier: Apache-2.0

config DS18B20
	bool "DS18B20 Temperature Sensor"
	depends on W1
	help
	  Enable driver for DS18B20 1-Wire temperature sensors.
```

## drivers/sensor/mpl3115a2/Kconfig
```kconfig
# NXP MPL3115A2 Barometric Pressure/Altitude/Temperature Sensor

#
# Copyright (c) 2023 HARDWARIO a.s.
#
# SPDX-License-Identifier: LicenseRef-HARDWARIO-5-Clause
#

menuconfig MPL3115A2
	bool "MPL3115A2 Pressure Sensor"
	depends on I2C
	help
	  Enable the driver for NXP MPL3115A2 Barometric Pressure/Altitude/Temperature Sensor
	  
config MPL3115A2_SHELL
	bool "MPL3115A2 Shell Commands"
	default y if MPL3115A2
	depends on MPL3115A2

if MPL3115A2

endif # MPL3115A2
```

## drivers/sensor/sps30/Kconfig
```kconfig
# Sensirion SPS30 Particulate Matter Sensor

#
# Copyright (c) 2024 HARDWARIO a.s.
#
# SPDX-License-Identifier: LicenseRef-HARDWARIO-5-Clause
#

menuconfig SPS30
	bool "SPS30 Particulate Matter Sensor"
	depends on I2C
	help
	  Enable the driver for Sensirion SPS30 Particulate Matter Sensor

if SPS30

endif # SPS30
```

## drivers/sensor/tmp112/Kconfig
```kconfig
# TMP112 temperature sensor configuration options (HARDWARIO variant)

#
# Copyright (c) 2016 Firmwave
# Copyright (c) 2026 HARDWARIO a.s.
#
# SPDX-License-Identifier: Apache-2.0
#

menuconfig HIO_TMP112
	bool "TMP112 Temperature Sensor (HARDWARIO variant)"
	default y
	depends on DT_HAS_HARDWARIO_TMP112_ENABLED
	select I2C
	help
	  Enable the HARDWARIO driver for Texas Instruments TMP112 High-Accuracy
	  Digital Temperature Sensors.

	  This variant adds shutdown / one-shot operation: when the
	  conversion-rate device-tree property is set to 0, the sensor stays in
	  shutdown and a one-shot conversion is triggered on each sample_fetch.

	  The TMP102 is compatible with the TMP112 but is less accurate and has
	  been successfully tested with this driver.

if HIO_TMP112

config HIO_TMP112_FULL_SCALE_RUNTIME
	bool "Allow to set extended mode at runtime"
	default y
	help
	  When set extended mode can be selected using sensor_attr_set
	  with SENSOR_ATTR_FULL_SCALE and value to set either 128 or 150.

config HIO_TMP112_SAMPLING_FREQUENCY_RUNTIME
	bool "Allow to set conversion rate at runtime"
	default y
	help
	  When set conversion rate can be set at runtime using sensor_attr_set
	  with SENSOR_ATTR_SAMPLING_FREQUENCY. Setting the rate to 0 Hz at
	  runtime puts the sensor into shutdown / one-shot mode.

endif # HIO_TMP112
```

## drivers/serial/Kconfig
```kconfig
#
# Copyright (c) 2023 HARDWARIO a.s.
#
# SPDX-License-Identifier: LicenseRef-HARDWARIO-5-Clause
#

rsource "Kconfig.uart_sc16is7xx"
```

## drivers/serial/Kconfig.uart_sc16is7xx
```kconfig
#
# Copyright (c) 2023 HARDWARIO a.s.
#
# SPDX-License-Identifier: LicenseRef-HARDWARIO-5-Clause
#

config UART_SC16IS7XX
	bool "NXP SC16IS7XX UART driver"
	depends on GPIO && I2C && SERIAL
	select REQUIRES_FULL_LIBC
	select SERIAL_HAS_DRIVER
	select SERIAL_SUPPORT_INTERRUPT

if UART_SC16IS7XX

module = UART_SC16IS7XX
module-str = uart_sc16is7xx
source "subsys/logging/Kconfig.template.log_config"

config UART_SC16IS7XX_INIT_PRIORITY
	int "Init priority"
	default 80
	help
	  Device driver initialization priority.

endif # UART_SC16IS7XX
```

## drivers/w1/Kconfig
```kconfig
#
# Copyright (c) 2023 HARDWARIO a.s.
#
# SPDX-License-Identifier: LicenseRef-HARDWARIO-5-Clause
#

if W1

rsource "Kconfig.ds28e17"

endif # W1
```

## drivers/w1/Kconfig.ds28e17
```kconfig
#
# Copyright (c) 2023 HARDWARIO a.s.
#
# SPDX-License-Identifier: LicenseRef-HARDWARIO-5-Clause
#

config DS28E17
	bool "DS28E17 1-Wire-to-I2C Master Bridge"
	default y if $(dt_compat_enabled,$(maxim,ds28e17))
	depends on W1_NET
```

## drivers/w1/Kconfig.w1_ds2484
```kconfig
config W1_DS2484
	bool "DS2484 Single-Channel 1-Wire Master Driver"
	depends on I2C
```

## dts/bindings/adastra/adastra,people-counter.yaml
```yaml
#
# Copyright (c) 2023 HARDWARIO a.s.
#
# SPDX-License-Identifier: LicenseRef-HARDWARIO-5-Clause
#

description: Adastra People Counter Module

compatible: "adastra,people-counter"

include: i2c-device.yaml
```

## dts/bindings/adc/ti,ads122c04.yaml
```yaml
#
# Copyright (c) 2023 HARDWARIO a.s.
#
# SPDX-License-Identifier: LicenseRef-HARDWARIO-5-Clause
#

description: Texas Instruments ADS122C04 24-Bit 4-Channel 2-kSPS Delta-Sigma ADC

compatible: "ti,ads122c04"

include: [i2c-device.yaml, adc-controller.yaml]

properties:
  "#io-channel-cells":
    const: 1

  gain:
    type: int
    description: Gain configuration
    default: 0
    enum:
      - 0 # Gain 1
      - 1 # Gain 2
      - 2 # Gain 4
      - 3 # Gain 8
      - 4 # Gain 16
      - 5 # Gain 32
      - 6 # Gain 64
      - 7 # Gain 128

  mux:
    type: int
    description: Input multiplexer configuration
    default: 0
    enum:
      - 0 # AINP = AIN0, AINN = AIN1
      - 1 # AINP = AIN0, AINN = AIN2
      - 2 # AINP = AIN0, AINN = AIN3
      - 3 # AINP = AIN1, AINN = AIN0
      - 4 # AINP = AIN1, AINN = AIN2
      - 5 # AINP = AIN1, AINN = AIN3
      - 6 # AINP = AIN2, AINN = AIN3
      - 7 # AINP = AIN3, AINN = AIN2
      - 8 # AINP = AIN0, AINN = AVSS
      - 9 # AINP = AIN1, AINN = AVSS
      - 10 # AINP = AIN2, AINN = AVSS
      - 11 # AINP = AIN3, AINN = AVSS
      - 12 # (VREFP – VREFN) / 4 monitor (PGA bypassed)
      - 13 # (AVDD – AVSS) / 4 monitor (PGA bypassed)
      - 14 # AINP and AINN shorted to (AVDD + AVSS) / 2

  vref:
    type: int
    description: Reference selection
    default: 0
    enum:
      - 0 # Internal 2048 mV reference
      - 1 # External reference (REFP + REFN)
      - 2 # Analog supply (AVDD - AVSS)
      - 3 # Analog supply (AVDD - AVSS)

  idac:
    type: int
    description: IDAC current setting
    default: 0
    enum:
      - 0 # Off
      - 1 # 10 uA
      - 2 # 50 uA
      - 3 # 100 uA
      - 4 # 250 uA
      - 5 # 500 uA
      - 6 # 1000 uA
      - 7 # 1500 uA

  i1mux:
    type: int
    description: IDAC1 routing configuration
    default: 0
    enum:
      - 0 # IDAC1 disabled
      - 1 # IDAC1 connected to AIN0
      - 2 # IDAC1 connected to AIN1
      - 3 # IDAC1 connected to AIN2
      - 4 # IDAC1 connected to AIN3
      - 5 # IDAC1 connected to REFP
      - 6 # IDAC1 connected to REFN

  i2mux:
    type: int
    description: IDAC2 routing configuration
    default: 0
    enum:
      - 0 # IDAC2 disabled
      - 1 # IDAC2 connected to AIN0
      - 2 # IDAC2 connected to AIN1
      - 3 # IDAC2 connected to AIN2
      - 4 # IDAC2 connected to AIN3
      - 5 # IDAC2 connected to REFP
      - 6 # IDAC2 connected to REFN

io-channel-cells:
  - input
```

## dts/bindings/adc/ti,tla2021.yaml
```yaml
description: Texas Instruments TLA2021 Low-Power ADC

compatible: "ti,tla2021"

include: [i2c-device.yaml, adc-controller.yaml]

properties:
  "#io-channel-cells":
    const: 1

  data-rate:
    type: int
    description: Data rate in samples per second (SPS)
    default: 4
    enum:
      - 0 # 128 SPS
      - 1 # 250 SPS
      - 2 # 490 SPS
      - 3 # 920 SPS
      - 4 # 1600 SPS (default)
      - 5 # 2400 SPS
      - 6 # 3300 SPS
      - 7 # 3300 SPS

io-channel-cells:
  - input
```

## dts/bindings/adc/ti,tla2024.yaml
```yaml
#
# Copyright (c) 2023 HARDWARIO a.s.
#
# SPDX-License-Identifier: LicenseRef-HARDWARIO-5-Clause
#

description: Texas Instruments TLA2024 Low-Power ADC

compatible: "ti,tla2024"

include: [i2c-device.yaml, adc-controller.yaml]

properties:
  "#io-channel-cells":
    const: 4

  data-rate:
    type: int
    description: Data rate in samples per second (SPS)
    default: 4
    enum:
      - 0 # 128 SPS
      - 1 # 250 SPS
      - 2 # 490 SPS
      - 3 # 920 SPS
      - 4 # 1600 SPS (default)
      - 5 # 2400 SPS
      - 6 # 3300 SPS
      - 7 # 3300 SPS

io-channel-cells:
  - input
```

## dts/bindings/chester/hardwario,ctr-a1.yaml
```yaml
#
# Copyright (c) 2023 HARDWARIO a.s.
#
# SPDX-License-Identifier: LicenseRef-HARDWARIO-5-Clause
#

description: HARDWARIO CHESTER-A1 Driver

compatible: "hardwario,ctr-a1"

include: base.yaml

properties:

  relay1-gpios:
    type: phandle-array
    required: true
    description: Relay output 1

  relay2-gpios:
    type: phandle-array
    required: true
    description: Relay output 2

  led1-gpios:
    type: phandle-array
    required: true
    description: LED output 1

  led2-gpios:
    type: phandle-array
    required: true
    description: LED output 2
```

## dts/bindings/chester/hardwario,ctr-b1.yaml
```yaml
#
# Copyright (c) 2023 HARDWARIO a.s.
#
# SPDX-License-Identifier: LicenseRef-HARDWARIO-5-Clause
#

description: HARDWARIO CHESTER-B1 Driver

compatible: "hardwario,ctr-b1"

include: base.yaml

properties:

  wm-reset-gpios:
    type: phandle-array
    required: true
    description: wM-Bus module reset signal

  wm-on-gpios:
    type: phandle-array
    required: true
    description: wM-Bus module power-switch signal

  ant-1-gpios:
    type: phandle-array
    required: true
    description: Antenna 1

  ant-2-gpios:
    type: phandle-array
    required: true
    description: Antenna 2
```

## dts/bindings/chester/hardwario,ctr-batt.yaml
```yaml
#
# Copyright (c) 2023 HARDWARIO a.s.
#
# SPDX-License-Identifier: LicenseRef-HARDWARIO-5-Clause
#

description: HARDWARIO CHESTER Battery Measurement Circuit Driver

compatible: "hardwario,ctr-batt"

include: base.yaml

properties:
  load-gpios:
    type: phandle-array
    required: true
    description: Enable load circuit - active high

  test-gpios:
    type: phandle-array
    required: true
    description: enable test circuit - active high

  load-resistor:
    type: int
    required: true
    description: Load resistance in Ohm

  divider-r1:
    type: int
    required: true
    description: Voltage divider R1 (Ohm)

  divider-r2:
    type: int
    required: true
    description: Voltage divider R2 (Ohm)
```

## dts/bindings/chester/hardwario,ctr-k1.yaml
```yaml
#
# Copyright (c) 2023 HARDWARIO a.s.
#
# SPDX-License-Identifier: LicenseRef-HARDWARIO-5-Clause
#

description: HARDWARIO CHESTER-K1 Driver

compatible: "hardwario,ctr-k1"

include: base.yaml

properties:

  on1-gpios:
    type: phandle-array
    required: true
    description: Power rail enable pin for CH1 (active high)

  on2-gpios:
    type: phandle-array
    required: true
    description: Power rail enable pin for CH2 (active high)

  on3-gpios:
    type: phandle-array
    required: true
    description: Power rail enable pin for CH3 (active high)

  on4-gpios:
    type: phandle-array
    required: true
    description: Power rail enable pin for CH4 (active high)

  en-gpios:
    type: phandle-array
    required: true
    description: Step-up enable pin (active high)

  nc1-gpios:
    type: phandle-array
    required: true
    description: Unconnected pin 1

  nc2-gpios:
    type: phandle-array
    required: true
    description: Unconnected pin 2

  nc3-gpios:
    type: phandle-array
    required: true
    description: Unconnected pin 3
```

## dts/bindings/chester/hardwario,ctr-lrw-if.yaml
```yaml
#
# Copyright (c) 2023 HARDWARIO a.s.
#
# SPDX-License-Identifier: LicenseRef-HARDWARIO-5-Clause
#

description: HARDWARIO LoRaWAN Interface Driver

compatible: "hardwario,ctr-lrw-if"

include: uart-device.yaml

properties:
  reset-gpios:
    type: phandle-array
    required: true
    description: Modem reset line (active low)
```

## dts/bindings/chester/hardwario,ctr-lrw-link.yaml
```yaml
#
# Copyright (c) 2024 HARDWARIO a.s.
#
# SPDX-License-Identifier: LicenseRef-HARDWARIO-5-Clause
#

description: HARDWARIO LoRaWAN Link Interface Driver

compatible: "hardwario,ctr-lrw-link"

include: uart-device.yaml

properties:
  reset-gpios:
    type: phandle-array
    required: true
    description: Modem reset line (active low)
```
