## dts/bindings/chester/hardwario,ctr-lte-if-v2.yaml
```yaml
#
# Copyright (c) 2023 HARDWARIO a.s.
#
# SPDX-License-Identifier: LicenseRef-HARDWARIO-5-Clause
#

description: HARDWARIO LTE Interface Driver

compatible: "hardwario,ctr-lte-if-v2"

include: uart-device.yaml

properties:
  reset-gpios:
    type: phandle-array
    required: true
    description: Modem reset line (active low)

  wakeup-gpios:
    type: phandle-array
    required: true
    description: Modem wakeup line (active low)
```
