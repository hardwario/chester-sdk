## dts/bindings/chester/hardwario,ctr-meteo.yaml
```yaml
#
# Copyright (c) 2023 HARDWARIO a.s.
#
# SPDX-License-Identifier: LicenseRef-HARDWARIO-5-Clause
#

description: HARDWARIO CHESTER-Meteo

compatible: "hardwario,ctr-meteo"

include: base.yaml

properties:
  slot:
    type: string
    required: true
    description: Slot position (A or B) on CHESTER mainboard
    enum:
      - "A"
      - "B"
```

## dts/bindings/chester/hardwario,ctr-rfmux.yaml
```yaml
#
# Copyright (c) 2023 HARDWARIO a.s.
#
# SPDX-License-Identifier: LicenseRef-HARDWARIO-5-Clause
#

description: HARDWARIO CHESTER RF Multiplexer

compatible: "hardwario,ctr-rfmux"

include: base.yaml

properties:
  rf-lte-gpios:
    type: phandle-array
    required: true
    description: |
      Enable LTE RF switch (active high)

  rf-lrw-gpios:
    type: phandle-array
    required: true
    description: |
      Enable LoRaWAN RF switch (active high)

  rf-int-gpios:
    type: phandle-array
    required: true
    description: |
      Enable internal antenna RF switch (active high)

  rf-ext-gpios:
    type: phandle-array
    required: true
    description: |
      Enable external antenna RF switch (active high)
```

## dts/bindings/chester/hardwario,ctr-s1.yaml
```yaml
#
# Copyright (c) 2023 HARDWARIO a.s.
#
# SPDX-License-Identifier: LicenseRef-HARDWARIO-5-Clause
#

description: HARDWARIO CHESTER-S1 Cover Module

compatible: "hardwario,ctr-s1"

include: i2c-device.yaml

properties:
  irq-gpios:
    type: phandle-array
    required: true
    description: |
      Alert line (active low); Needs external pull-up resistor.

  auto-beep:
    type: boolean
    description: |
      Enables the panel to automatically beep on a button press.
```

## dts/bindings/chester/hardwario,ctr-s3.yaml
```yaml
#
# Copyright (c) 2023 HARDWARIO a.s.
#
# SPDX-License-Identifier: LicenseRef-HARDWARIO-5-Clause
#

description: HARDWARIO CHESTER-S3 Driver

compatible: "hardwario,ctr-s3"

include: base.yaml

properties:

  left-si-gpios:
    type: phandle-array
    required: true
    description: Left PIR detector - SI pin

  left-dl-gpios:
    type: phandle-array
    required: true
    description: Left PIR detector - DL pin

  right-si-gpios:
    type: phandle-array
    required: true
    description: Right PIR detector - SI pin

  right-dl-gpios:
    type: phandle-array
    required: true
    description: Right PIR detector - DL pin
```

## dts/bindings/chester/hardwario,ctr-v1.yaml
```yaml
description: HARDWARIO CHESTER-V1 Driver

compatible: "hardwario,ctr-v1"

include: base.yaml

properties:

  modem-reset-gpios:
    type: phandle-array
    required: true
    description: Astronode S Module reset pin

  modem-wakeup-gpios:
    type: phandle-array
    required: true
    description: Astronode S Module wakeup pin

  modem-event-gpios:
    type: phandle-array
    required: true
    description: Astronode S Module event pin
```

## dts/bindings/chester/hardwario,ctr-x0.yaml
```yaml
#
# Copyright (c) 2023 HARDWARIO a.s.
#
# SPDX-License-Identifier: LicenseRef-HARDWARIO-5-Clause
#

description: HARDWARIO CHESTER-X0 Driver

compatible: "hardwario,ctr-x0"

include: base.yaml

properties:

  ch1-gpios:
    type: phandle-array
    required: true
    description: Microcontroller connection for CH1

  on1-gpios:
    type: phandle-array
    required: true
    description: Enable pin for CH1 switched power rail (active low)

  pu1-gpios:
    type: phandle-array
    required: true
    description: Enable pin for CH1 switched pull-up resistor (active low)

  pd1-gpios:
    type: phandle-array
    required: true
    description: Enable pin for CH1 switched pull-down resistor (active high)

  cl1-gpios:
    type: phandle-array
    required: true
    description: Enable pin for CH1 switched current loop shunt resistor (active high)

  ch2-gpios:
    type: phandle-array
    required: true
    description: Microcontroller connection for CH2

  on2-gpios:
    type: phandle-array
    required: true
    description: Enable pin for CH2 switched power rail (active low)

  pu2-gpios:
    type: phandle-array
    required: true
    description: Enable pin for CH2 switched pull-up resistor (active low)

  pd2-gpios:
    type: phandle-array
    required: true
    description: Enable pin for CH2 switched pull-down resistor (active high)

  cl2-gpios:
    type: phandle-array
    required: true
    description: Enable pin for CH2 switched current loop shunt resistor (active high)

  ch3-gpios:
    type: phandle-array
    required: true
    description: Microcontroller connection for CH3

  on3-gpios:
    type: phandle-array
    required: true
    description: Enable pin for CH3 switched power rail (active low)

  pu3-gpios:
    type: phandle-array
    required: true
    description: Enable pin for CH3 switched pull-up resistor (active low)

  pd3-gpios:
    type: phandle-array
    required: true
    description: Enable pin for CH3 switched pull-down resistor (active high)

  cl3-gpios:
    type: phandle-array
    required: true
    description: Enable pin for CH3 switched current loop shunt resistor (active high)

  ch4-gpios:
    type: phandle-array
    required: true
    description: Microcontroller connection for CH4

  on4-gpios:
    type: phandle-array
    required: true
    description: Enable pin for CH4 switched power rail (active low)

  pu4-gpios:
    type: phandle-array
    required: true
    description: Enable pin for CH4 switched pull-up resistor (active low)

  pd4-gpios:
    type: phandle-array
    required: true
    description: Enable pin for CH4 switched pull-down resistor (active high)

  cl4-gpios:
    type: phandle-array
    required: true
    description: Enable pin for CH4 switched current loop shunt resistor (active high)
```

## dts/bindings/chester/hardwario,ctr-x10.yaml
```yaml
#
# Copyright (c) 2023 HARDWARIO a.s.
#
# SPDX-License-Identifier: LicenseRef-HARDWARIO-5-Clause
#

description: HARDWARIO CHESTER-X10 Driver

compatible: "hardwario,ctr-x10"

include: base.yaml

properties:
  line-measurement-interval:
    type: int
    default: 5000
    description: Time interval (in milliseconds) for line voltage measurement

  line-threshold-min:
    type: int
    default: 7000
    description: Minimum voltage threshold (in millivolts) for line presence detection

  line-threshold-max:
    type: int
    default: 9000
    description: Maximum voltage threshold (in millivolts) for line presence detection
```

## dts/bindings/chester/hardwario,ctr-x3.yaml
```yaml
#
# Copyright (c) 2023 HARDWARIO a.s.
#
# SPDX-License-Identifier: LicenseRef-HARDWARIO-5-Clause
#

description: HARDWARIO CHESTER-X3 Driver

compatible: "hardwario,ctr-x3"

include: base.yaml

properties:
  slot:
    type: string
    required: true
    description: Slot position (A or B) on CHESTER mainboard
    enum:
      - "A"
      - "B"

  pwr0-gpios:
    type: phandle-array
    required: true
    description: Enable pin for switched power rail (active low)

  pwr1-gpios:
    type: phandle-array
    required: true
    description: Enable pin for switched power rail (active low)
```

## dts/bindings/chester/hardwario,ctr-x4.yaml
```yaml
#
# Copyright (c) 2023 HARDWARIO a.s.
#
# SPDX-License-Identifier: LicenseRef-HARDWARIO-5-Clause
#

description: HARDWARIO CHESTER-X4 Driver

compatible: "hardwario,ctr-x4"

include: base.yaml

properties:

  pwr1-gpios:
    type: phandle-array
    required: true
    description: Power rail output enable 1

  pwr2-gpios:
    type: phandle-array
    required: true
    description: Power rail output enable 2

  pwr3-gpios:
    type: phandle-array
    required: true
    description: Power rail output enable 3

  pwr4-gpios:
    type: phandle-array
    required: true
    description: Power rail output enable 4

  line-measurement-interval:
    type: int
    default: 5000
    description: Time interval (in milliseconds) for line voltage measurement

  line-threshold-min:
    type: int
    default: 7000
    description: Minimum voltage threshold (in millivolts) for line presence detection

  line-threshold-max:
    type: int
    default: 9000
    description: Maximum voltage threshold (in millivolts) for line presence detection
```

## dts/bindings/chester/hardwario,ctr-x7.yaml
```yaml
#
# Copyright (c) 2023 HARDWARIO a.s.
#
# SPDX-License-Identifier: LicenseRef-HARDWARIO-5-Clause
#

description: HARDWARIO CHESTER-X7 Driver

compatible: "hardwario,ctr-x7"

include: base.yaml

properties:

  en-gpios:
    type: phandle-array
    required: true
    description: Step-up enable pin (active high)
```

## dts/bindings/chester/hardwario,ctr-x9.yaml
```yaml
#
# Copyright (c) 2023 HARDWARIO a.s.
#
# SPDX-License-Identifier: LicenseRef-HARDWARIO-5-Clause
#

description: HARDWARIO CHESTER-X9 Driver

compatible: "hardwario,ctr-x9"

include: base.yaml

properties:

  output1-gpios:
    type: phandle-array
    required: true
    description: Output 1

  output2-gpios:
    type: phandle-array
    required: true
    description: Output 2

  output3-gpios:
    type: phandle-array
    required: true
    description: Output 3

  output4-gpios:
    type: phandle-array
    required: true
    description: Output 4
```

## dts/bindings/chester/hardwario,ctr-z.yaml
```yaml
#
# Copyright (c) 2023 HARDWARIO a.s.
#
# SPDX-License-Identifier: LicenseRef-HARDWARIO-5-Clause
#

description: HARDWARIO CHESTER-Z Cover Module

compatible: "hardwario,ctr-z"

include: i2c-device.yaml

properties:
  irq-gpios:
    type: phandle-array
    required: true
    description: |
      Alert line (active low); Needs external pull-up resistor.

  auto-beep:
    type: boolean
    description: |
      Enables the panel to automatically beep on a button press.
```

## dts/bindings/gnss/ublox,m8.yaml
```yaml
#
# Copyright (c) 2023 HARDWARIO a.s.
#
# SPDX-License-Identifier: LicenseRef-HARDWARIO-5-Clause
#

description: u-blox M8 GNSS Receiver

compatible: "u-blox,m8"

include: [i2c-device.yaml]

properties:
  main-en-gpios:
    type: phandle-array
    required: false
    description: |
      Enable main power domain (active high)

  bckp-en-gpios:
    type: phandle-array
    required: false
    description: |
      Enable backup power domain (active high)
```

## dts/bindings/gpio/nxp,pcal6416a.yaml
```yaml
description: PCAL6416A 16-bit I2C-based I/O expander

compatible: "nxp,pcal6416a"

include: [i2c-device.yaml, gpio-controller.yaml]

properties:
    label:
      required: true

    ngpios:
      required: true
      const: 16

    int-gpios:
      type: phandle-array
      required: false
      description: |
        GPIO connected to the controller INT pin. This pin is active-low.

    reset-gpios:
      type: phandle-array
      required: false
      description: |
        GPIO connected to the controller RESET pin. This pin is active-low.

    "#gpio-cells":
      const: 2

gpio-cells:
  - pin
  - flags
```

## dts/bindings/sensor/adi,adxl355.yaml
```yaml
description: Analog Devices 3-axis accelerometer

compatible: "adi,adxl355"

include: i2c-device.yaml

properties:

    range:
      type: int
      description: measurement range
      default: 1
      enum:
        - 1 # +-2g
        - 2 # +-4g
        - 3 # +-8g

    odr_lpf:
      type: int
      description: data rate and low pass filter
      default: 5
      enum: 
        - 0 # Data rate 4000     Hz | low pass filter 1000      Hz
        - 1 # Data rate 2000     Hz | low pass filter  500      Hz
        - 2 # Data rate 1000     Hz | low pass filter  250      Hz
        - 3 # Data rate  500     Hz | low pass filter  125      Hz
        - 4 # Data rate  250     Hz | low pass filter   62.5    Hz
        - 5 # Data rate  125     Hz | low pass filter   31.25   Hz
        - 6 # Data rate   62.5   Hz | low pass filter   15.625  Hz
        - 7 # Data rate   32.25  Hz | low pass filter    7.812  Hz
        - 8 # Data rate   15.625 Hz | low pass filter    3.906  Hz
        - 9 # Data rate    7.813 Hz | low pass filter    1.953  Hz
        - 10 # Data rate   3.306 Hz | low pass filter    0.977  Hz

    hpf:
      type: int
      description: high pass filter
      default: 0
      enum: 
        - 0 # off
        - 1 # 247     x 10^3 data rate
        - 2 #  62.084 x 10^3 data rate
        - 3 #  15.545 x 10^3 data rate
        - 4 #   3.862 x 10^3 data rate
        - 5 #   0.954 x 10^3 data rate
        - 6 #   0.238 x 10^3 data rate


    i2c_speed:
      type: int
      description: i2c speed
      default: 1
      enum: 
        - 0 # fast speed
        - 1 # high speed

    op_mode:
      type: int
      description: operation mode
      default: 1
      enum: 
        - 0 # wakeup
        - 1 # standby

    drdy-gpios:
      type: phandle-array
      required: false
      default: false
      description: |
          The DRDY signal defaults to active high as produced by the
          sensor.

    int1-gpios:
      type: phandle-array
      required: false
      description: |
          The INT1 signal defaults to active high as produced by the
          sensor.  The property value should ensure the flags properly
          describe the signal that is presented to the driver.

    int2-gpios:
      type: phandle-array
      required: false
      description: |
          The INT2 signal defaults to active high as produced by the
          sensor.  The property value should ensure the flags properly
          describe the signal that is presented to the driver.
```

## dts/bindings/sensor/cubic,pm3006s.yaml
```yaml
#
# Copyright (c) 2023 HARDWARIO a.s.
#
# SPDX-License-Identifier: LicenseRef-HARDWARIO-5-Clause
#

description: Cubic PM3006S Outdoor Laser Particle Sensor Module

compatible: "cubic,pm3006s"

include: i2c-device.yaml
```

## dts/bindings/sensor/maxbotix,mb7066.yaml
```yaml
#
# Copyright (c) 2023 HARDWARIO a.s.
#
# SPDX-License-Identifier: LicenseRef-HARDWARIO-5-Clause
#

description: MaxBotix MB7066 ultrasonic distance sensor

compatible: "maxbotix,mb7066"

include: sensor-device.yaml

properties:
  pin-chan:
    type: int
    required: true
    description: |
      CHESTER X0 channel used to connect the sensor

  power-chan:
    type: int
    required: true
    description: |
      CHESTER X0 channel used to power the sensor
```

## dts/bindings/sensor/nxp,mpl3115a2.yaml
```yaml
#
# Copyright (c) 2023 HARDWARIO a.s.
#
# SPDX-License-Identifier: LicenseRef-HARDWARIO-5-Clause
#

description: NXP MPL3115A2 Barometric Pressure/Altitude/Temperature Sensor

compatible: "nxp,mpl3115a2"

include: [sensor-device.yaml, i2c-device.yaml]
```

## dts/bindings/serial/nxp,sc16is7xx.yaml
```yaml
#
# Copyright (c) 2023 HARDWARIO a.s.
#
# SPDX-License-Identifier: LicenseRef-HARDWARIO-5-Clause
#

description: NXP SC16IS7XX, I2C to UART interface

compatible: "nxp,sc16is7xx"

include: [i2c-device.yaml, uart-controller.yaml]

properties:
  clock-frequency:
    type: int
    required: true
    description: Clock frequency in Hz

  prescaler:
    type: int
    required: false
    default: 1
    description: Clock prescaler for programmable baud rate generator
    enum:
      - 1
      - 4

  irq-gpios:
    type: phandle-array
    required: true
    description: tbd

  reset-gpios:
    type: phandle-array
    required: false
    description: tbd

  reset-delay:
    type: int
    required: false
    default: 1000
    description: Reset delay in microseconds

  rts-control:
    type: boolean
    required: false
    description: Enable the transmitter to control the RTS pin

  rts-invert:
    type: boolean
    required: false
    description: Invert RTS signal in RS-485 mode
```
