## dts/bindings/w1/maxim,ds2484.yaml
```yaml
description: DS4284 Single-Channel 1-Wire Master

compatible: "maxim,ds2484"

include: [i2c-device.yaml, w1-controller.yaml]

properties:
  slpz-gpios:
    type: phandle-array
    required: true
    description: |
      Enable sleep mode (active low)

  active-pullup:
    type: boolean
    description: |
      Controls whether an active pullup or a passive pullup is used to drive a
      1-Wire line from low to high.
```

## dts/bindings/w1/maxim,ds28e17.yaml
```yaml
#
# Copyright (c) 2023 HARDWARIO a.s.
#
# SPDX-License-Identifier: LicenseRef-HARDWARIO-5-Clause
#

description: DS28E17 1-Wire-to-I2C Master Bridge

compatible: "maxim,ds28e17"

include: w1-slave.yaml
```

## dts/bindings/w1/w1-controller.yaml
```yaml
# Copyright (c) 2021 Thomas Stranger
# SPDX-License-Identifier: Apache-2.0

# Common fields for W1 controllers

include: base.yaml

bus: w1

properties:
    label:
      required: true
```

## dts/bindings/w1/w1-device.yaml
```yaml
# Copyright (c) 2021, Thomas Stranger
# SPDX-License-Identifier: Apache-2.0

# Common fields for W1 peripheral devices

include: base.yaml

on-bus: w1

properties:
    reg:
        required: false
        description: |
          8-bit 1-Wire family code, which is also part of the 64 bit ROM ID.
    inverted-tx:
      type: boolean
      required: false
      description: |
          The gpio transmit logic is inverted.

          Instead of pulling the line low during the dominant state, the output
          is pulled up in these dominat phases.
          This property migh be enabled in case a FET is used to drive the bus.

    label:
      required: true
```

## lib/Kconfig
```kconfig
#
# Copyright (c) 2023 HARDWARIO a.s.
#
# SPDX-License-Identifier: LicenseRef-HARDWARIO-5-Clause
#

rsource "ctr_buf/Kconfig"
rsource "ctr_util/Kconfig"
```
